/dts-v1/;

/ {
	#address-cells = <0x2>;
	#size-cells = <0x2>;
	compatible = "mediatek,MT6765";
	interrupt-parent = <0x1>;
	model = "MT6765";

	HardwareInfo {
		compatible = "hardinfo,hardinfo_charger";
		phandle = <0xfa>;
		status = "okay";
	};

	__symbols__ {
		DPIDLE = "/cpus/idle-states/dpidle";
		MCDI_CLUSTER = "/cpus/idle-states/mcdi-cluster";
		MCDI_CPU = "/cpus/idle-states/mcdi-cpu";
		SODI = "/cpus/idle-states/sodi";
		SODI3 = "/cpus/idle-states/sodi3";
		STANDBY = "/cpus/idle-states/standby";
		SUSPEND = "/cpus/idle-states/suspend";
		accdet = "/accdet";
		apdma = "/dma-controller@11000580";
		apmixed = "/apmixed@1000c000";
		audclk = "/audclk@11220000";
		audgpio = "/mt_soc_dl1_pcm@11220000";
		audio = "/audio@11220000";
		auxadc = "/auxadc@11001000";
		btcvsd_snd = "/mtk-btcvsd-snd@18050000";
		camera_af_hw_node = "/camera_af_hw_node";
		camsys = "/camsys@1a000000";
		camsys1 = "/camsysisp@1a000000";
		cci = "/cci";
		cci_opp = "/opp_table2";
		ccifdriver = "/ccifdriver@10209000";
		cdfinger = "/cdfinger";
		charger = "/charger";
		chosen = "/chosen";
		cldmadriver = "/cldmadriver@10014000";
		clk13m = "/clocks/clk13m";
		clk26m = "/clocks/clk26m";
		clk32k = "/clocks/clk32k";
		clock_buffer_ctrl = "/pwrap@1000d000/main_pmic/clock_buffer_ctrl";
		cluster0_opp = "/opp_table0";
		cluster1_opp = "/opp_table1";
		cm_mgr = "/cm_mgr@10200000";
		consys = "/consys@18002000";
		consys_mem = "/reserved-memory/consys-reserve-memory";
		cpu0 = "/cpus/cpu@000";
		cpu1 = "/cpus/cpu@001";
		cpu2 = "/cpus/cpu@002";
		cpu3 = "/cpus/cpu@003";
		cpu4 = "/cpus/cpu@100";
		cpu5 = "/cpus/cpu@101";
		cpu6 = "/cpus/cpu@102";
		cpu7 = "/cpus/cpu@103";
		cpu_dbgapb = "/cpu_dbgapb@0d410000";
		cpu_freq_segment = "/efuse@11c50000/segment@1c";
		dcm = "/dcm@10001000";
		disp_color0 = "/disp_color0@1400f000";
		disp_mutex0 = "/disp_mutex0@14001000";
		dispsys_config = "/dispsys_config@14000000";
		dsi_te = "/dsi_te";
		dvfsrc = "/dvfsrc@10012000";
		dvfsrc_freq_opp0 = "/dvfsrc@10012000/opp0";
		dvfsrc_freq_opp1 = "/dvfsrc@10012000/opp1";
		dvfsrc_freq_opp2 = "/dvfsrc@10012000/opp2";
		dynamic_options = "/dynamic_options";
		efuse = "/efuse@11c50000";
		efuse_ly = "/efuse@11c50000/ly@210";
		efuse_segment = "/efuse@11c50000/segment@78";
		eint = "/eint@1000b000";
		ext_32k = "/pwrap@1000d000/main_pmic/mtk_rtc/ext_32k";
		extcon_usb = "/extcon_usb";
		fg_init = "/pwrap@1000d000/main_pmic/mtk_rtc/fg_init";
		fg_soc = "/pwrap@1000d000/main_pmic/mtk_rtc/fg_soc";
		flashlight_core = "/flashlight_core";
		flashlights_aw36518 = "/flashlights_aw36518";
		flashlights_mt6370 = "/flashlights_mt6370";
		flashlights_sgm3785_gpio = "/flashlights_sgm3785_gpio";
		fp_egistec = "/fp_egistec";
		fpsensor_finger = "/fpsensor_finger";
		gce = "/gce@10238000";
		gce_mbox = "/gce_mbox@10238000";
		gce_mbox_svp = "/gce_mbox_svp@10238000";
		ged = "/ged";
		gic = "/interrupt-controller@0c000000";
		gpio = "/gpio@10005000";
		gpio_usage_mapping = "/gpio";
		gpufreq = "/gpufreq";
		hwinfo = "/HardwareInfo";
		hwrng = "/hwrng";
		i2c0 = "/i2c0@11007000";
		i2c1 = "/i2c1@11008000";
		i2c2 = "/i2c2@11009000";
		i2c20 = "/i2c-gpio@0";
		i2c3 = "/i2c3@1100f000";
		i2c4 = "/i2c4@11011000";
		i2c5 = "/i2c5@11016000";
		i2c6 = "/i2c6@1100d000";
		i2c7 = "/i2c7";
		i2c8 = "/i2c8";
		i2c9 = "/i2c9";
		i2c_common = "/i2c_common";
		imgsys = "/imgsys_clk@15020000";
		infracfg_ao = "/infracfg_ao@10001000";
		io_cfg_bl = "/io_cfg_bl@10002600";
		io_cfg_lb = "/io_cfg_lb@10002400";
		io_cfg_lm = "/io_cfg_lm@10002200";
		io_cfg_lt = "/io_cfg_lt@10002000";
		io_cfg_rb = "/io_cfg_rb@10002a00";
		io_cfg_rr = "/io_cfg_rr@10002800";
		io_cfg_rt = "/io_cfg_rt@10002c00";
		irq_nfc = "/irq_nfc";
		irtx_pwm = "/irtx_pwm";
		kd_camera_hw1 = "/kd_camera_hw1@1a040000";
		keypad = "/kp@10010000";
		lk_charger = "/lk_charger";
		main_pmic = "/pwrap@1000d000/main_pmic";
		md1_sim1_hot_plug_eint = "/md1_sim1_hot_plug_eint";
		md1_sim2_hot_plug_eint = "/md1_sim2_hot_plug_eint";
		md_auxadc = "/md_auxadc";
		mddriver = "/mddriver@10014000";
		mdp_ccorr = "/mdp_ccorr0@14005000";
		mdp_rdma0 = "/mdp_rdma0@14004000";
		mdp_rsz0 = "/mdp_rsz0@14006000";
		mdp_rsz1 = "/mdp_rsz1@14007000";
		mdp_tdshp0 = "/mdp_tdshp0@1400a000";
		mdp_wdma0 = "/mdp_wdma0@14008000";
		mdp_wrot0 = "/mdp_wrot0@14009000";
		memory_ssmr_features = "/memory-ssmr-features";
		mfg_cfg = "/mfg_cfg@13ffe000";
		mfg_doma = "/mfg_doma@13000000";
		mipi_rx_ana_csi0a = "/mipi_rx_ana_csi0a@11c10000";
		mipi_rx_ana_csi0b = "/mipi_rx_ana_csi0b@11c11000";
		mipi_rx_ana_csi1a = "/mipi_rx_ana_csi1a@11c12000";
		mipi_rx_ana_csi1b = "/mipi_rx_ana_csi1b@11c13000";
		mipi_rx_ana_csi2a = "/mipi_rx_ana_csi2a@11c14000";
		mipi_rx_ana_csi2b = "/mipi_rx_ana_csi2b@11c15000";
		mmsys_config = "/mmsys_config@14000000";
		mrdump_ext_rst = "/mrdump_ext_rst";
		msdc0 = "/msdc@11230000";
		msdc0_pins_default = "/pinctrl@1000b000/msdc0@default";
		msdc0_pins_hs200 = "/pinctrl@1000b000/msdc0@hs200";
		msdc0_pins_hs400 = "/pinctrl@1000b000/msdc0@hs400";
		msdc0_register_setting_default = "/pinctrl@1000b000/msdc0@register_default";
		msdc1 = "/msdc@11240000";
		msdc1_ins = "/msdc1_ins@0";
		msdc1_pins_ddr50 = "/pinctrl@1000b000/msdc1@ddr50";
		msdc1_pins_default = "/pinctrl@1000b000/msdc1@default";
		msdc1_pins_sdr104 = "/pinctrl@1000b000/msdc1@sdr104";
		msdc1_pins_sdr50 = "/pinctrl@1000b000/msdc1@sdr50";
		msdc1_register_setting_default = "/pinctrl@1000b000/msdc1@register_default";
		msdc2 = "/msdc@11250000";
		msdc3 = "/msdc@11260000";
		msdc3_pins_default = "/pinctrl@1000b000/msdc3@default";
		msdc3_register_setting_default = "/pinctrl@1000b000/msdc3@register_default";
		mt6357_charger = "/pwrap@1000d000/main_pmic/mt6357_charger";
		mt6357_ts_buck1 = "/pwrap@1000d000/main_pmic/mt6357_ts_buck1";
		mt6357_ts_buck2 = "/pwrap@1000d000/main_pmic/mt6357_ts_buck2";
		mt6357keys = "/pwrap@1000d000/main_pmic/mt6357keys";
		mt6357regulator = "/pwrap@1000d000/main_pmic/mt6357regulator";
		mt6370_chg = "/mt6370_pmu_dts/charger";
		mt6370_pmu = "/mt6370_pmu_dts";
		mt6370_typec = "/type_c_port0";
		mt_pmic_vaud28_ldo_reg = "/pwrap@1000d000/main_pmic/mt6357regulator/ldo_vaud28";
		mt_pmic_vaux18_ldo_reg = "/pwrap@1000d000/main_pmic/mt6357regulator/ldo_vaux18";
		mt_pmic_vcama_ldo_reg = "/pwrap@1000d000/main_pmic/mt6357regulator/ldo_vcama";
		mt_pmic_vcamd_ldo_reg = "/pwrap@1000d000/main_pmic/mt6357regulator/ldo_vcamd";
		mt_pmic_vcamio_ldo_reg = "/pwrap@1000d000/main_pmic/mt6357regulator/ldo_vcamio";
		mt_pmic_vcn18_ldo_reg = "/pwrap@1000d000/main_pmic/mt6357regulator/ldo_vcn18";
		mt_pmic_vcn28_ldo_reg = "/pwrap@1000d000/main_pmic/mt6357regulator/ldo_vcn28";
		mt_pmic_vcn33_bt_ldo_reg = "/pwrap@1000d000/main_pmic/mt6357regulator/ldo_vcn33_bt";
		mt_pmic_vcn33_wifi_ldo_reg = "/pwrap@1000d000/main_pmic/mt6357regulator/ldo_vcn33_wifi";
		mt_pmic_vcore_buck_reg = "/pwrap@1000d000/main_pmic/mt6357regulator/buck_vcore";
		mt_pmic_vdram_ldo_reg = "/pwrap@1000d000/main_pmic/mt6357regulator/ldo_vdram";
		mt_pmic_vefuse_ldo_reg = "/pwrap@1000d000/main_pmic/mt6357regulator/ldo_vefuse";
		mt_pmic_vemc_ldo_reg = "/pwrap@1000d000/main_pmic/mt6357regulator/ldo_vemc";
		mt_pmic_vfe28_ldo_reg = "/pwrap@1000d000/main_pmic/mt6357regulator/ldo_vfe28";
		mt_pmic_vibr_ldo_reg = "/pwrap@1000d000/main_pmic/mt6357regulator/ldo_vibr";
		mt_pmic_vio18_ldo_reg = "/pwrap@1000d000/main_pmic/mt6357regulator/ldo_vio18";
		mt_pmic_vio28_ldo_reg = "/pwrap@1000d000/main_pmic/mt6357regulator/ldo_vio28";
		mt_pmic_vldo28_ldo_reg = "/pwrap@1000d000/main_pmic/mt6357regulator/ldo_vldo28";
		mt_pmic_vmc_ldo_reg = "/pwrap@1000d000/main_pmic/mt6357regulator/ldo_vmc";
		mt_pmic_vmch_ldo_reg = "/pwrap@1000d000/main_pmic/mt6357regulator/ldo_vmch";
		mt_pmic_vmodem_buck_reg = "/pwrap@1000d000/main_pmic/mt6357regulator/buck_vmodem";
		mt_pmic_vpa_buck_reg = "/pwrap@1000d000/main_pmic/mt6357regulator/buck_vpa";
		mt_pmic_vproc_buck_reg = "/pwrap@1000d000/main_pmic/mt6357regulator/buck_vproc";
		mt_pmic_vrf12_ldo_reg = "/pwrap@1000d000/main_pmic/mt6357regulator/ldo_vrf12";
		mt_pmic_vrf18_ldo_reg = "/pwrap@1000d000/main_pmic/mt6357regulator/ldo_vrf18";
		mt_pmic_vs1_buck_reg = "/pwrap@1000d000/main_pmic/mt6357regulator/buck_vs1";
		mt_pmic_vsim1_ldo_reg = "/pwrap@1000d000/main_pmic/mt6357regulator/ldo_vsim1";
		mt_pmic_vsim2_ldo_reg = "/pwrap@1000d000/main_pmic/mt6357regulator/ldo_vsim2";
		mt_pmic_vsram_others_ldo_reg = "/pwrap@1000d000/main_pmic/mt6357regulator/ldo_vsram_others";
		mt_pmic_vsram_proc_ldo_reg = "/pwrap@1000d000/main_pmic/mt6357regulator/ldo_vsram_proc";
		mt_pmic_vusb33_ldo_reg = "/pwrap@1000d000/main_pmic/mt6357regulator/ldo_vusb33";
		mt_pmic_vxo22_ldo_reg = "/pwrap@1000d000/main_pmic/mt6357regulator/ldo_vxo22";
		mtk_charger_type = "/pwrap@1000d000/main_pmic/mtk_charger_type";
		mtk_gauge = "/pwrap@1000d000/main_pmic/mtk_gauge";
		mtk_rtc = "/pwrap@1000d000/main_pmic/mtk_rtc";
		mtk_ts_pmic = "/pwrap@1000d000/main_pmic/mtk_ts_pmic";
		mtkfb = "/mtkfb@0";
		nfc = "/nfc";
		odm = "/odm";
		otg_iddig = "/otg_iddig";
		otg_vbus = "/mt6370_pmu_dts/charger/usb-otg-vbus";
		pd_adapter = "/pd_adapter";
		pdc = "/pdc";
		pe = "/pe";
		pe2 = "/pe2";
		pe4 = "/pe4";
		pericfg = "/pericfg@10003000";
		pio = "/pinctrl@1000b000";
		pmic_accdet = "/pwrap@1000d000/main_pmic/pmic_accdet";
		pmic_auxadc = "/pwrap@1000d000/main_pmic/pmic_auxadc";
		pmic_clock_buffer_ctrl = "/pmic_clock_buffer_ctrl";
		pmic_codec = "/pwrap@1000d000/main_pmic/pmic_codec";
		pmic_efuse = "/pwrap@1000d000/main_pmic/pmic_efuse";
		pwm = "/pwm@11006000";
		pwrap = "/pwrap@1000d000";
		radio_md_cfg = "/radio_md_cfg";
		reserved_memory = "/reserved-memory";
		rt9465_slave_chr = "/rt9465_slave_chr";
		scp_infra = "/scp_infra@10001000";
		scpsys = "/scpsys@10001000";
		silead_fp = "/silead_fp";
		sleep = "/sleep@10006000";
		smart_pa = "/smart_pa";
		smi_common = "/smi_common@14002000";
		smi_larb0 = "/smi_larb0@14003000";
		smi_larb1 = "/smi_larb1@17010000";
		smi_larb2 = "/smi_larb2@15021000";
		smi_larb3 = "/smi_larb3@1a002000";
		soc_codec = "/mt_soc_codec_name";
		spi0 = "/spi@1100a000";
		spi1 = "/spi@11010000";
		spi2 = "/spi@11012000";
		spi3 = "/spi@11013000";
		spi4 = "/spi@11014000";
		spi5 = "/spi@11015000";
		ssmr_cma_mem = "/reserved-memory/ssmr-reserved-cma_memory";
		subpmic_pmu_eint = "/mt6370_pmu_eint";
		sysirq = "/intpol-controller@10200a80";
		tboard_thermistor1 = "/thermal-sensor1";
		tboard_thermistor2 = "/thermal-sensor2";
		tboard_thermistor3 = "/thermal-sensor3";
		tboard_thermistor4 = "/thermal-sensor4";
		tcpc1 = "/i2c5@11016000/sgm7220@47";
		tcpc2 = "/i2c5@11016000/fusb301@21";
		tcpc_pd = "/mt6370_pd_eint";
		thermal_efuse = "/efuse@11c50000/segment@190";
		timer = "/timer@10017000";
		topckgen = "/topckgen@10000000";
		toprgu = "/toprgu@10007000";
		touch = "/touch";
		u2_phy_data = "/efuse@11c50000/u2_phy_data@1ac";
		u2phy0 = "/usb-phy@11210000";
		u2port0 = "/usb-phy@11210000/usb-phy@11210000";
		uart0 = "/serial@11020000";
		uart1 = "/serial@11030000";
		usb = "/usb0@11200000";
		usb_typec_will = "/i2c5@11016000/wusb3801@60";
		vcodecsys = "/vcodecsys@17000000";
		venc_gcon = "/venc_gcon@17000000";
		wifi = "/wifi@18000000";
		wifi_mem = "/reserved-memory/wifi-reserve-memory";
	};

	accdet {
		compatible = "mediatek,pmic-accdet";
		phandle = <0x9d>;
	};

	aes_top0@10016000 {
		compatible = "mediatek,aes_top0";
		reg = <0x0 0x10016000 0x0 0x1000>;
	};

	aliases {
		i2c20 = "/i2c-gpio@0";
	};

	amms_control {
		compatible = "mediatek,amms";
		interrupts = <0x0 0x86 0x1>;
	};

	ap_ccif0@10209000 {
		compatible = "mediatek,ap_ccif0";
		interrupts = <0x0 0x94 0x8>;
		reg = <0x0 0x10209000 0x0 0x1000>;
	};

	ap_ccif1@1020b000 {
		compatible = "mediatek,ap_ccif1";
		interrupts = <0x0 0x96 0x8>;
		reg = <0x0 0x1020b000 0x0 0x1000>;
	};

	ap_ccif2@1023c000 {
		compatible = "mediatek,ap_ccif2";
		interrupts = <0x0 0x8f 0x8>;
		reg = <0x0 0x1023c000 0x0 0x1000>;
	};

	ap_ccif3@1023e000 {
		compatible = "mediatek,ap_ccif3";
		interrupts = <0x0 0x92 0x8>;
		reg = <0x0 0x1023e000 0x0 0x1000>;
	};

	ap_dma@11000000 {
		compatible = "mediatek,ap_dma";
		interrupts = <0x0 0x61 0x8>;
		reg = <0x0 0x11000000 0x0 0x1000>;
	};

	apcldmain@1021b000 {
		compatible = "mediatek,apcldmain";
		reg = <0x0 0x1021b000 0x0 0x0>;
	};

	apcldmain_ao@10014000 {
		compatible = "mediatek,apcldmain_ao";
		reg = <0x0 0x10014000 0x0 0x400>;
	};

	apcldmamisc@1021b800 {
		compatible = "mediatek,apcldmamisc";
		interrupts = <0x0 0xa5 0x4>;
		reg = <0x0 0x1021b800 0x0 0x0>;
	};

	apcldmamisc_ao@10014800 {
		compatible = "mediatek,apcldmamisc_ao";
		reg = <0x0 0x10014800 0x0 0x400>;
	};

	apcldmaout@1021b400 {
		compatible = "mediatek,apcldmaout";
		reg = <0x0 0x1021b400 0x0 0x0>;
	};

	apcldmaout_ao@10014400 {
		compatible = "mediatek,apcldmaout_ao";
		reg = <0x0 0x10014400 0x0 0x400>;
	};

	apmixed@1000c000 {
		#clock-cells = <0x1>;
		compatible = "mediatek,mt6765-apmixedsys", "syscon";
		phandle = <0x3>;
		reg = <0x0 0x1000c000 0x0 0xe00>;
	};

	apxgpt@10008000 {
		clocks = <0x23>;
		compatible = "mediatek,apxgpt";
		interrupts = <0x0 0xaa 0x8>;
		reg = <0x0 0x10008000 0x0 0x1000>;
	};

	atf_logger {
		compatible = "mediatek,atf_logger";
		interrupts = <0x0 0xf7 0x1>;
	};

	audclk@11220000 {
		#clock-cells = <0x1>;
		compatible = "mediatek,mt6765-audsys", "syscon";
		phandle = <0x5f>;
		reg = <0x0 0x11220000 0x0 0x1000>;
	};

	audio@11220000 {
		compatible = "mediatek,audio", "syscon";
		mediatek,btcvsd_snd = <0x5d>;
		mediatek,headset-codec = <0x5e>;
		phandle = <0xc7>;
		reg = <0x0 0x11220000 0x0 0x1000>;
	};

	audio_snd_card {
		compatible = "mediatek,audio_snd_card";
	};

	audio_sram@11221000 {
		compatible = "mediatek,audio_sram";
		reg = <0x0 0x11221000 0x0 0x9000>;
	};

	auxadc@11001000 {
		#interconnect-cells = <0x1>;
		#io-channel-cells = <0x1>;
		clock-names = "main";
		clocks = <0x25 0x21>;
		compatible = "mediatek,mt6765-auxadc";
		interrupts = <0x0 0x4c 0x2>;
		mediatek,cali-efuse-reg-offset = <0x1a8>;
		mediatek,cali-en-bit = <0x14>;
		mediatek,cali-ge-bit = <0xa>;
		mediatek,cali-oe-bit = <0x0>;
		nvmem = <0x3b>;
		nvmem-names = "mtk_efuse";
		phandle = <0x38>;
		reg = <0x0 0x11001000 0x0 0x1000>;
	};

	bpi_bsi_slv0@1021e000 {
		compatible = "mediatek,bpi_bsi_slv0";
		reg = <0x0 0x1021e000 0x0 0x1000>;
	};

	bpi_bsi_slv1@1021f000 {
		compatible = "mediatek,bpi_bsi_slv1";
		reg = <0x0 0x1021f000 0x0 0x6000>;
	};

	bpi_bsi_slv2@10225000 {
		compatible = "mediatek,bpi_bsi_slv2";
		reg = <0x0 0x10225000 0x0 0x1000>;
	};

	btif@1100c000 {
		clock-names = "btifc", "apdmac";
		clocks = <0x25 0x1a 0x25 0x26>;
		compatible = "mediatek,btif";
		interrupts = <0x0 0x70 0x8 0x0 0x84 0x8 0x0 0x85 0x8>;
		reg = <0x0 0x1100c000 0x0 0x1000 0x0 0x11000880 0x0 0x80 0x0 0x11000900 0x0 0x80>;
	};

	bus_dbg@10208000 {
		compatible = "mediatek,bus_dbg-v2";
		interrupts = <0x0 0x8d 0x8>;
		mediatek,bus_dbg_con_offset = <0x2fc>;
		reg = <0x0 0x10208000 0x0 0x1000 0x0 0x10001000 0x0 0x1000>;
	};

	cam1@1a003000 {
		compatible = "mediatek,cam1";
		interrupts = <0x0 0xeb 0x8>;
		reg = <0x0 0x1a003000 0x0 0x1000>;
	};

	cam2@1a004000 {
		compatible = "mediatek,cam2";
		interrupts = <0x0 0xec 0x8>;
		reg = <0x0 0x1a004000 0x0 0x1000>;
	};

	cam3@1a005000 {
		compatible = "mediatek,cam3";
		interrupts = <0x0 0xed 0x8>;
		reg = <0x0 0x1a005000 0x0 0x1000>;
	};

	cam_clear@1a01b000 {
		compatible = "mediatek,cam_clear";
		reg = <0x0 0x1a01b000 0x0 0x1000>;
	};

	cam_inner@1a013000 {
		compatible = "mediatek,cam_inner";
		reg = <0x0 0x1a013000 0x0 0x1000>;
	};

	cam_set@1a00b000 {
		compatible = "mediatek,cam_set";
		reg = <0x0 0x1a00b000 0x0 0x1000>;
	};

	cama_clear@1a01c000 {
		compatible = "mediatek,cama_clear";
		reg = <0x0 0x1a01c000 0x0 0x1000>;
	};

	cama_ext@1a024000 {
		compatible = "mediatek,cama_ext";
		reg = <0x0 0x1a024000 0x0 0x1000>;
	};

	cama_inner@1a014000 {
		compatible = "mediatek,cama_inner";
		reg = <0x0 0x1a014000 0x0 0x1000>;
	};

	cama_set@1a00c000 {
		compatible = "mediatek,cama_set";
		reg = <0x0 0x1a00c000 0x0 0x1000>;
	};

	camb_clear@1a01d000 {
		compatible = "mediatek,camb_clear";
		reg = <0x0 0x1a01d000 0x0 0x1000>;
	};

	camb_ext@1a025000 {
		compatible = "mediatek,camb_ext";
		reg = <0x0 0x1a025000 0x0 0x1000>;
	};

	camb_inner@1a015000 {
		compatible = "mediatek,camb_inner";
		reg = <0x0 0x1a015000 0x0 0x1000>;
	};

	camb_set@1a00d000 {
		compatible = "mediatek,camb_set";
		reg = <0x0 0x1a00d000 0x0 0x1000>;
	};

	camera_af_hw_node {
		compatible = "mediatek,camera_af_lens";
		phandle = <0xdc>;
	};

	camsv1@1a050000 {
		compatible = "mediatek,camsv1";
		interrupts = <0x0 0xf3 0x8>;
		reg = <0x0 0x1a050000 0x0 0x1000>;
	};

	camsv2@1a051000 {
		compatible = "mediatek,camsv2";
		interrupts = <0x0 0xf4 0x8>;
		reg = <0x0 0x1a051000 0x0 0x1000>;
	};

	camsv3@1a052000 {
		compatible = "mediatek,camsv3";
		interrupts = <0x0 0xf1 0x8>;
		reg = <0x0 0x1a052000 0x0 0x1000>;
	};

	camsv4@1a053000 {
		compatible = "mediatek,camsv4";
		interrupts = <0x0 0xf2 0x8>;
		reg = <0x0 0x1a053000 0x0 0x1000>;
	};

	camsys@1a000000 {
		#clock-cells = <0x1>;
		compatible = "mediatek,mt6765-camsys", "syscon";
		phandle = <0x65>;
		pwr-regmap = <0x62>;
		reg = <0x0 0x1a000000 0x0 0x1000>;
	};

	camsysisp@1a000000 {
		compatible = "mediatek,camsys", "syscon";
		phandle = <0xd9>;
		reg = <0x0 0x1a000000 0x0 0x1000>;
	};

	cci {
		clock-names = "dsu_clock";
		clocks = <0x3 0x2>;
		compatible = "mediatek,mtk-cci";
		operating-points-v2 = <0x4>;
		phandle = <0x6c>;
	};

	ccifdriver@10209000 {
		clock-names = "infra-ccif-ap", "infra-ccif-md", "infra-ccif1-ap", "infra-ccif1-md", "infra-ccif2-ap", "infra-ccif2-md";
		clocks = <0x25 0x29 0x25 0x2c 0x25 0x23 0x25 0x24 0x25 0x51 0x25 0x52>;
		compatible = "mediatek,ccci_ccif";
		interrupts = <0x0 0x94 0x8 0x0 0x95 0x8>;
		mediatek,sram_size = <0x200>;
		phandle = <0xa4>;
		reg = <0x0 0x10209000 0x0 0x1000 0x0 0x1020a000 0x0 0x1000>;
	};

	ccu@1a0b1000 {
		clock-names = "CCU_CLK_CAM_CCU", "CAM_PWR";
		clocks = <0x65 0x8 0x35 0x9>;
		compatible = "mediatek,ccu";
		interrupts = <0x0 0xf6 0x8>;
		reg = <0x0 0x1a0b1000 0x0 0x1000>;
	};

	cdfinger {
		compatible = "mediatek,mtk_finger";
		phandle = <0xa1>;
	};

	charger {
		ac_charger_current = <0x1e8480>;
		ac_charger_input_current = <0x16e360>;
		algorithm_name = "Basic";
		battery_cv = <0x426030>;
		bootmode = <0x2a>;
		charger = <0x29>;
		charger_configuration = <0x0>;
		charging_host_charger_current = <0x16e360>;
		compatible = "mediatek,charger";
		enable_dynamic_mivr;
		enable_min_charge_temp;
		gauge = <0x68>;
		jeita_temp_above_t4_cv = <0x40b280>;
		jeita_temp_below_t0_cv = <0x3da540>;
		jeita_temp_t0_to_t1_cv = <0x3da540>;
		jeita_temp_t1_to_t2_cv = <0x40b280>;
		jeita_temp_t2_to_t3_cv = <0x423920>;
		jeita_temp_t3_to_t4_cv = <0x40b280>;
		max_charge_temp = <0x32>;
		max_charge_temp_minus_x_degree = <0x2f>;
		max_charger_voltage = <0x632ea0>;
		max_dmivr_charger_current = <0x1b7740>;
		min_charge_temp = <0x0>;
		min_charge_temp_plus_x_degree = <0x6>;
		min_charger_voltage = <0x4630c0>;
		min_charger_voltage_1 = <0x432380>;
		min_charger_voltage_2 = <0x401640>;
		phandle = <0x2e>;
		pmic = <0x30>;
		temp_neg_10_thres = <0x0>;
		temp_t0_thres = <0x0>;
		temp_t0_thres_plus_x_degree = <0x0>;
		temp_t1_thres = <0x0>;
		temp_t1_thres_plus_x_degree = <0x6>;
		temp_t2_thres = <0xa>;
		temp_t2_thres_plus_x_degree = <0x10>;
		temp_t3_thres = <0x2d>;
		temp_t3_thres_minus_x_degree = <0x27>;
		temp_t4_thres = <0x32>;
		temp_t4_thres_minus_x_degree = <0x2f>;
		usb_charger_current = <0x7a120>;
	};

	chipid@08000000 {
		compatible = "mediatek,chipid";
		reg = <0x0 0x8000000 0x0 0x4 0x0 0x8000004 0x0 0x4 0x0 0x8000008 0x0 0x4 0x0 0x800000c 0x0 0x4>;
	};

	chosen {
		bootargs = "console=tty0 console=ttyS0,921600n1 vmalloc=400M page_owner=on swiotlb=noforce androidboot.hardware=mt6765 maxcpus=8 loop.max_part=7 firmware_class.path=/vendor/firmware";
		kaslr-seed = <0x0 0x0>;
		phandle = <0x2a>;
	};

	cldmadriver@10014000 {
		cldma-infracfg = <0x25>;
		clock-names = "infra-cldma-bclk";
		clocks = <0x25 0x32>;
		compatible = "mediatek,ccci_cldma";
		interrupts = <0x0 0xa5 0x4>;
		mediatek,cldma_capability = <0x6>;
		mediatek,md_generation = <0x1895>;
		mediatek,platform = <0x1a6d>;
		phandle = <0xa5>;
		reg = <0x0 0x10014000 0x0 0x1000 0x0 0x1021b000 0x0 0x1000>;
	};

	clocks {

		clk13m {
			#clock-cells = <0x0>;
			clock-frequency = <0xc65d40>;
			compatible = "fixed-clock";
			phandle = <0x34>;
		};

		clk26m {
			#clock-cells = <0x0>;
			clock-frequency = <0x18cba80>;
			compatible = "fixed-clock";
			phandle = <0x24>;
		};

		clk32k {
			#clock-cells = <0x0>;
			clock-frequency = <0x7d00>;
			compatible = "fixed-clock";
			phandle = <0x23>;
		};
	};

	cm_mgr@10200000 {
		cm_mgr,cp_down = <0x64 0x64>;
		cm_mgr,cp_up = <0x64 0x64>;
		cm_mgr,dt_down = <0x0 0x3>;
		cm_mgr,dt_up = <0x0 0x3>;
		cm_mgr,vp_down = <0x64 0x64>;
		cm_mgr,vp_up = <0x64 0x64>;
		compatible = "mediatek,mt6765-cm_mgr";
		phandle = <0xf9>;
		reg = <0x0 0x10200000 0x0 0x4000>;
		reg-names = "cm_mgr_base";
		required-opps = <0x31 0x32 0x33>;
	};

	consys@18002000 {
		#address-cells = <0x2>;
		#size-cells = <0x2>;
		clock-names = "conn";
		clocks = <0x35 0x1>;
		compatible = "mediatek,mt6765-consys";
		interrupts = <0x0 0x10b 0x8 0x0 0x10d 0x8 0x0 0x10e 0x1>;
		memory-region = <0x4c>;
		phandle = <0x21>;
		pmic = <0x30>;
		reg = <0x0 0x18002000 0x0 0x1000 0x0 0x10007000 0x0 0x100 0x0 0x10001000 0x0 0x1000 0x0 0x10006000 0x0 0x1000 0x0 0x18007000 0x0 0x1000 0x0 0x180b1000 0x0 0x1000 0x0 0x180a3000 0x0 0x1000 0x0 0x180a5000 0x0 0x800 0x0 0x180c1000 0x0 0x1000 0x0 0x18004000 0x0 0x1000 0x0 0x0 0x0 0x0 0x0 0x0 0x0 0x0 0x0 0x1020e000 0x0 0x1000>;
	};

	cpu_dbgapb@0d410000 {
		compatible = "mediatek,hw_dbg";
		num = <0x8>;
		phandle = <0x6e>;
		reg = <0x0 0xd410000 0x0 0x1000 0x0 0xd510000 0x0 0x1000 0x0 0xd610000 0x0 0x1000 0x0 0xd710000 0x0 0x1000 0x0 0xd810000 0x0 0x1000 0x0 0xd910000 0x0 0x1000 0x0 0xda10000 0x0 0x1000 0x0 0xdb10000 0x0 0x1000>;
	};

	cpus {
		#address-cells = <0x1>;
		#size-cells = <0x0>;

		cpu-map {

			cluster0 {

				core0 {
					cpu = <0xe>;
				};

				core1 {
					cpu = <0xf>;
				};

				core2 {
					cpu = <0x10>;
				};

				core3 {
					cpu = <0x11>;
				};
			};

			cluster1 {

				core0 {
					cpu = <0x12>;
				};

				core1 {
					cpu = <0x13>;
				};

				core2 {
					cpu = <0x14>;
				};

				core3 {
					cpu = <0x15>;
				};
			};
		};

		cpu@000 {
			capacity-dmips-mhz = <0x400>;
			clock-frequency = <0x89267940>;
			compatible = "arm,cortex-a53";
			cpu-idle-states = <0x6 0x7 0x8 0x9 0xa 0xb 0xc>;
			device_type = "cpu";
			dynamic-power-coefficient = <0x113>;
			enable-method = "psci";
			operating-points-v2 = <0x5>;
			phandle = <0xe>;
			reg = <0x0>;
		};

		cpu@001 {
			capacity-dmips-mhz = <0x400>;
			clock-frequency = <0x89267940>;
			compatible = "arm,cortex-a53";
			cpu-idle-states = <0x6 0x7 0x8 0x9 0xa 0xb 0xc>;
			device_type = "cpu";
			dynamic-power-coefficient = <0x113>;
			enable-method = "psci";
			operating-points-v2 = <0x5>;
			phandle = <0xf>;
			reg = <0x1>;
		};

		cpu@002 {
			capacity-dmips-mhz = <0x400>;
			clock-frequency = <0x89267940>;
			compatible = "arm,cortex-a53";
			cpu-idle-states = <0x6 0x7 0x8 0x9 0xa 0xb 0xc>;
			device_type = "cpu";
			dynamic-power-coefficient = <0x113>;
			enable-method = "psci";
			operating-points-v2 = <0x5>;
			phandle = <0x10>;
			reg = <0x2>;
		};

		cpu@003 {
			capacity-dmips-mhz = <0x400>;
			clock-frequency = <0x89267940>;
			compatible = "arm,cortex-a53";
			cpu-idle-states = <0x6 0x7 0x8 0x9 0xa 0xb 0xc>;
			device_type = "cpu";
			dynamic-power-coefficient = <0x113>;
			enable-method = "psci";
			operating-points-v2 = <0x5>;
			phandle = <0x11>;
			reg = <0x3>;
		};

		cpu@100 {
			capacity-dmips-mhz = <0x321>;
			clock-frequency = <0x6b49d200>;
			compatible = "arm,cortex-a53";
			cpu-idle-states = <0x6 0x7 0x8 0x9 0xa 0xb 0xc>;
			device_type = "cpu";
			dynamic-power-coefficient = <0x55>;
			enable-method = "psci";
			operating-points-v2 = <0xd>;
			phandle = <0x12>;
			reg = <0x100>;
		};

		cpu@101 {
			capacity-dmips-mhz = <0x321>;
			clock-frequency = <0x6b49d200>;
			compatible = "arm,cortex-a53";
			cpu-idle-states = <0x6 0x7 0x8 0x9 0xa 0xb 0xc>;
			device_type = "cpu";
			dynamic-power-coefficient = <0x55>;
			enable-method = "psci";
			operating-points-v2 = <0xd>;
			phandle = <0x13>;
			reg = <0x101>;
		};

		cpu@102 {
			capacity-dmips-mhz = <0x321>;
			clock-frequency = <0x6b49d200>;
			compatible = "arm,cortex-a53";
			cpu-idle-states = <0x6 0x7 0x8 0x9 0xa 0xb 0xc>;
			device_type = "cpu";
			dynamic-power-coefficient = <0x55>;
			enable-method = "psci";
			operating-points-v2 = <0xd>;
			phandle = <0x14>;
			reg = <0x102>;
		};

		cpu@103 {
			capacity-dmips-mhz = <0x321>;
			clock-frequency = <0x6b49d200>;
			compatible = "arm,cortex-a53";
			cpu-idle-states = <0x6 0x7 0x8 0x9 0xa 0xb 0xc>;
			device_type = "cpu";
			dynamic-power-coefficient = <0x55>;
			enable-method = "psci";
			operating-points-v2 = <0xd>;
			phandle = <0x15>;
			reg = <0x103>;
		};

		idle-states {
			entry-method = "arm,psci";

			dpidle {
				arm,psci-suspend-param = <0x1010004>;
				compatible = "arm,idle-state";
				entry-latency-us = <0x320>;
				exit-latency-us = <0x3e8>;
				min-residency-us = <0x7d0>;
				phandle = <0xb>;
			};

			mcdi-cluster {
				arm,psci-suspend-param = <0x1010001>;
				compatible = "arm,idle-state";
				entry-latency-us = <0x258>;
				exit-latency-us = <0x258>;
				min-residency-us = <0x4b0>;
				phandle = <0x8>;
			};

			mcdi-cpu {
				arm,psci-suspend-param = <0x10001>;
				compatible = "arm,idle-state";
				entry-latency-us = <0x258>;
				exit-latency-us = <0x258>;
				min-residency-us = <0x4b0>;
				phandle = <0x7>;
			};

			sodi {
				arm,psci-suspend-param = <0x1010002>;
				compatible = "arm,idle-state";
				entry-latency-us = <0x320>;
				exit-latency-us = <0x3e8>;
				min-residency-us = <0x7d0>;
				phandle = <0x9>;
			};

			sodi3 {
				arm,psci-suspend-param = <0x1010003>;
				compatible = "arm,idle-state";
				entry-latency-us = <0x320>;
				exit-latency-us = <0x3e8>;
				min-residency-us = <0x7d0>;
				phandle = <0xa>;
			};

			standby {
				arm,psci-suspend-param = <0x1>;
				compatible = "arm,idle-state";
				entry-latency-us = <0x258>;
				exit-latency-us = <0x258>;
				min-residency-us = <0x4b0>;
				phandle = <0x6>;
			};

			suspend {
				arm,psci-suspend-param = <0x1010005>;
				compatible = "arm,idle-state";
				entry-latency-us = <0x320>;
				exit-latency-us = <0x3e8>;
				min-residency-us = <0x7d0>;
				phandle = <0xc>;
			};
		};
	};

	cq_dma@10212000 {
		clock-names = "cqdma";
		clocks = <0x25 0x43>;
		compatible = "mediatek,mt-cqdma-v1";
		interrupts = <0x0 0x71 0x8 0x0 0x72 0x8>;
		keep_clock_ao = "yes";
		nr_channel = <0x2>;
		reg = <0x0 0x10212000 0x0 0x80 0x0 0x10212080 0x0 0x80>;
	};

	dbg_apmcu_mp0@0d400000 {
		compatible = "mediatek,dbg_apmcu_mp0";
		reg = <0x0 0xd400000 0x0 0x1000>;
	};

	dbg_apmcu_mp0@0d410000 {
		compatible = "mediatek,dbg_apmcu_mp0";
		reg = <0x0 0xd410000 0x0 0x1000>;
	};

	dbg_apmcu_mp0@0d420000 {
		compatible = "mediatek,dbg_apmcu_mp0";
		reg = <0x0 0xd420000 0x0 0x1000>;
	};

	dbg_apmcu_mp0@0d430000 {
		compatible = "mediatek,dbg_apmcu_mp0";
		reg = <0x0 0xd430000 0x0 0x1000>;
	};

	dbg_apmcu_mp0@0d440000 {
		compatible = "mediatek,dbg_apmcu_mp0";
		reg = <0x0 0xd440000 0x0 0x1000>;
	};

	dbg_apmcu_mp0@0d510000 {
		compatible = "mediatek,dbg_apmcu_mp0";
		reg = <0x0 0xd510000 0x0 0x1000>;
	};

	dbg_apmcu_mp0@0d520000 {
		compatible = "mediatek,dbg_apmcu_mp0";
		reg = <0x0 0xd520000 0x0 0x1000>;
	};

	dbg_apmcu_mp0@0d530000 {
		compatible = "mediatek,dbg_apmcu_mp0";
		reg = <0x0 0xd530000 0x0 0x1000>;
	};

	dbg_apmcu_mp0@0d540000 {
		compatible = "mediatek,dbg_apmcu_mp0";
		reg = <0x0 0xd540000 0x0 0x1000>;
	};

	dbg_apmcu_mp0@0d610000 {
		compatible = "mediatek,dbg_apmcu_mp0";
		reg = <0x0 0xd610000 0x0 0x1000>;
	};

	dbg_apmcu_mp0@0d620000 {
		compatible = "mediatek,dbg_apmcu_mp0";
		reg = <0x0 0xd620000 0x0 0x1000>;
	};

	dbg_apmcu_mp0@0d630000 {
		compatible = "mediatek,dbg_apmcu_mp0";
		reg = <0x0 0xd630000 0x0 0x1000>;
	};

	dbg_apmcu_mp0@0d640000 {
		compatible = "mediatek,dbg_apmcu_mp0";
		reg = <0x0 0xd640000 0x0 0x1000>;
	};

	dbg_apmcu_mp0@0d710000 {
		compatible = "mediatek,dbg_apmcu_mp0";
		reg = <0x0 0xd710000 0x0 0x1000>;
	};

	dbg_apmcu_mp0@0d720000 {
		compatible = "mediatek,dbg_apmcu_mp0";
		reg = <0x0 0xd720000 0x0 0x1000>;
	};

	dbg_apmcu_mp0@0d730000 {
		compatible = "mediatek,dbg_apmcu_mp0";
		reg = <0x0 0xd730000 0x0 0x1000>;
	};

	dbg_apmcu_mp0@0d740000 {
		compatible = "mediatek,dbg_apmcu_mp0";
		reg = <0x0 0xd740000 0x0 0x1000>;
	};

	dbg_apmcu_mp1@0d800000 {
		compatible = "mediatek,dbg_apmcu_mp1";
		reg = <0x0 0xd800000 0x0 0x1000>;
	};

	dbg_apmcu_mp1@0d810000 {
		compatible = "mediatek,dbg_apmcu_mp1";
		reg = <0x0 0xd810000 0x0 0x1000>;
	};

	dbg_apmcu_mp1@0d820000 {
		compatible = "mediatek,dbg_apmcu_mp1";
		reg = <0x0 0xd820000 0x0 0x1000>;
	};

	dbg_apmcu_mp1@0d830000 {
		compatible = "mediatek,dbg_apmcu_mp1";
		reg = <0x0 0xd830000 0x0 0x1000>;
	};

	dbg_apmcu_mp1@0d840000 {
		compatible = "mediatek,dbg_apmcu_mp1";
		reg = <0x0 0xd840000 0x0 0x1000>;
	};

	dbg_apmcu_mp1@0d910000 {
		compatible = "mediatek,dbg_apmcu_mp1";
		reg = <0x0 0xd910000 0x0 0x1000>;
	};

	dbg_apmcu_mp1@0d920000 {
		compatible = "mediatek,dbg_apmcu_mp1";
		reg = <0x0 0xd920000 0x0 0x1000>;
	};

	dbg_apmcu_mp1@0d930000 {
		compatible = "mediatek,dbg_apmcu_mp1";
		reg = <0x0 0xd930000 0x0 0x1000>;
	};

	dbg_apmcu_mp1@0d940000 {
		compatible = "mediatek,dbg_apmcu_mp1";
		reg = <0x0 0xd940000 0x0 0x1000>;
	};

	dbg_apmcu_mp1@0da10000 {
		compatible = "mediatek,dbg_apmcu_mp1";
		reg = <0x0 0xda10000 0x0 0x1000>;
	};

	dbg_apmcu_mp1@0da20000 {
		compatible = "mediatek,dbg_apmcu_mp1";
		reg = <0x0 0xda20000 0x0 0x1000>;
	};

	dbg_apmcu_mp1@0da30000 {
		compatible = "mediatek,dbg_apmcu_mp1";
		reg = <0x0 0xda30000 0x0 0x1000>;
	};

	dbg_apmcu_mp1@0da40000 {
		compatible = "mediatek,dbg_apmcu_mp1";
		reg = <0x0 0xda40000 0x0 0x1000>;
	};

	dbg_apmcu_mp1@0db10000 {
		compatible = "mediatek,dbg_apmcu_mp1";
		reg = <0x0 0xdb10000 0x0 0x1000>;
	};

	dbg_apmcu_mp1@0db20000 {
		compatible = "mediatek,dbg_apmcu_mp1";
		reg = <0x0 0xdb20000 0x0 0x1000>;
	};

	dbg_apmcu_mp1@0db30000 {
		compatible = "mediatek,dbg_apmcu_mp1";
		reg = <0x0 0xdb30000 0x0 0x1000>;
	};

	dbg_apmcu_mp1@0db40000 {
		compatible = "mediatek,dbg_apmcu_mp1";
		reg = <0x0 0xdb40000 0x0 0x1000>;
	};

	dbg_cti@0d020000 {
		compatible = "mediatek,dbg_cti";
		reg = <0x0 0xd020000 0x0 0x10000>;
	};

	dbg_dem@0d0a0000 {
		compatible = "mediatek,dbg_dem";
		interrupts = <0x0 0x8c 0x8>;
		reg = <0x0 0xd0a0000 0x0 0x10000>;
	};

	dbg_etr@0d030000 {
		compatible = "mediatek,dbg_etr";
		reg = <0x0 0xd030000 0x0 0x10000>;
	};

	dbg_funnel@0d040000 {
		compatible = "mediatek,dbg_funnel";
		reg = <0x0 0xd040000 0x0 0x10000>;
	};

	dbg_mdsys1@0d0c0000 {
		compatible = "mediatek,dbg_mdsys1";
		reg = <0x0 0xd0c0000 0x0 0x40000>;
	};

	dcm@10001000 {
		compatible = "mediatek,mt6765-dcm";
		phandle = <0x6f>;
		reg = <0x0 0x10001000 0x0 0x1000 0x0 0x10200000 0x0 0x1000 0x0 0x10200000 0x0 0x1000 0x0 0x10200200 0x0 0x1000 0x0 0x10200400 0x0 0x1000 0x0 0x1022d000 0x0 0x1000 0x0 0x10235000 0x0 0x1000 0x0 0x10238000 0x0 0x1000 0x0 0x11220000 0x0 0x1000 0x0 0x11c50000 0x0 0x1000 0x0 0x13000000 0x0 0x1000 0x0 0x14000000 0x0 0x1000 0x0 0x14002000 0x0 0x1000 0x0 0x14003000 0x0 0x1000 0x0 0x15021000 0x0 0x1000 0x0 0x17010000 0x0 0x1000 0x0 0x17020000 0x0 0x1000 0x0 0x17030000 0x0 0x1000>;
		reg-names = "infracfg_ao", "mcucfg", "mp0_cpucfg", "mp1_cpucfg", "mcu_misccfg", "chn0_emi", "chn1_emi", "gce", "audio", "efusec", "mfgcfg", "mmsys_config", "smi_common", "smi_larb0", "smi_larb2", "smi_larb1", "venc", "jpgenc";
	};

	ddrphy@10015000 {
		compatible = "mediatek,ddrphy";
		reg = <0x0 0x10015000 0x0 0x1000>;
	};

	ddrphy@1001e000 {
		compatible = "mediatek,ddrphy";
		reg = <0x0 0x1001e000 0x0 0x1000>;
	};

	dev_ril_bridge_pdata {
		compatible = "samsung,dev_ril_bridge_pdata";
		status = "okay";
	};

	devapc@10207000 {
		clock-names = "devapc-infra-clock";
		clocks = <0x25 0x28>;
		compatible = "mediatek,devapc";
		interrupts = <0x0 0x8e 0x8>;
		reg = <0x0 0x10207000 0x0 0x1000>;
	};

	dfd@10200b00 {
		compatible = "mediatek,dfd";
		mediatek,chain_length = <0xc350>;
		mediatek,check_dfd_support = <0x1>;
		mediatek,dfd_ap_addr_offset = <0x18>;
		mediatek,dfd_infra_base = <0x390>;
		mediatek,dfd_latch_offset = <0x48>;
		mediatek,enabled = <0x1>;
		mediatek,rg_dfd_timeout = <0xa0>;
		reg = <0x0 0x10200b00 0x0 0x10000>;
		reg_base = <0x48>;
	};

	dip1@15022000 {
		compatible = "mediatek,dip1";
		interrupts = <0x0 0xff 0x8>;
		reg = <0x0 0x15022000 0x0 0x3000>;
	};

	disp_aal0@14011000 {
		compatible = "mediatek,disp_aal0";
		interrupts = <0x0 0xde 0x8>;
		reg = <0x0 0x14011000 0x0 0x1000>;
	};

	disp_ccorr0@14010000 {
		compatible = "mediatek,disp_ccorr0";
		interrupts = <0x0 0xdd 0x8>;
		reg = <0x0 0x14010000 0x0 0x1000>;
	};

	disp_color0@1400f000 {
		clock-names = "MDP_COLOR";
		clocks = <0x63 0xc>;
		compatible = "mediatek,disp_color0";
		interrupts = <0x0 0xdc 0x8>;
		phandle = <0x43>;
		reg = <0x0 0x1400f000 0x0 0x1000>;
	};

	disp_dither0@14013000 {
		compatible = "mediatek,disp_dither0";
		interrupts = <0x0 0xe0 0x8>;
		reg = <0x0 0x14013000 0x0 0x1000>;
	};

	disp_gamma0@14012000 {
		compatible = "mediatek,disp_gamma0";
		interrupts = <0x0 0xdf 0x8>;
		reg = <0x0 0x14012000 0x0 0x1000>;
	};

	disp_mutex0@14001000 {
		compatible = "mediatek,disp_mutex0";
		interrupts = <0x0 0xd2 0x8>;
		phandle = <0x45>;
		reg = <0x0 0x14001000 0x0 0x1000>;
	};

	disp_ovl0@1400b000 {
		compatible = "mediatek,disp_ovl0";
		interrupts = <0x0 0xd9 0x8>;
		reg = <0x0 0x1400b000 0x0 0x1000>;
	};

	disp_ovl0_2l@1400c000 {
		compatible = "mediatek,disp_ovl0_2l";
		interrupts = <0x0 0xe5 0x8>;
		reg = <0x0 0x1400c000 0x0 0x1000>;
	};

	disp_pwm@1100e000 {
		compatible = "mediatek,disp_pwm";
		reg = <0x0 0x1100e000 0x0 0x1000>;
	};

	disp_rdma0@1400d000 {
		compatible = "mediatek,disp_rdma0";
		interrupts = <0x0 0xda 0x8>;
		reg = <0x0 0x1400d000 0x0 0x1000>;
	};

	disp_rsz0@14015000 {
		compatible = "mediatek,disp_rsz0";
		interrupts = <0x0 0x114 0x8>;
		reg = <0x0 0x14015000 0x0 0x1000>;
	};

	disp_wdma0@1400e000 {
		compatible = "mediatek,disp_wdma0";
		interrupts = <0x0 0xdb 0x8>;
		reg = <0x0 0x1400e000 0x0 0x1000>;
	};

	dispsys {
		clock-names = "MMSYS_MTCMOS", "MMSYS_SMI_COMMON", "MMSYS_SMI_LARB0", "MMSYS_GALS_COMM0", "MMSYS_GALS_COMM1", "MMSYS_DISP_OVL0", "MMSYS_DISP_OVL0_2L", "MMSYS_DISP_RDMA0", "MMSYS_DISP_WDMA0", "MMSYS_DISP_COLOR0", "MMSYS_DISP_CCORR0", "MMSYS_DISP_AAL0", "MMSYS_DISP_GAMMA0", "MMSYS_DISP_DITHER0", "MMSYS_DSI0_MM_CK", "MMSYS_DSI0_IF_CK", "MMSYS_26M", "MMSYS_DISP_RSZ0", "APMIXED_MIPI_26M", "TOP_MUX_DISP_PWM", "DISP_PWM", "TOP_26M", "TOP_UNIVPLL2_D4", "TOP_ULPOSC1_D2", "TOP_ULPOSC1_D8";
		clocks = <0x35 0x3 0x63 0x13 0x63 0x14 0x63 0x15 0x63 0x16 0x63 0x7 0x63 0x8 0x63 0xa 0x63 0xb 0x63 0xc 0x63 0xd 0x63 0xe 0x63 0xf 0x63 0x10 0x63 0x11 0x63 0x1c 0x63 0x1d 0x63 0x9 0x3 0x15 0x26 0x73 0x25 0x31 0x24 0x26 0x1b 0x26 0x2e 0x26 0x30>;
		compatible = "mediatek,dispsys";
	};

	dispsys_config@14000000 {
		clock-names = "CAM_MDP", "IMG_DL_RELAY", "IMG_DL_ASYNC_TOP";
		clocks = <0x63 0x17 0x63 0x1a 0x63 0x1b>;
		compatible = "mediatek,mmsys_config", "syscon";
		interrupts = <0x0 0xab 0x8>;
		phandle = <0x3c>;
		reg = <0x0 0x14000000 0x0 0x1000>;
	};

	dma-controller@11000580 {
		#dma-cells = <0x1>;
		clock-names = "apdma";
		clocks = <0x25 0x26>;
		compatible = "mediatek,mt6577-uart-dma";
		dma-requests = <0x4>;
		interrupts = <0x0 0x6d 0x8 0x0 0x6e 0x8 0x0 0x6f 0x8 0x0 0x74 0x8>;
		phandle = <0x49>;
		reg = <0x0 0x11000680 0x0 0x80 0x0 0x11000700 0x0 0x80 0x0 0x11000780 0x0 0x80 0x0 0x11000800 0x0 0x80>;
	};

	dpe@15028000 {
		clock-names = "DPE_CG_IMG_DPE";
		clocks = <0x64 0x3>;
		compatible = "mediatek,dpe";
		interrupts = <0x0 0x100 0x8>;
		reg = <0x0 0x15028000 0x0 0x1000>;
	};

	dram_ctrl {
		compatible = "mediatek,dram-qosctrl";
		required-opps = <0x31 0x32>;
	};

	dramc0@1001d000 {
		compatible = "mediatek,dramc0";
		reg = <0x0 0x1001d000 0x0 0x1000>;
	};

	dramc@1022a000 {
		compatible = "mediatek,dramc";
		reg = <0x0 0x1022a000 0x0 0x2000 0x0 0x10232000 0x0 0x2000 0x0 0x1022c000 0x0 0x1000 0x0 0x10234000 0x0 0x1000 0x0 0x10228000 0x0 0x2000 0x0 0x10230000 0x0 0x2000 0x0 0x1022e000 0x0 0x1000 0x0 0x10236000 0x0 0x1000>;
	};

	dramc_nao@1021d000 {
		compatible = "mediatek,dramc_nao";
		reg = <0x0 0x1021d000 0x0 0x1000>;
	};

	dsi0@14014000 {
		compatible = "mediatek,dsi0";
		interrupts = <0x0 0xe1 0x8>;
		reg = <0x0 0x14014000 0x0 0x1000>;
	};

	dsi_te {
		compatible = "mediatek, DSI_TE-eint";
		phandle = <0xd5>;
		status = "disabled";
	};

	dvfsp@00110800 {
		B-table = <0x898 0x64 0x1 0x1 0x855 0x60 0x1 0x1 0x812 0x5c 0x1 0x1 0x7d0 0x58 0x1 0x1 0x78d 0x54 0x1 0x1 0x74a 0x50 0x1 0x1 0x708 0x4b 0x1 0x1 0x673 0x46 0x1 0x1 0x5df 0x40 0x1 0x1 0x586 0x3d 0x2 0x1 0x50f 0x39 0x2 0x1 0x498 0x35 0x2 0x1 0x43f 0x31 0x2 0x1 0x3e6 0x2e 0x2 0x1 0x38d 0x2b 0x2 0x1 0x352 0x28 0x2 0x1>;
		CCI-table = <0x578 0x60 0x2 0x1 0x549 0x5c 0x2 0x1 0x51a 0x58 0x2 0x1 0x4ec 0x54 0x2 0x1 0x4a6 0x4e 0x2 0x1 0x483 0x4b 0x2 0x1 0x460 0x47 0x2 0x1 0x3d8 0x40 0x2 0x1 0x395 0x3e 0x2 0x1 0x33b 0x3a 0x2 0x1 0x2e1 0x36 0x2 0x2 0x29d 0x33 0x2 0x2 0x243 0x2f 0x2 0x2 0x200 0x2c 0x2 0x2 0x1bd 0x29 0x2 0x2 0x190 0x26 0x2 0x2>;
		L-table = <0x7d0 0x60 0x1 0x1 0x78d 0x5c 0x1 0x1 0x74a 0x58 0x1 0x1 0x708 0x53 0x1 0x1 0x6c5 0x50 0x1 0x1 0x682 0x4b 0x1 0x1 0x60c 0x47 0x1 0x1 0x5c3 0x42 0x2 0x1 0x55f 0x40 0x2 0x1 0x4fb 0x3a 0x2 0x1 0x497 0x36 0x2 0x1 0x433 0x31 0x2 0x1 0x3e7 0x2e 0x2 0x1 0x39d 0x2b 0x2 0x1 0x352 0x28 0x2 0x1 0x306 0x26 0x2 0x1>;
		big-down-time = <0x2ee>;
		big-rise-time = <0x3e8>;
		change_flag = <0x0>;
		compatible = "mediatek,mt6765-dvfsp";
		little-down-time = <0x2ee>;
		little-rise-time = <0x3e8>;
		nvmem-cell-names = "efuse_segment_cell", "efuse_ly_cell";
		nvmem-cells = <0x39 0x3a>;
		reg = <0x0 0x110800 0x0 0x1400 0x0 0x110800 0x0 0x1400>;
		state = <0x1>;
	};

	dvfsp@10227000 {
		compatible = "mediatek,dvfsp";
		reg = <0x0 0x10227000 0x0 0x1000>;
	};

	dvfsrc@10012000 {
		#address-cells = <0x2>;
		#size-cells = <0x2>;
		compatible = "mediatek,mt6765-dvfsrc";
		phandle = <0xa2>;
		ranges;
		reg = <0x0 0x10012000 0x0 0x1000 0x0 0x10006000 0x0 0x1000>;
		reg-names = "dvfsrc", "spm";

		dvfsrc-debug {
			compatible = "mediatek,mt6765-dvfsrc-debug";
			required-opps = <0x31 0x32 0x33>;
		};

		dvfsrc-met {
			compatible = "mediatek,mt6765-dvfsrc-met";
		};

		dvfsrc-up {
			compatible = "mediatek,mt6765-dvfsrc-up";
		};

		opp0 {
			opp-level = <0x0>;
			phandle = <0x31>;
		};

		opp1 {
			opp-level = <0x1>;
			phandle = <0x32>;
		};

		opp2 {
			opp-level = <0x2>;
			phandle = <0x33>;
		};

		qos@00110780 {
			compatible = "mediatek,mt6765-qos";
			reg = <0x0 0x110780 0x0 0x80>;
		};
	};

	dxcc_sec@10210000 {
		compatible = "mediatek,dxcc_sec";
		interrupts = <0x0 0xa2 0x4>;
		reg = <0x0 0x10210000 0x0 0x1000>;
	};

	dynamic_options {
		compatible = "mediatek,dynamic_options";
		phandle = <0xef>;
	};

	eas {
		eff_turn_point = <0x1d3>;
		tiny = <0x32>;
	};

	eem_fsm@1100b000 {
		compatible = "mediatek,eem_fsm";
		interrupts = <0x0 0x7d 0x8>;
		nvmem = <0x3b>;
		nvmem-cell-names = "efuse_segment_cell";
		nvmem-cells = <0x39>;
		nvmem-names = "mtk_efuse";
		reg = <0x0 0x1100b000 0x0 0x1000>;
	};

	efuse@11c50000 {
		#address-cells = <0x1>;
		#size-cells = <0x1>;
		compatible = "mediatek,devinfo";
		phandle = <0x3b>;
		reg = <0x0 0x11c50000 0x0 0x10000>;

		ly@210 {
			phandle = <0x3a>;
			reg = <0x210 0x4>;
		};

		segment@190 {
			phandle = <0x4b>;
			reg = <0x190 0xc>;
		};

		segment@1c {
			phandle = <0x4a>;
			reg = <0x1c 0x4>;
		};

		segment@78 {
			phandle = <0x39>;
			reg = <0x78 0x4>;
		};

		u2_phy_data@1ac {
			phandle = <0x50>;
			reg = <0x1ac 0x4>;
		};
	};

	efuse_dbg@10004000 {
		compatible = "mediatek,efuse_dbg";
		reg = <0x0 0x10004000 0x0 0x1000>;
	};

	eint@1000b000 {
		compatible = "mediatek,eint";
		phandle = <0x72>;
		reg = <0x0 0x1000b000 0x0 0x1000>;
	};

	emi@10219000 {
		compatible = "mediatek,emi";
		interrupts = <0x0 0x90 0x8>;
		reg = <0x0 0x10219000 0x0 0x1000 0x0 0x10226000 0x0 0x1000 0x0 0x1022d000 0x0 0x1000 0x0 0x10235000 0x0 0x1000>;
	};

	extcon_usb {
		charger = <0x29>;
		compatible = "mediatek,extcon-usb";
		dev-conn = <0x6a>;
		mediatek,bypss-typec-sink = <0x1>;
		phandle = <0xe7>;
		vbus-current = <0x13d620>;
		vbus-supply = <0x69>;
		vbus-voltage = <0x4c4b40>;
	};

	fdvt@1502b000 {
		clock-names = "FD_CLK_IMG_FDVT";
		clocks = <0x64 0x2>;
		compatible = "mediatek,fdvt";
		interrupts = <0x0 0x102 0x8>;
		reg = <0x0 0x1502b000 0x0 0x1000>;
	};

	fhctl@1000ce00 {
		compatible = "mediatek,mt6765-fhctl";
		mediatek,apmixed = <0x3>;
		reg = <0x0 0x1000ce00 0x0 0x100>;

		armpll {
			mediatek,fh-cpu-pll;
			mediatek,fh-id = <0x0>;
			mediatek,fh-pll-id = <0x1>;
		};

		armpll_l {
			mediatek,fh-cpu-pll;
			mediatek,fh-id = <0x7>;
			mediatek,fh-pll-id = <0x0>;
		};

		mainpll {
			mediatek,fh-id = <0x1>;
			mediatek,fh-pll-id = <0x3>;
		};

		mfgpll {
			mediatek,fh-id = <0x3>;
			mediatek,fh-pll-id = <0x4>;
		};

		mmpll {
			mediatek,fh-id = <0x6>;
			mediatek,fh-pll-id = <0x5>;
		};

		mpll {
			mediatek,fh-id = <0x5>;
			mediatek,fh-pll-id = <0x9>;
		};

		msdcpll {
			mediatek,fh-id = <0x2>;
			mediatek,fh-pll-id = <0x7>;
		};
	};

	flashlight_core {
		compatible = "mediatek,flashlight_core";
		phandle = <0xdd>;
	};

	flashlights_aw36518 {
		compatible = "mediatek,flashlights_aw36518";
		decouple = <0x1>;
		phandle = <0xdf>;

		channel@1 {
			ct = <0x0>;
			part = <0x0>;
			type = <0x0>;
		};
	};

	flashlights_mt6370 {
		compatible = "mediatek,flashlights_mt6370";
		decouple = <0x1>;
		phandle = <0xde>;

		channel@1 {
			ct = <0x0>;
			part = <0x0>;
			type = <0x0>;
		};
	};

	flashlights_sgm3785_gpio {
		compatible = "mediatek,flashlights_sgm3785_gpio";
		decouple = <0x1>;
		phandle = <0xe0>;

		channel@1 {
			ct = <0x0>;
			part = <0x0>;
			type = <0x0>;
		};
	};

	fp_egistec {
		compatible = "fp-egistec";
		phandle = <0x9f>;
	};

	fpsensor_finger {
		compatible = "mediatek,fpsensor";
		phandle = <0xa0>;
	};

	gce@10238000 {
		ap_dma_base = <0x18010000 0x17 0xffff0000>;
		audio_base = <0x17000000 0x12 0xffff0000>;
		buf_underrun_event_0 = <0x8c>;
		camsys1_base = <0x180a0000 0x1c 0xffff0000>;
		camsys2_base = <0x180b0000 0x1d 0xffff0000>;
		camsys_base = <0x18080000 0x1b 0xffff0000>;
		clock-names = "GCE", "GCE_TIMER";
		clocks = <0x25 0x9 0x25 0x18>;
		compatible = "mediatek,gce", "syscon";
		conn_peri_base = <0x18820000 0x7 0xffff0000>;
		dip_cq_thread0_frame_done = <0x101>;
		dip_cq_thread10_frame_done = <0x10b>;
		dip_cq_thread11_frame_done = <0x10c>;
		dip_cq_thread12_frame_done = <0x10d>;
		dip_cq_thread13_frame_done = <0x10e>;
		dip_cq_thread14_frame_done = <0x10f>;
		dip_cq_thread15_frame_done = <0x110>;
		dip_cq_thread16_frame_done = <0x111>;
		dip_cq_thread17_frame_done = <0x112>;
		dip_cq_thread18_frame_done = <0x113>;
		dip_cq_thread1_frame_done = <0x102>;
		dip_cq_thread2_frame_done = <0x103>;
		dip_cq_thread3_frame_done = <0x104>;
		dip_cq_thread4_frame_done = <0x105>;
		dip_cq_thread5_frame_done = <0x106>;
		dip_cq_thread6_frame_done = <0x107>;
		dip_cq_thread7_frame_done = <0x108>;
		dip_cq_thread8_frame_done = <0x109>;
		dip_cq_thread9_frame_done = <0x10a>;
		disp_2l_ovl0_frame_done = <0x1c>;
		disp_2l_ovl0_sof = <0x8>;
		disp_aal0_frame_done = <0x22>;
		disp_aal0_sof = <0xd>;
		disp_ccorr0_frame_done = <0x21>;
		disp_ccorr0_sof = <0xc>;
		disp_color0_frame_done = <0x20>;
		disp_color0_sof = <0xb>;
		disp_dither0_frame_done = <0x24>;
		disp_dither0_sof = <0xf>;
		disp_dither_base = <0x14010000 0x2 0xffff0000>;
		disp_dsi0_frame_done = <0x25>;
		disp_dsi0_sof = <0x10>;
		disp_gamma0_frame_done = <0x23>;
		disp_gamma0_sof = <0xe>;
		disp_ovl0_frame_done = <0x1b>;
		disp_ovl0_frame_rst_done_pusle = <0x98>;
		disp_ovl0_sof = <0x7>;
		disp_pwm0_sof = <0x13>;
		disp_rdma0_frame_done = <0x1e>;
		disp_rdma0_sof = <0x9>;
		disp_rsz0_frame_done = <0x1d>;
		disp_rsz0_sof = <0x11>;
		disp_wdma0_frame_done = <0x1f>;
		disp_wdma0_rst_done = <0x93>;
		disp_wdma0_sof = <0xa>;
		dsi0_done_event = <0x8f>;
		dsi0_irq_event = <0x8e>;
		dsi0_te_event = <0x8d>;
		dve_frame_done = <0x114>;
		g3d_config_base = <0x13000000 0x0 0xffff0000>;
		gce_base = <0x18020000 0x18 0xffff0000>;
		gcpu_base = <0x10050000 0xf 0xffff0000>;
		img_dl_relay_sof = <0x12>;
		imgsys_base = <0x15020000 0x4 0xffff0000>;
		infra_na3_base = <0x10010000 0xb 0xffff0000>;
		infra_na4_base = <0x10020000 0xc 0xffff0000>;
		interrupts = <0x0 0x9a 0x8 0x0 0x9b 0x8>;
		jpgdec_done = <0x123>;
		jpgenc_done = <0x122>;
		kp_base = <0x18840000 0x9 0xffff0000>;
		max_prefetch_cnt = <0x1>;
		mboxes = <0x46 0x0 0x0 0x4 0x46 0x1 0x0 0x4 0x46 0x2 0x0 0x5 0x46 0x3 0x0 0x4 0x46 0x4 0x0 0x4 0x46 0x5 0x0 0x4 0x46 0x6 0x0 0x4 0x46 0x7 0xffffffff 0x2 0x47 0x8 0x0 0x4 0x47 0x9 0x0 0x4 0x47 0xa 0x0 0x1 0x46 0xb 0x0 0x1 0x46 0xc 0x0 0x1 0x46 0xd 0x0 0x1 0x46 0xe 0x0 0x1 0x46 0xf 0xffffffff 0x1>;
		mcucfg_base = <0x10040000 0xe 0xffff0000>;
		mdp_ccorr0 = <0x44>;
		mdp_ccorr0_frame_done = <0x15>;
		mdp_ccorr0_sof = <0x1>;
		mdp_color0 = <0x43>;
		mdp_rdma0 = <0x3d>;
		mdp_rdma0_frame_done = <0x14>;
		mdp_rdma0_rst_done = <0x97>;
		mdp_rdma0_sof = <0x0>;
		mdp_rsz0 = <0x3e>;
		mdp_rsz0_frame_done = <0x16>;
		mdp_rsz0_sof = <0x2>;
		mdp_rsz1 = <0x3f>;
		mdp_rsz1_frame_done = <0x17>;
		mdp_rsz1_sof = <0x3>;
		mdp_tdshp0 = <0x42>;
		mdp_tdshp0_frame_done = <0x1a>;
		mdp_tdshp0_sof = <0x6>;
		mdp_wdma0 = <0x40>;
		mdp_wdma_frame_done = <0x19>;
		mdp_wdma_rst_done = <0x94>;
		mdp_wdma_sof = <0x4>;
		mdp_wrot0 = <0x41>;
		mdp_wrot0_rst_done = <0x95>;
		mdp_wrot0_sof = <0x5>;
		mdp_wrot0_write_frame_done = <0x18>;
		mediatek,mailbox-gce = <0x46>;
		mipitx0_base = <0x11c80000 0x63 0xffff0000>;
		mm_mutex = <0x45>;
		mm_na_base = <0x14020000 0x3 0xffff0000>;
		mmsys_config = <0x3c>;
		mmsys_config_base = <0x14000000 0x1 0xffff0000>;
		msdc2_base = <0x17020000 0x14 0xffff0000>;
		msdc3_base = <0x18000000 0x16 0xffff0000>;
		phandle = <0xa7>;
		prefetch_size = <0x60>;
		pwm_sw_base = <0x1100e000 0x63 0xffff0000>;
		reg = <0x0 0x10238000 0x0 0x4000>;
		rsc_frame_done = <0x116>;
		scp_base = <0x10030000 0xd 0xffff0000>;
		scp_sram_base = <0x10000000 0xa 0xffff0000>;
		sram_share_cnt = <0x1>;
		sram_share_engine = <0xa>;
		sram_share_event = <0x2c6>;
		sram_size_cpr_64 = <0x40>;
		stream_done_0 = <0x82>;
		stream_done_1 = <0x83>;
		stream_done_2 = <0x84>;
		stream_done_3 = <0x85>;
		stream_done_4 = <0x86>;
		stream_done_5 = <0x87>;
		stream_done_6 = <0x88>;
		stream_done_7 = <0x89>;
		stream_done_8 = <0x8a>;
		stream_done_9 = <0x8b>;
		topckgen_base = <0x18830000 0x8 0xffff0000>;
		usb0_base = <0x10200000 0x10 0xffff0000>;
		usb_sif_base = <0x10280000 0x11 0xffff0000>;
		vdec1_base = <0x17030000 0x15 0xffff0000>;
		vdec2_base = <0x18040000 0x19 0xffff0000>;
		vdec3_base = <0x18050000 0x1a 0xffff0000>;
		vdec_base = <0x17010000 0x13 0xffff0000>;
		vdec_gcon_base = <0x18800000 0x5 0xffff0000>;
		venc_128byte_cnt_done = <0x125>;
		venc_done = <0x121>;
		venc_gcon_base = <0x18810000 0x6 0xffff0000>;
		venc_mb_done = <0x124>;
		wmf_frame_done = <0x115>;
	};

	gce_mbox@10238000 {
		#gce-event-cells = <0x1>;
		#gce-subsys-cells = <0x2>;
		#mbox-cells = <0x3>;
		clock-names = "gce", "gce-timer";
		clocks = <0x25 0x9 0x25 0x18>;
		compatible = "mediatek,mt6761-gce";
		default_tokens = [02 bc 02 bd 02 be 02 bf 02 c0 02 c6 02 c7];
		interrupts = <0x0 0x9a 0x8 0x0 0x9b 0x8>;
		phandle = <0x46>;
		reg = <0x0 0x10238000 0x0 0x4000>;
	};

	gce_mbox_svp@10238000 {
		#mbox-cells = <0x3>;
		clock-names = "gce", "GCE_TIMER";
		clocks = <0x25 0x9 0x25 0x18>;
		compatible = "mediatek,mailbox-gce-svp";
		interrupts = <0x0 0x9a 0x8 0x0 0x9b 0x8>;
		phandle = <0x47>;
		reg = <0x0 0x10238000 0x0 0x4000>;
	};

	ged {
		compatible = "mediatek,ged";
		gpufreq-supply = <0x61>;
		phandle = <0x60>;
	};

	gic500@0c000000 {
		compatible = "mediatek,gic500";
		reg = <0x0 0xc000000 0x0 0x1000>;
	};

	gic_cpu@0c400000 {
		compatible = "mediatek,gic_cpu";
		reg = <0x0 0xc400000 0x0 0x40000>;
	};

	gpio {
		compatible = "mediatek,gpio_usage_mapping";
		phandle = <0x71>;
	};

	gpio@10005000 {
		compatible = "mediatek,gpio", "syscon";
		phandle = <0x17>;
		reg = <0x0 0x10005000 0x0 0x1000>;
	};

	gps {
		compatible = "mediatek,gps";
	};

	gpufreq {
		clock-names = "clk_mux", "clk_main_parent", "clk_sub_parent", "mtcmos_mfg_async", "mtcmos_mfg", "mtcmos_mfg_core0";
		clocks = <0x26 0x64 0x26 0x26 0x24 0x35 0x8 0x35 0x4 0x35 0x7>;
		compatible = "mediatek,mt6765-gpufreq";
		nvmem-cell-names = "efuse_segment_cell";
		nvmem-cells = <0x39>;
		phandle = <0x61>;
		vcore-supply = <0x37>;
	};

	hacc@1000a000 {
		compatible = "mediatek,hacc";
		interrupts = <0x0 0xbd 0x8>;
		reg = <0x0 0x1000a000 0x0 0x1000>;
	};

	hwrng {
		compatible = "mediatek,mt67xx-rng";
		phandle = <0x75>;
	};

	i2c-gpio@0 {
		phandle = <0xf5>;
	};

	i2c0@11007000 {
		aed = <0x1a>;
		clock-div = <0x5>;
		clock-names = "main", "dma";
		clocks = <0x25 0xb 0x25 0x26>;
		compatible = "mediatek,i2c";
		eh_cfg = <0x20>;
		gpio_start = <0x10002a00>;
		id = <0x0>;
		interrupts = <0x0 0x54 0x8>;
		mediatek,hs_only;
		mem_len = <0x200>;
		phandle = <0xab>;
		pu_cfg = <0x50>;
		reg = <0x0 0x11007000 0x0 0x1000 0x0 0x11000080 0x0 0x80>;
		rsel_cfg = <0x70>;
		scl-gpio-id = <0x53>;
		sda-gpio-id = <0x52>;
	};

	i2c1@11008000 {
		aed = <0x1a>;
		clock-div = <0x5>;
		clock-names = "main", "dma";
		clocks = <0x25 0xb 0x25 0x26>;
		compatible = "mediatek,i2c";
		eh_cfg = <0x20>;
		gpio_start = <0x10002a00>;
		id = <0x1>;
		interrupts = <0x0 0x55 0x8>;
		mediatek,hs_only;
		mem_len = <0x200>;
		phandle = <0xac>;
		pu_cfg = <0x50>;
		reg = <0x0 0x11008000 0x0 0x1000 0x0 0x11000100 0x0 0x80>;
		rsel_cfg = <0x70>;
		scl-gpio-id = <0x54>;
		sda-gpio-id = <0x51>;
	};

	i2c2@11009000 {
		aed = <0x1a>;
		ch_offset_ccu = <0x200>;
		ch_offset_default = <0x100>;
		clock-div = <0x5>;
		clock-names = "main", "dma";
		clocks = <0x25 0xb 0x25 0x26>;
		compatible = "mediatek,i2c";
		eh_cfg = <0x20>;
		gpio_start = <0x10002800>;
		id = <0x2>;
		interrupts = <0x0 0x56 0x8>;
		mediatek,hs_only;
		mem_len = <0x200>;
		phandle = <0xad>;
		pu_cfg = <0x60>;
		reg = <0x0 0x11009000 0x0 0x1000 0x0 0x11000180 0x0 0x180>;
		rsel_cfg = <0xa0>;
		scl-gpio-id = <0x67>;
		sda-gpio-id = <0x68>;
	};

	i2c3@1100f000 {
		aed = <0x1a>;
		ch_offset_default = <0x100>;
		clock-div = <0x5>;
		clock-names = "main", "dma";
		clocks = <0x25 0xb 0x25 0x26>;
		compatible = "mediatek,i2c";
		eh_cfg = <0x20>;
		gpio_start = <0x10002600>;
		id = <0x3>;
		interrupts = <0x0 0x57 0x8>;
		mediatek,hs_only;
		mem_len = <0x200>;
		phandle = <0xae>;
		pu_cfg = <0x90>;
		reg = <0x0 0x1100f000 0x0 0x1000 0x0 0x11000300 0x0 0x100>;
		rsel_cfg = <0xb0>;
		scl-gpio-id = <0x32>;
		sda-gpio-id = <0x33>;
	};

	i2c4@11011000 {
		aed = <0x1a>;
		ch_offset_ccu = <0x200>;
		ch_offset_default = <0x100>;
		clock-div = <0x5>;
		clock-names = "main", "dma";
		clocks = <0x25 0xb 0x25 0x26>;
		compatible = "mediatek,i2c";
		eh_cfg = <0x20>;
		gpio_start = <0x10002800>;
		id = <0x4>;
		interrupts = <0x0 0x58 0x8>;
		mediatek,hs_only;
		mem_len = <0x200>;
		phandle = <0xaf>;
		pu_cfg = <0x60>;
		reg = <0x0 0x11011000 0x0 0x1000 0x0 0x11000400 0x0 0x180>;
		rsel_cfg = <0xa0>;
		scl-gpio-id = <0x69>;
		sda-gpio-id = <0x6a>;
	};

	i2c5@11016000 {
		aed = <0x1a>;
		clock-div = <0x5>;
		clock-frequency = <0x61a80>;
		clock-names = "main", "dma";
		clocks = <0x25 0xb 0x25 0x26>;
		compatible = "mediatek,i2c";
		eh_cfg = <0x20>;
		gpio_start = <0x10002600>;
		id = <0x5>;
		interrupts = <0x0 0x82 0x8>;
		mediatek,hs_only;
		mem_len = <0x200>;
		phandle = <0xb0>;
		pu_cfg = <0x90>;
		reg = <0x0 0x11016000 0x0 0x1000 0x0 0x11000580 0x0 0x80>;
		rsel_cfg = <0xb0>;
		scl-gpio-id = <0x30>;
		sda-gpio-id = <0x31>;

		fusb301@21 {
			compatible = "mediatek,fusb301";
			fusb301a,drp-toggle-time = <0x0>;
			fusb301a,host-current = <0x1>;
			fusb301a,init-mode = <0x20>;
			fusb301a,irq-gpio = <0x1f 0x6b 0x0>;
			interrupt-name = "fusb301a_int_irq";
			interrupt-parent = <0x1f>;
			interrupts = <0x6b 0x0>;
			phandle = <0xb3>;
			reg = <0x21>;
			status = "okay";
		};

		sgm7220@47 {
			compatible = "sgm,sgm7220";
			debounce = <0x6b 0x0>;
			interrupt-name = "sgm7220_int_irq";
			interrupt-parent = <0x1f>;
			interrupts = <0x6b 0x0>;
			phandle = <0xb2>;
			reg = <0x47>;
			sgm7220,irq_gpio = <0x1f 0x6b 0x0>;
			status = "okay";
		};

		wusb3801@60 {
			compatible = "will,wusb3801";
			interrupt-name = "wusb3801_int_irq";
			interrupt-parent = <0x1f>;
			interrupts = <0x6b 0x0>;
			phandle = <0xb1>;
			reg = <0x60>;
			status = "okay";
			wusb3801,drp-toggle-time = <0x0>;
			wusb3801,host-current = <0x1>;
			wusb3801,init-mode = <0x20>;
			wusb3801,irq-gpio = <0x1f 0x6b 0x0>;
		};
	};

	i2c6@1100d000 {
		aed = <0x1a>;
		ch_offset_ccu = <0x200>;
		ch_offset_default = <0x100>;
		clock-div = <0x5>;
		clock-names = "main", "dma";
		clocks = <0x25 0xb 0x25 0x26>;
		compatible = "mediatek,i2c";
		eh_cfg = <0x20>;
		gpio_start = <0x10002c00>;
		id = <0x6>;
		interrupts = <0x0 0x83 0x8>;
		mediatek,hs_only;
		mem_len = <0x200>;
		phandle = <0xb4>;
		pu_cfg = <0x50>;
		reg = <0x0 0x1100d000 0x0 0x1000 0x0 0x11000600 0x0 0x80>;
		rsel_cfg = <0x70>;
		scl-gpio-id = <0xa1>;
		sda-gpio-id = <0xa2>;
	};

	i2c7 {
		phandle = <0xf2>;
	};

	i2c8 {
		phandle = <0xf3>;
	};

	i2c9 {
		phandle = <0xf4>;
	};

	i2c_common {
		check_max_freq = [01];
		cnt_constraint = [01];
		compatible = "mediatek,i2c_common";
		dma_support = [02];
		ext_time_config = [18 01];
		idvfs = [01];
		phandle = <0xaa>;
		set_dt_div = [01];
		set_ltiming = [01];
		ver = [02];
	};

	imgsys@15020000 {
		clock-names = "ISP_SCP_SYS_DIS", "ISP_SCP_SYS_ISP", "ISP_SCP_SYS_CAM", "ISP_CLK_IMG_DIP", "ISP_CLK_CAM", "ISP_CLK_CAMTG", "ISP_CLK_CAMSV0", "ISP_CLK_CAMSV1", "ISP_CLK_CAMSV2";
		clocks = <0x35 0x3 0x35 0x5 0x35 0x9 0x64 0x1 0x65 0x2 0x65 0x3 0x65 0x5 0x65 0x6 0x65 0x7>;
		compatible = "mediatek,imgsys", "syscon";
		reg = <0x0 0x15020000 0x0 0x1000>;
	};

	imgsys_clk@15020000 {
		#clock-cells = <0x1>;
		compatible = "mediatek,mt6765-imgsys", "syscon";
		phandle = <0x64>;
		pwr-regmap = <0x62>;
		reg = <0x0 0x15020000 0x0 0x1000>;
	};

	imp_iic@11017000 {
		compatible = "mediatek,imp_iic";
		reg = <0x0 0x11017000 0x0 0x1000>;
	};

	infra_mbist@1020d000 {
		compatible = "mediatek,infra_mbist";
		reg = <0x0 0x1020d000 0x0 0x1000>;
	};

	infracfg@1020e000 {
		compatible = "mediatek,infracfg";
		reg = <0x0 0x1020e000 0x0 0x1000>;
	};

	infracfg_ao@10001000 {
		#clock-cells = <0x1>;
		compatible = "mediatek,common-infracfg_ao", "mediatek,infracfg_ao", "mediatek,mt6765-infracfg", "syscon";
		interrupts = <0x0 0x93 0x1>;
		phandle = <0x25>;
		reg = <0x0 0x10001000 0x0 0x1000>;
	};

	input_booster {
		#address-cells = <0x1>;
		#size-cells = <0x0>;
		compatible = "input_booster";
		ib_release_values = "-1, 16, 0";
		max_resource_count = [33 00];
		resValcount = [32 00];
		status = "okay";

		booster_key@1 {
			input_booster,head_time = <0xc8>;
			input_booster,label = "key";
			input_booster,tail_time = <0xc8>;
			input_booster,type = <0x0>;

			inputbooster,resource {
				compatible = "resource";

				resource@1 {
					resource,label = "CPU";
					resource,value = <0x16a4e0 0x0>;
				};

				resource@2 {
					resource,label = "DDR";
					resource,value = <0x0 0x0>;
				};

				resource@3 {
					resource,label = "SCHEDBOOST";
					resource,value = <0x0 0x0>;
				};
			};
		};

		booster_key@2 {
			input_booster,head_time = <0x1>;
			input_booster,label = "touchkey";
			input_booster,tail_time = <0x12c>;
			input_booster,type = <0x1>;

			inputbooster,resource {
				compatible = "resource";

				resource@1 {
					resource,label = "CPU";
					resource,value = <0x108e48 0x0>;
				};

				resource@2 {
					resource,label = "DDR";
					resource,value = <0x0 0x0>;
				};

				resource@3 {
					resource,label = "SCHEDBOOST";
					resource,value = <0x0 0x0>;
				};
			};
		};

		booster_key@3 {
			input_booster,head_time = <0x82>;
			input_booster,label = "touch";
			input_booster,tail_time = <0x1f4>;
			input_booster,type = <0x2>;

			inputbooster,resource {
				compatible = "resource";

				resource@1 {
					resource,label = "CPU";
					resource,value = <0x231c48 0x149d58>;
				};

				resource@2 {
					resource,label = "DDR";
					resource,value = <0x74a 0x74a>;
				};

				resource@3 {
					resource,label = "SCHEDBOOST";
					resource,value = <0x1 0x1>;
				};
			};
		};

		booster_key@4 {
			input_booster,head_time = <0x3e8>;
			input_booster,label = "multitouch";
			input_booster,tail_time = <0x1f4>;
			input_booster,type = <0x3>;

			inputbooster,resource {
				compatible = "resource";

				resource@1 {
					resource,label = "CPU";
					resource,value = <0x16a4e0 0x108e48>;
				};

				resource@2 {
					resource,label = "DDR";
					resource,value = <0x0 0x0>;
				};

				resource@3 {
					resource,label = "SCHEDBOOST";
					resource,value = <0x0 0x0>;
				};
			};
		};

		booster_key@5 {
			input_booster,head_time = <0xc8>;
			input_booster,label = "keyboard";
			input_booster,tail_time = <0x0>;
			input_booster,type = <0x4>;

			inputbooster,resource {
				compatible = "resource";

				resource@1 {
					resource,label = "CPU";
					resource,value = <0x108e48 0x108e48>;
				};

				resource@2 {
					resource,label = "DDR";
					resource,value = <0x0 0x0>;
				};

				resource@3 {
					resource,label = "SCHEDBOOST";
					resource,value = <0x0 0x0>;
				};
			};
		};

		booster_key@6 {
			input_booster,head_time = <0xc8>;
			input_booster,label = "mouse";
			input_booster,tail_time = <0x12c>;
			input_booster,type = <0x5>;

			inputbooster,resource {
				compatible = "resource";

				resource@1 {
					resource,label = "CPU";
					resource,value = <0x16a4e0 0x108e48>;
				};

				resource@2 {
					resource,label = "DDR";
					resource,value = <0x0 0x0>;
				};

				resource@3 {
					resource,label = "SCHEDBOOST";
					resource,value = <0x0 0x0>;
				};
			};
		};

		booster_key@7 {
			input_booster,head_time = <0xc8>;
			input_booster,label = "mouse_wheel";
			input_booster,tail_time = <0x0>;
			input_booster,type = <0x6>;

			inputbooster,resource {
				compatible = "resource";

				resource@1 {
					resource,label = "CPU";
					resource,value = <0x16a4e0 0x0>;
				};

				resource@2 {
					resource,label = "DDR";
					resource,value = <0x0 0x0>;
				};

				resource@3 {
					resource,label = "SCHEDBOOST";
					resource,value = <0x0 0x0>;
				};
			};
		};

		booster_key@8 {
			input_booster,head_time = <0xc8>;
			input_booster,label = "pen_hover";
			input_booster,tail_time = <0x12c>;
			input_booster,type = <0x7>;

			inputbooster,resource {
				compatible = "resource";

				resource@1 {
					resource,label = "CPU";
					resource,value = <0x16a4e0 0x108e48>;
				};

				resource@2 {
					resource,label = "DDR";
					resource,value = <0x0 0x0>;
				};

				resource@3 {
					resource,label = "SCHEDBOOST";
					resource,value = <0x0 0x0>;
				};
			};
		};

		booster_key@9 {
			input_booster,head_time = <0xc8>;
			input_booster,label = "pen";
			input_booster,tail_time = <0x258>;
			input_booster,type = <0x8>;

			inputbooster,resource {
				compatible = "resource";

				resource@1 {
					resource,label = "CPU";
					resource,value = <0x16a4e0 0x108e48>;
				};

				resource@2 {
					resource,label = "DDR";
					resource,value = <0x0 0x0>;
				};

				resource@3 {
					resource,label = "SCHEDBOOST";
					resource,value = <0x0 0x0>;
				};
			};
		};
	};

	interrupt-controller@0c000000 {
		#address-cells = <0x2>;
		#interrupt-cells = <0x3>;
		#redistributor-regions = <0x1>;
		#size-cells = <0x2>;
		compatible = "arm,gic-v3";
		interrupt-controller;
		interrupt-parent = <0x16>;
		interrupts = <0x1 0x9 0x4>;
		phandle = <0x16>;
		reg = <0x0 0xc000000 0x0 0x40000 0x0 0xc100000 0x0 0x200000 0x0 0x10200a80 0x0 0x50>;
	};

	intpol-controller@10200a80 {
		#interrupt-cells = <0x3>;
		compatible = "mediatek,mt6577-sysirq";
		interrupt-controller;
		interrupt-parent = <0x16>;
		phandle = <0x1>;
		reg = <0x0 0x10200a80 0x0 0x50>;
	};

	io_cfg_bl@10002600 {
		compatible = "mediatek,io_cfg_bl";
		phandle = <0x1b>;
		reg = <0x0 0x10002600 0x0 0x200>;
	};

	io_cfg_lb@10002400 {
		compatible = "mediatek,io_cfg_lb";
		phandle = <0x1a>;
		reg = <0x0 0x10002400 0x0 0x200>;
	};

	io_cfg_lm@10002200 {
		compatible = "mediatek,io_cfg_lm";
		phandle = <0x19>;
		reg = <0x0 0x10002200 0x0 0x200>;
	};

	io_cfg_lt@10002000 {
		compatible = "mediatek,io_cfg_lt";
		phandle = <0x18>;
		reg = <0x0 0x10002000 0x0 0x200>;
	};

	io_cfg_rb@10002a00 {
		compatible = "mediatek,io_cfg_rb";
		phandle = <0x1d>;
		reg = <0x0 0x10002a00 0x0 0x200>;
	};

	io_cfg_rr@10002800 {
		compatible = "mediatek,io_cfg_rr";
		phandle = <0x1c>;
		reg = <0x0 0x10002800 0x0 0x200>;
	};

	io_cfg_rt@10002c00 {
		compatible = "mediatek,io_cfg_rt";
		phandle = <0x1e>;
		reg = <0x0 0x10002c00 0x0 0x200>;
	};

	irq_nfc {
		compatible = "mediatek,irq_nfc-eint";
		phandle = <0xd1>;
	};

	irtx_pwm {
		compatible = "mediatek,irtx-pwm";
		phandle = <0xeb>;
		pwm_ch = <0x0>;
		pwm_data_invert = <0x0>;
	};

	kd_camera_hw1@1a040000 {
		clock-names = "CLK_TOP_CAMTG_SEL", "CLK_TOP_CAMTG1_SEL", "CLK_TOP_CAMTG2_SEL", "CLK_TOP_CAMTG3_SEL", "CLK_MCLK_6M", "CLK_MCLK_12M", "CLK_MCLK_13M", "CLK_MCLK_48M", "CLK_MCLK_52M", "CLK_MCLK_24M", "CLK_MCLK_26M", "CLK_CAM_SENINF_CG", "CLK_MIPI_C0_26M_CG", "CLK_MIPI_C1_26M_CG", "CLK_MIPI_ANA_0A_CG", "CLK_TOP_CAMTM_SEL_CG", "CLK_TOP_CAMTM_208_CG", "CLK_SCP_SYS_CAM";
		clocks = <0x26 0x66 0x26 0x67 0x26 0x68 0x26 0x69 0x26 0x14 0x26 0x13 0x26 0x1d 0x26 0x11 0x26 0x1c 0x26 0x12 0x24 0x65 0x4 0x3 0xe 0x3 0x12 0x67 0x0 0x26 0x7d 0x26 0x1a 0x35 0x9>;
		compatible = "mediatek,camera_hw";
		phandle = <0xdb>;
		pmic = <0x30>;
		reg = <0x0 0x1a040000 0x0 0x1000>;
	};

	kp@10010000 {
		clock-names = "kpd";
		clocks = <0x24>;
		compatible = "mediatek,kp";
		interrupts = <0x0 0xb4 0x2>;
		phandle = <0x20>;
		reg = <0x0 0x10010000 0x0 0x1000>;
	};

	l2c_parity {
		compatible = "mediatek,l2c_parity-v1";
		interrupts = <0x0 0x18 0x4 0x0 0x19 0x4>;
	};

	lk_charger {
		ac_charger_current = <0x1e8480>;
		ac_charger_input_current = <0x16e360>;
		charging_host_charger_current = <0x16e360>;
		compatible = "mediatek,lk_charger";
		enable_anime;
		enable_pd20_reset;
		enable_pe_plus;
		fast_charge_voltage = <0x2dc6c0>;
		max_charger_voltage = <0x632ea0>;
		non_std_ac_charger_current = <0x7a120>;
		pd_charger_current = <0x7a120>;
		phandle = <0xe1>;
		power_path_support;
		ta_ac_charger_current = <0x2dc6c0>;
		temp_t1_threshold = <0x0>;
		temp_t3_threshold = <0x2d>;
		temp_t4_threshold = <0x32>;
		usb_charger_current = <0x7a120>;
	};

	m4u@10205000 {
		cell-index = <0x0>;
		compatible = "mediatek,m4u";
		interrupts = <0x0 0x9e 0x8>;
		reg = <0x0 0x10205000 0x0 0x1000>;
	};

	mbist@17050000 {
		compatible = "mediatek,mbist";
		reg = <0x0 0x17050000 0x0 0x10000>;
	};

	mbist_ao@10013000 {
		compatible = "mediatek,mbist_ao";
		reg = <0x0 0x10013000 0x0 0x1000>;
	};

	mcdi@0010fc00 {
		compatible = "mediatek,mt6765-mcdi";
		reg = <0x0 0x10fc00 0x0 0x800>;
	};

	mcucfg@10200000 {
		compatible = "mediatek,mcucfg";
		interrupts = <0x0 0x0 0x8>;
		reg = <0x0 0x10200000 0x0 0x1000>;
	};

	mcucfg_mp0_counter@10200000 {
		compatible = "mediatek,mcucfg_mp0_counter";
		reg = <0x0 0x10200000 0x0 0x4000>;
	};

	mcupm_reg@10216000 {
		compatible = "mediatek,mcupm_reg";
		reg = <0x0 0x10216000 0x0 0x1000>;
	};

	mcupm_sram0@10217000 {
		compatible = "mediatek,mcupm_sram0";
		reg = <0x0 0x10217000 0x0 0x1000>;
	};

	mcupm_sram1@10218000 {
		compatible = "mediatek,mcupm_sram1";
		reg = <0x0 0x10218000 0x0 0x1000>;
	};

	mcupm_sram2@10211000 {
		compatible = "mediatek,mcupm_sram2";
		reg = <0x0 0x10211000 0x0 0x1000>;
	};

	mcupm_sram3@10213000 {
		compatible = "mediatek,mcupm_sram3";
		reg = <0x0 0x10213000 0x0 0x1000>;
	};

	md1_sim1_hot_plug_eint {
		phandle = <0xf7>;
	};

	md1_sim2_hot_plug_eint {
		phandle = <0xf8>;
	};

	md_auxadc {
		compatible = "mediatek,md_auxadc";
		io-channel-names = "md-channel", "md-battery";
		io-channels = <0x38 0x2>;
		phandle = <0xa6>;
	};

	md_ccif0@1020a000 {
		compatible = "mediatek,md_ccif0";
		reg = <0x0 0x1020a000 0x0 0x1000>;
	};

	md_ccif1@1020c000 {
		compatible = "mediatek,md_ccif1";
		reg = <0x0 0x1020c000 0x0 0x1000>;
	};

	md_ccif2@1023d000 {
		compatible = "mediatek,md_ccif2";
		reg = <0x0 0x1023d000 0x0 0x1000>;
	};

	md_ccif3@1023f000 {
		compatible = "mediatek,md_ccif3";
		reg = <0x0 0x1023f000 0x0 0x1000>;
	};

	mdcldmain@1021c000 {
		compatible = "mediatek,mdcldmain";
		reg = <0x0 0x1021c000 0x0 0x400>;
	};

	mdcldmain_ao@10015000 {
		compatible = "mediatek,mdcldmain_ao";
		reg = <0x0 0x10015000 0x0 0x400>;
	};

	mdcldmamisc@1021c800 {
		compatible = "mediatek,mdcldmamisc";
		reg = <0x0 0x1021c800 0x0 0x1000>;
	};

	mdcldmamisc_ao@10015800 {
		compatible = "mediatek,mdcldmamisc_ao";
		reg = <0x0 0x10015800 0x0 0x400>;
	};

	mdcldmaout@1021c400 {
		compatible = "mediatek,mdcldmaout";
		reg = <0x0 0x1021c400 0x0 0x400>;
	};

	mdcldmaout_ao@10015400 {
		compatible = "mediatek,mdcldmaout_ao";
		reg = <0x0 0x10015400 0x0 0x400>;
	};

	mddriver@10014000 {
		_vcore-supply = <0x37>;
		_vmodem-supply = <0x36>;
		ccci-infracfg = <0x25>;
		clock-names = "scp-sys-md1-main", "infra-cldma-bclk", "infra-ccif-ap", "infra-ccif-md", "infra-ccif1-ap", "infra-ccif1-md", "infra-ccif2-ap", "infra-ccif2-md";
		clocks = <0x35 0x0 0x25 0x32 0x25 0x29 0x25 0x2c 0x25 0x23 0x25 0x24 0x25 0x51 0x25 0x52>;
		compatible = "mediatek,mddriver", "mediatek,mddriver-mt6765";
		interrupts = <0x0 0xa5 0x4 0x0 0x94 0x8 0x0 0x95 0x8 0x0 0x105 0x2>;
		mediatek,ap_plat_info = <0x1a6d>;
		mediatek,cldma_capability = <0x6>;
		mediatek,md_generation = <0x1895>;
		mediatek,md_id = <0x0>;
		mediatek,mdhif_type = <0x3>;
		mediatek,offset_apon_md1 = <0x1c24>;
		phandle = <0x22>;
		reg = <0x0 0x10014000 0x0 0x1000 0x0 0x1021b000 0x0 0x1000 0x0 0x10209000 0x0 0x1000 0x0 0x1020a000 0x0 0x1000>;
	};

	mdp_ccorr0@14005000 {
		clock-names = "MDP_CCORR";
		clocks = <0x63 0x1>;
		compatible = "mediatek,mdp_ccorr0";
		interrupts = <0x0 0xe2 0x8>;
		phandle = <0x44>;
		reg = <0x0 0x14005000 0x0 0x1000>;
	};

	mdp_rdma0@14004000 {
		clock-names = "MDP_RDMA0";
		clocks = <0x63 0x0>;
		compatible = "mediatek,mdp_rdma0";
		interrupts = <0x0 0xd3 0x8>;
		phandle = <0x3d>;
		reg = <0x0 0x14004000 0x0 0x1000>;
	};

	mdp_rsz0@14006000 {
		clock-names = "MDP_RSZ0";
		clocks = <0x63 0x2>;
		compatible = "mediatek,mdp_rsz0";
		interrupts = <0x0 0xd4 0x8>;
		phandle = <0x3e>;
		reg = <0x0 0x14006000 0x0 0x1000>;
	};

	mdp_rsz1@14007000 {
		clock-names = "MDP_RSZ1";
		clocks = <0x63 0x3>;
		compatible = "mediatek,mdp_rsz1";
		interrupts = <0x0 0xd5 0x8>;
		phandle = <0x3f>;
		reg = <0x0 0x14007000 0x0 0x1000>;
	};

	mdp_tdshp0@1400a000 {
		clock-names = "MDP_TDSHP";
		clocks = <0x63 0x4>;
		compatible = "mediatek,mdp_tdshp0";
		phandle = <0x42>;
		reg = <0x0 0x1400a000 0x0 0x1000>;
	};

	mdp_wdma0@14008000 {
		clock-names = "MDP_WDMA";
		clocks = <0x63 0x6>;
		compatible = "mediatek,mdp_wdma0";
		interrupts = <0x0 0xd8 0x8>;
		phandle = <0x40>;
		reg = <0x0 0x14008000 0x0 0x1000>;
	};

	mdp_wrot0@14009000 {
		clock-names = "MDP_WROT0";
		clocks = <0x63 0x5>;
		compatible = "mediatek,mdp_wrot0";
		interrupts = <0x0 0xd7 0x8>;
		phandle = <0x41>;
		reg = <0x0 0x14009000 0x0 0x1000>;
	};

	memory {
		device_type = "memory";
		reg = <0x0 0x40000000 0x0 0x20000000>;
	};

	memory-ssmr-features {
		compatible = "mediatek,memory-ssmr-features";
		phandle = <0xed>;
		svp-region-based-size = <0x0 0x10000000>;
		wfd-size = <0x0 0x4000000>;
	};

	mfg_cfg@13ffe000 {
		#clock-cells = <0x1>;
		compatible = "mediatek,mfgcfg", "syscon";
		phandle = <0xcf>;
		reg = <0x0 0x13ffe000 0x0 0x1000>;
	};

	mfg_doma@13000000 {
		clock-frequency = <0x21f98280>;
		compatible = "mediatek,doma";
		ged-supply = <0x60>;
		interrupt-names = "RGX";
		interrupts = <0x0 0x103 0x8>;
		phandle = <0xce>;
		reg = <0x0 0x13000000 0x0 0x80000>;
	};

	mif_pdata {
		compatible = "sec_modem,modem_pdata";
		mif,ipc_version = <0x32>;
		mif,link_attrs = <0x7c8>;
		mif,link_name = "shmem";
		mif,link_types = <0x200>;
		mif,modem_net = <0x0>;
		mif,modem_type = <0xa>;
		mif,name = "MT6765ap";
		mif,num_iodevs = <0x5>;
		mif,use_handover = <0x0>;
		status = "okay";

		iodevs {

			io_device_0 {
				iod,app = "RIL";
				iod,attrs = <0x2>;
				iod,format = <0x0>;
				iod,id = <0xec>;
				iod,io_type = <0x0>;
				iod,links = <0x200>;
				iod,minor = <0x52>;
				iod,name = "umts_boot0";
			};

			io_device_1 {
				iod,app = "RIL";
				iod,attrs = <0x2>;
				iod,format = <0x0>;
				iod,id = <0xec>;
				iod,io_type = <0x0>;
				iod,links = <0x200>;
				iod,minor = <0x50>;
				iod,name = "umts_ipc0";
			};

			io_device_2 {
				iod,app = "RIL";
				iod,attrs = <0x2>;
				iod,format = <0x0>;
				iod,id = <0xec>;
				iod,io_type = <0x0>;
				iod,links = <0x200>;
				iod,minor = <0x51>;
				iod,name = "umts_ipc1";
			};

			io_device_3 {
				iod,app = "smdexe";
				iod,attrs = <0x2>;
				iod,format = <0x1>;
				iod,id = <0xec>;
				iod,io_type = <0x0>;
				iod,links = <0x200>;
				iod,minor = <0x3>;
				iod,name = "umts_router";
			};

			io_device_4 {
				iod,app = "CSVT";
				iod,attrs = <0x2>;
				iod,format = <0x1>;
				iod,io_type = <0x0>;
				iod,links = <0x200>;
				iod,minor = <0x52>;
				iod,name = "umts_csd";
			};
		};
	};

	mipi_rx_ana_csi0a@11c10000 {
		#clock-cells = <0x1>;
		compatible = "mediatek,mt6765-mipi0a", "syscon";
		phandle = <0x67>;
		reg = <0x0 0x11c10000 0x0 0x1000>;
	};

	mipi_rx_ana_csi0b@11c11000 {
		#clock-cells = <0x1>;
		compatible = "mediatek,mt6765-mipi0b", "syscon";
		phandle = <0xc9>;
		reg = <0x0 0x11c11000 0x0 0x1000>;
	};

	mipi_rx_ana_csi1a@11c12000 {
		#clock-cells = <0x1>;
		compatible = "mediatek,mt6765-mipi1a", "syscon";
		phandle = <0xca>;
		reg = <0x0 0x11c12000 0x0 0x1000>;
	};

	mipi_rx_ana_csi1b@11c13000 {
		#clock-cells = <0x1>;
		compatible = "mediatek,mt6765-mipi1b", "syscon";
		phandle = <0xcb>;
		reg = <0x0 0x11c13000 0x0 0x1000>;
	};

	mipi_rx_ana_csi2a@11c14000 {
		#clock-cells = <0x1>;
		compatible = "mediatek,mt6765-mipi2a", "syscon";
		phandle = <0xcc>;
		reg = <0x0 0x11c14000 0x0 0x1000>;
	};

	mipi_rx_ana_csi2b@11c15000 {
		#clock-cells = <0x1>;
		compatible = "mediatek,mt6765-mipi2b", "syscon";
		phandle = <0xcd>;
		reg = <0x0 0x11c15000 0x0 0x1000>;
	};

	mipi_tx0@11c80000 {
		compatible = "mediatek,mipi_tx0";
		reg = <0x0 0x11c80000 0x0 0x10000>;
	};

	mmdvfs_pmqos {
		cam_freq = "mm_step0", "mm_step1", "mm_step2";
		clock-names = "mmdvfs_clk_mm_sel_ck", "mmdvfs_clk_mmpll_ck", "mmdvfs_clk_univpll1_d2_ck", "mmdvfs_clk_mmpll_d2_ck";
		clocks = <0x26 0x62 0x26 0x21 0x26 0x17 0x26 0x22>;
		compatible = "mediatek,mmdvfs_pmqos";
		disp_freq = "mm_step0", "mm_step1", "mm_step2";
		img_freq = "mm_step0", "mm_step1", "mm_step2";
		mdp_freq = "mm_step0", "mm_step1", "mm_step2";
		mm_step0 = <0x1c9 0x1 0x0 0x1>;
		mm_step1 = <0x138 0x1 0x0 0x2>;
		mm_step2 = <0xe4 0x1 0x0 0x3>;
		vdec_freq = "mm_step0", "mm_step1", "mm_step2";
		venc_freq = "mm_step0", "mm_step1", "mm_step2";
		vopp_steps = <0x0 0x1 0x3>;
	};

	mmsys_config@14000000 {
		#clock-cells = <0x1>;
		compatible = "mediatek,mt6765-mmsys_config", "syscon";
		interrupts = <0x0 0xe3 0x8>;
		phandle = <0x63>;
		pwr-regmap = <0x62>;
		reg = <0x0 0x14000000 0x0 0x1000>;
	};

	mobicore {
		compatible = "trustonic,mobicore";
		interrupts = <0x0 0x10f 0x1>;
	};

	modem_temp_share@10018000 {
		compatible = "mediatek,modem_temp_share";
		reg = <0x0 0x10018000 0x0 0x1000>;
	};

	mrdump_ext_rst {
		compatible = "mediatek, mrdump_ext_rst-eint";
		force_mode = "SYSRST";
		mode = "RST";
		phandle = <0x9b>;
		status = "okay";
	};

	msdc0_pad_macro@11cd0000 {
		compatible = "mediatek,msdc0_pad_macro";
		reg = <0x0 0x11cd0000 0x0 0x10000>;
	};

	msdc0_top@11cd0000 {
		compatible = "mediatek,msdc0_top";
		reg = <0x0 0x11cd0000 0x0 0x1000>;
	};

	msdc1_ins@0 {
		compatible = "mediatek,mt6765-sdcard-ins";
		phandle = <0xc6>;
	};

	msdc1_pad_macro@11c90000 {
		compatible = "mediatek,msdc1_pad_macro";
		reg = <0x0 0x11c90000 0x0 0x10000>;
	};

	msdc1_top@11c90000 {
		compatible = "mediatek,msdc1_top";
		reg = <0x0 0x11c90000 0x0 0x1000>;
	};

	msdc@11230000 {
		bootable;
		bus-width = <0x8>;
		cap-mmc-highspeed;
		clk_src = [01];
		clock-names = "msdc0-clock", "msdc0-hclock", "msdc0-aes-clock";
		clocks = <0x25 0x4c 0x25 0x1c 0x25 0x44>;
		compatible = "mediatek,msdc";
		host_function = [00];
		index = [00];
		infracfg = <0x25>;
		interrupts = <0x0 0x4f 0x8>;
		max-frequency = <0xbebc200>;
		mmc-ddr-1_8v;
		mmc-hs200-1_8v;
		mmc-hs400-1_8v;
		no-sd;
		no-sdio;
		non-removable;
		phandle = <0xc2>;
		pinctl = <0x51>;
		pinctl_hs200 = <0x53>;
		pinctl_hs400 = <0x52>;
		reg = <0x0 0x11230000 0x0 0x10000>;
		register_setting = <0x54>;
		status = "okay";
		topckgen = <0x26>;
		vmmc-supply = <0x55>;
	};

	msdc@11240000 {
		bus-width = <0x4>;
		cap-sd-highspeed;
		cd-gpios = <0x1f 0x1 0x0>;
		cd_level = [00];
		clk_src = [02];
		clock-names = "msdc1-clock", "msdc1-hclock";
		clocks = <0x25 0x4d 0x25 0x1d>;
		compatible = "mediatek,msdc";
		host_function = [01];
		index = [01];
		interrupts = <0x0 0x50 0x8>;
		max-frequency = <0xbebc200>;
		mediatek,pwrap-regmap = <0x2f>;
		no-mmc;
		no-sdio;
		phandle = <0xc3>;
		pinctl = <0x56>;
		pinctl_ddr50 = <0x59>;
		pinctl_sdr104 = <0x57>;
		pinctl_sdr50 = <0x58>;
		reg = <0x0 0x11240000 0x0 0x10000>;
		register_setting = <0x5a>;
		sd-uhs-ddr50;
		sd-uhs-sdr104;
		sd-uhs-sdr12;
		sd-uhs-sdr25;
		sd-uhs-sdr50;
		status = "okay";
		vmmc-supply = <0x5b>;
		vqmmc-supply = <0x5c>;
	};

	msdc@11250000 {
		compatible = "mediatek,msdc2";
		phandle = <0xc4>;
		reg = <0x0 0x11250000 0x0 0x10000>;
		status = "disable";
	};

	msdc@11260000 {
		compatible = "mediatek,msdc3";
		phandle = <0xc5>;
		reg = <0x0 0x11250000 0x0 0x10000>;
		status = "disable";
	};

	mt6370_pd_eint {
		phandle = <0xea>;
	};

	mt6370_pmu_dts {
		#interrupt-cells = <0x1>;
		interrupt-controller;
		mt6370,intr_gpio = <0x1f 0x3 0x0>;
		mt6370,intr_gpio_num = <0x3>;
		phandle = <0xfb>;

		bled {
			compatible = "mediatek,mt6370_pmu_bled";
			interrupt-names = "bled_ocp";
			mt,bl_ocp_level = <0x2>;
			mt,bl_ovp_level = <0x3>;
			mt,bled_curr_scale = <0x0>;
			mt,bled_flash_ramp = <0x1>;
			mt,bled_name = "mt6370_pmu_bled";
			mt,bled_ramptime = <0x3>;
			mt,chan_en = <0xc>;
			mt,map_linear;
			mt,max_bled_brightness = <0x622>;
			mt,pwm_avg_cycle = <0x0>;
			mt,pwm_deglitch = <0x1>;
			mt,pwm_fsample = <0x2>;
			mt,pwm_hys = <0x2>;
			mt,pwm_hys_en = <0x1>;
			mt,pwm_lpf_coef = <0x0>;
			mt,use_pwm;
		};

		charger {
			aicr = <0x7a120>;
			bc12_sel = <0x0>;
			bootmode = <0x2a>;
			charger = <0x29>;
			charger_name = "primary_chg";
			compatible = "mediatek,mt6370_pmu_charger";
			cv = <0x426030>;
			dc_wdt = <0x3d0900>;
			enable_otg_wdt;
			enable_te;
			enable_wdt;
			ichg = <0x1e8480>;
			ieoc = <0x249f0>;
			interrupt-names = "chg_mivr", "chg_aiclmeasi", "attachi", "ovpctrl_uvp_d_evt", "chg_wdtmri", "chg_vbusov", "chg_tmri", "chg_treg", "dcdti", "pwr_rdy";
			ircmp_resistor = <0x61a8>;
			ircmp_vclamp = <0x0>;
			lbp_dt = <0x1>;
			lbp_hys_sel = <0x1>;
			load_switch_name = "primary_load_switch";
			mivr = <0x432380>;
			phandle = <0x29>;
			safety_timer = <0xc>;

			usb-otg-vbus {
				phandle = <0x69>;
				regulator-compatible = "usb-otg-vbus";
				regulator-max-microamp = <0x2dc6c0>;
				regulator-max-microvolt = <0x588040>;
				regulator-min-microamp = <0x7a120>;
				regulator-min-microvolt = <0x426030>;
				regulator-name = "usb-otg-vbus";
			};
		};

		core {
			compatible = "mediatek,mt6370_pmu_core";
			i2cstmr_rst_tmr = <0x0>;
			int_deg = <0x0>;
			int_wdt = <0x0>;
			interrupt-names = "otp", "vdda_ovp", "vdda_uv";
			mrstb_en;
			mrstb_tmr = <0x3>;
		};

		dsv {
			compatible = "mediatek,mt6370_pmu_dsv";
			db_delay = <0x3>;
			db_ext_en = <0x0>;
			db_freq_pm = <0x0>;
			db_periodic_fix = <0x0>;
			db_periodic_mode = <0x0>;
			db_single_pin = <0x0>;
			db_startup = <0x0>;
			db_vbst = <0x1838>;
			db_vneg_20ms = <0x1>;
			db_vneg_disc = <0x0>;
			db_vneg_slew = <0x1>;
			db_vpos_20ms = <0x1>;
			db_vpos_disc = <0x1>;
			db_vpos_slew = <0x1>;
			interrupt-names = "dsv_vneg_ocp", "dsv_vpos_ocp", "dsv_bst_ocp", "dsv_vneg_scp", "dsv_vpos_scp";

			mt6370_dsvn {
				regulator-max-microvolt = <0x5b8d80>;
				regulator-min-microvolt = <0x3d0900>;
				regulator-name = "dsv_neg";
			};

			mt6370_dsvp {
				regulator-max-microvolt = <0x5b8d80>;
				regulator-min-microvolt = <0x3d0900>;
				regulator-name = "dsv_pos";
			};
		};

		ldo {
			compatible = "mediatek,mt6370_pmu_ldo";
			interrupt-names = "ldo_oc";
			ldo_oms = <0x1>;
			ldo_vrc_lt = <0x1>;

			mt6370_ldo {
				regulator-max-microvolt = <0x3d0900>;
				regulator-min-microvolt = <0x186a00>;
				regulator-name = "irtx_ldo";
			};
		};

		mt6370_pmu_fled1 {
			compatible = "mediatek,mt6370_pmu_fled1";
			fled_enable = <0x1>;
			interrupt-names = "fled_lvf", "fled2_short", "fled1_short";
			strobe_cur = <0x124f80>;
			strobe_timeout = <0x960>;
			torch_cur = <0x493e0>;
		};

		mt6370_pmu_fled2 {
			compatible = "mediatek,mt6370_pmu_fled2";
			fled_enable = <0x1>;
			strobe_cur = <0xf4240>;
			strobe_timeout = <0x4b0>;
			torch_cur = <0x30d40>;
		};

		rgbled {
			compatible = "mediatek,mt6370_pmu_rgbled";
			interrupt-names = "isink4_short", "isink3_short", "isink2_short", "isink1_short", "isink4_open", "isink3_open", "isink2_open", "isink1_open";
			mt,led_default_trigger = "cc_mode", "cc_mode", "cc_mode", "none";
			mt,led_name = "mt6370_pmu_led1", "mt6370_pmu_led2", "mt6370_pmu_led3", "mt6370_pmu_led4";
		};
	};

	mt6370_pmu_eint {
		phandle = <0xe9>;
	};

	mt_soc_anc_pcm {
		compatible = "mediatek,mt_soc_pcm_anc";
	};

	mt_soc_codec_dummy_name {
		compatible = "mediatek,mt_soc_codec_dummy";
	};

	mt_soc_codec_name {
		compatible = "mediatek,mt_soc_codec_63xx";
		phandle = <0xf0>;
		use_hp_depop_flow = <0x0>;
		use_ul_260k = <0x0>;
	};

	mt_soc_dai_name {
		compatible = "mediatek,mt_soc_dai_stub";
	};

	mt_soc_deep_buffer_dl_pcm {
		compatible = "mediatek,mt_soc_pcm_deep_buffer_dl";
	};

	mt_soc_dl1_awb_pcm {
		compatible = "mediatek,mt_soc_pcm_dl1_awb";
	};

	mt_soc_dl1_pcm@11220000 {
		clock-names = "aud_afe_clk", "aud_dac_clk", "aud_dac_predis_clk", "aud_adc_clk", "aud_apll22m_clk", "aud_apll1_tuner_clk", "aud_tml_clk", "aud_infra_clk", "mtkaif_26m_clk", "top_mux_audio", "top_mux_audio_int", "top_sys_pll1_d4", "top_mux_aud_1", "top_apll1_ck", "top_mux_aud_eng1", "top_apll1_d8", "apmixed_apll1", "top_clk26m_clk";
		clocks = <0x5f 0x0 0x5f 0x4 0x5f 0x5 0x5f 0x3 0x5f 0x1 0x5f 0x2 0x5f 0x6 0x25 0x2b 0x25 0x33 0x26 0x6f 0x26 0x70 0x26 0x3 0x26 0x71 0x26 0x29 0x26 0x72 0x26 0x2c 0x3 0x8 0x24>;
		compatible = "mediatek,mt_soc_pcm_dl1";
		interrupts = <0x0 0x99 0x8>;
		phandle = <0xc8>;
		reg = <0x0 0x11220000 0x0 0x1000>;
	};

	mt_soc_dl2_pcm {
		compatible = "mediatek,mt_soc_pcm_dl2";
	};

	mt_soc_dummy_pcm {
		compatible = "mediatek,mt_soc_pcm_dummy";
	};

	mt_soc_fm_i2s_awb_pcm {
		compatible = "mediatek,mt_soc_pcm_fm_i2s_awb";
	};

	mt_soc_fm_i2s_pcm {
		compatible = "mediatek,mt_soc_pcm_fm_i2s";
	};

	mt_soc_fm_mrgtx_pcm {
		compatible = "mediatek,mt_soc_pcm_fmtx";
	};

	mt_soc_hp_impedance_pcm {
		compatible = "mediatek,mt_soc_pcm_hp_impedance";
	};

	mt_soc_i2s0_awb_pcm {
		compatible = "mediatek,mt_soc_pcm_i2s0_awb";
	};

	mt_soc_i2s0_pcm {
		compatible = "mediatek,mt_soc_pcm_dl1_i2s0";
	};

	mt_soc_i2s0dl1_pcm {
		compatible = "mediatek,mt_soc_pcm_dl1_i2s0dl1";
	};

	mt_soc_mrgrx_awb_pcm {
		compatible = "mediatek,mt_soc_pcm_mrgrx_awb";
	};

	mt_soc_mrgrx_pcm {
		compatible = "mediatek,mt_soc_pcm_mrgrx";
	};

	mt_soc_pcm_dl1_scp_spk {
		compatible = "mediatek,mt_soc_pcm_dl1_scp_spk";
	};

	mt_soc_pcm_voice_scp {
		compatible = "mediatek,mt_soc_pcm_voice_scp";
	};

	mt_soc_pcm_voice_ultra {
		compatible = "mediatek,mt_soc_pcm_voice_ultra";
	};

	mt_soc_pcm_voice_usb {
		compatible = "mediatek,mt_soc_pcm_voice_usb";
	};

	mt_soc_pcm_voice_usb_echoref {
		compatible = "mediatek,mt_soc_pcm_voice_usb_echoref";
	};

	mt_soc_routing_dai_name {
		compatible = "mediatek,mt_soc_dai_routing";
	};

	mt_soc_routing_pcm {
		compatible = "mediatek,mt_soc_pcm_routing";
	};

	mt_soc_tdmrx_pcm {
		compatible = "mediatek,mt_soc_tdm_capture";
	};

	mt_soc_ul1_pcm {
		compatible = "mediatek,mt_soc_pcm_capture";
	};

	mt_soc_ul2_pcm {
		compatible = "mediatek,mt_soc_pcm_capture2";
	};

	mt_soc_uldlloopback_pcm {
		compatible = "mediatek,mt_soc_pcm_uldlloopback";
	};

	mt_soc_voice_md1 {
		compatible = "mediatek,mt_soc_pcm_voice_md1";
	};

	mt_soc_voice_md1_bt {
		compatible = "mediatek,mt_soc_pcm_voice_md1_bt";
	};

	mt_soc_voice_md2 {
		compatible = "mediatek,mt_soc_pcm_voice_md2";
	};

	mt_soc_voice_md2_bt {
		compatible = "mediatek,mt_soc_pcm_voice_md2_bt";
	};

	mt_soc_voip_bt_in {
		compatible = "mediatek,mt_soc_pcm_bt_dai";
	};

	mt_soc_voip_bt_out {
		compatible = "mediatek,mt_soc_pcm_dl1_bt";
	};

	mtk-btcvsd-snd@18050000 {
		compatible = "mediatek,mtk-btcvsd-snd";
		disable_write_silence = <0x0>;
		interrupts = <0x0 0x10a 0x8>;
		mediatek,infracfg = <0x25>;
		mediatek,offset = <0xf00 0x800 0x140 0x144 0x148>;
		phandle = <0x5d>;
		reg = <0x0 0x18050000 0x0 0x1000 0x0 0x18080000 0x0 0x10000>;
	};

	mtkfb@0 {
		compatible = "mediatek,mtkfb";
		phandle = <0xd4>;
	};

	nebula {
		#address-cells = <0x2>;
		#size-cells = <0x2>;
		compatible = "android,nebula-smc-v1";
		ranges;
		tee-id = <0x1>;
		tee-name = "nebula";

		nebula-gz-log {
			compatible = "android,nebula-gz-log-v1";
		};

		nebula-irq {
			compatible = "android,nebula-irq-v1";
			ppi-interrupt-parent = <0x16>;
		};

		nebula-virtio {
			compatible = "android,nebula-virtio-v1";
		};
	};

	nfc {
		compatible = "mediatek,nfc-gpio-v2";
		gpio-irq = <0xa>;
		gpio-irq-std = <0x1f 0xa 0x0>;
		gpio-rst = <0xac>;
		gpio-rst-std = <0x1f 0xac 0x0>;
		phandle = <0xd0>;
	};

	nfi@11018000 {
		compatible = "mediatek,nfi";
		reg = <0x0 0x11018000 0x0 0x1000>;
	};

	nfiecc@11019000 {
		compatible = "mediatek,nfiecc";
		reg = <0x0 0x11019000 0x0 0x1000>;
	};

	odm {
		compatible = "simple-bus";
		phandle = <0xec>;
	};

	opp_table0 {
		compatible = "operating-points-v2";
		opp-shared;
		phandle = <0x5>;

		opp0 {
			opp-hz = <0x0 0x35a4e900>;
			opp-microvolt = <0x927c0>;
		};

		opp1 {
			opp-hz = <0x0 0x3a5a5ac0>;
			opp-microvolt = <0x970fe>;
		};

		opp10 {
			opp-hz = <0x0 0x73df1600>;
			opp-microvolt = <0xdec74>;
		};

		opp11 {
			opp-hz = <0x0 0x77bee840>;
			opp-microvolt = <0xe7ef0>;
		};

		opp12 {
			opp-hz = <0x0 0x7b9eba80>;
			opp-microvolt = <0xf116c>;
		};

		opp13 {
			opp-hz = <0x0 0x7f7e8cc0>;
			opp-microvolt = <0xfa3e8>;
		};

		opp14 {
			opp-hz = <0x0 0x840637c0>;
			opp-microvolt = <0x104ece>;
		};

		opp15 {
			opp-hz = <0x0 0x89267940>;
			opp-microvolt = <0x11121e>;
		};

		opp2 {
			opp-hz = <0x0 0x40abc940>;
			opp-microvolt = <0x9d2a6>;
		};

		opp3 {
			opp-hz = <0x0 0x48993480>;
			opp-microvolt = <0xa4cb8>;
		};

		opp4 {
			opp-hz = <0x0 0x50869fc0>;
			opp-microvolt = <0xac6ca>;
		};

		opp5 {
			opp-hz = <0x0 0x58740b00>;
			opp-microvolt = <0xb40dc>;
		};

		opp6 {
			opp-hz = <0x0 0x60617640>;
			opp-microvolt = <0xbbaee>;
		};

		opp7 {
			opp-hz = <0x0 0x684ee180>;
			opp-microvolt = <0xc3500>;
		};

		opp8 {
			opp-hz = <0x0 0x6c1f7180>;
			opp-microvolt = <0xcc77c>;
		};

		opp9 {
			opp-hz = <0x0 0x6fff43c0>;
			opp-microvolt = <0xd59f8>;
		};
	};

	opp_table1 {
		compatible = "operating-points-v2";
		opp-shared;
		phandle = <0xd>;

		opp0 {
			opp-hz = <0x0 0x17d78400>;
			opp-microvolt = <0x927c0>;
		};

		opp1 {
			opp-hz = <0x0 0x1ddca740>;
			opp-microvolt = <0x9a1d2>;
		};

		opp10 {
			opp-hz = <0x0 0x4e520c80>;
			opp-microvolt = <0xdec74>;
		};

		opp11 {
			opp-hz = <0x0 0x5390d280>;
			opp-microvolt = <0xe7ef0>;
		};

		opp12 {
			opp-hz = <0x0 0x58dedac0>;
			opp-microvolt = <0xf116c>;
		};

		opp13 {
			opp-hz = <0x0 0x5e1da0c0>;
			opp-microvolt = <0xfa3e8>;
		};

		opp14 {
			opp-hz = <0x0 0x64414880>;
			opp-microvolt = <0x104ec4>;
		};

		opp15 {
			opp-hz = <0x0 0x6b49d200>;
			opp-microvolt = <0x11121e>;
		};

		opp2 {
			opp-hz = <0x0 0x204e4380>;
			opp-microvolt = <0x9d2a6>;
		};

		opp3 {
			opp-hz = <0x0 0x265366c0>;
			opp-microvolt = <0xa4cb8>;
		};

		opp4 {
			opp-hz = <0x0 0x2c67cc40>;
			opp-microvolt = <0xac6ca>;
		};

		opp5 {
			opp-hz = <0x0 0x326cef80>;
			opp-microvolt = <0xb40dc>;
		};

		opp6 {
			opp-hz = <0x0 0x38815500>;
			opp-microvolt = <0xbbaee>;
		};

		opp7 {
			opp-hz = <0x0 0x3e95ba80>;
			opp-microvolt = <0xc3500>;
		};

		opp8 {
			opp-hz = <0x0 0x43d48080>;
			opp-microvolt = <0xcc77c>;
		};

		opp9 {
			opp-hz = <0x0 0x49134680>;
			opp-microvolt = <0xd59f8>;
		};
	};

	opp_table2 {
		compatible = "operating-points-v2";
		opp-shared;
		phandle = <0x4>;

		opp00 {
			opp-hz = <0x0 0x11e1a300>;
			opp-microvolt = <0x927c0>;
		};

		opp01 {
			opp-hz = <0x0 0x1434bac0>;
			opp-microvolt = <0x970fe>;
		};

		opp02 {
			opp-hz = <0x0 0x175d7200>;
			opp-microvolt = <0x9d2a6>;
		};

		opp03 {
			opp-hz = <0x0 0x1b5bc8c0>;
			opp-microvolt = <0xa4cb8>;
		};

		opp04 {
			opp-hz = <0x0 0x1f4add40>;
			opp-microvolt = <0xac6ca>;
		};

		opp05 {
			opp-hz = <0x0 0x23493400>;
			opp-microvolt = <0xb40dc>;
		};

		opp06 {
			opp-hz = <0x0 0x27384880>;
			opp-microvolt = <0xbbaee>;
		};

		opp07 {
			opp-hz = <0x0 0x2b275d00>;
			opp-microvolt = <0xc3500>;
		};

		opp08 {
			opp-hz = <0x0 0x48c3ee0>;
			opp-microvolt = <0xcc77c>;
		};

		opp09 {
			opp-hz = <0x0 0x4c63aa0>;
			opp-microvolt = <0xd59f8>;
		};

		opp10 {
			opp-hz = <0x0 0x501bd00>;
			opp-microvolt = <0xdec74>;
		};

		opp11 {
			opp-hz = <0x0 0x53bb8c0>;
			opp-microvolt = <0xe7ef0>;
		};

		opp12 {
			opp-hz = <0x0 0x36a84f40>;
			opp-microvolt = <0xf116c>;
		};

		opp13 {
			opp-hz = <0x0 0x38ec24c0>;
			opp-microvolt = <0xfa3e8>;
		};

		opp14 {
			opp-hz = <0x0 0x3b9aca00>;
			opp-microvolt = <0x104ece>;
		};

		opp15 {
			opp-hz = <0x0 0x3ea4fcc0>;
			opp-microvolt = <0x11121e>;
		};
	};

	otg_iddig {
		compatible = "mediatek,usb_iddig_bi_eint";
		phandle = <0x9a>;
	};

	pd_adapter {
		adapter_name = "pd_adapter";
		compatible = "mediatek,pd_adapter";
		phandle = <0xe6>;
	};

	pdc {
		compatible = "mediatek,charger,pd";
		dcs_chg1_charger_current = <0x16e360>;
		dcs_chg2_charger_current = <0x16e360>;
		dcs_input_current = <0x30d400>;
		dual_polling_ieoc = <0x6ddd0>;
		gauge = <0x68>;
		ibus_err = <0x1e>;
		min_charger_voltage = <0x4630c0>;
		pd_stop_battery_soc = <0x50>;
		pd_vbus_low_bound = <0x4c4b40>;
		pd_vbus_upper_bound = <0xe4e1c0>;
		phandle = <0xe4>;
		sc_charger_current = <0x2932e0>;
		sc_input_current = <0x30d400>;
		slave_mivr_diff = <0x186a0>;
		vsys_watt = <0x4c4b40>;
	};

	pe {
		compatible = "mediatek,charger,pe";
		gauge = <0x68>;
		min_charger_voltage = <0x4630c0>;
		pe_charger_current = <0x2932e0>;
		pe_ichg_level_threshold = <0xf4240>;
		phandle = <0xe2>;
		ta_9v_support;
		ta_ac_12v_input_current = <0x30d400>;
		ta_ac_7v_input_current = <0x30d400>;
		ta_ac_9v_input_current = <0x30d400>;
		ta_start_battery_soc = <0x0>;
		ta_stop_battery_soc = <0x55>;
	};

	pe2 {
		cable_imp_threshold = <0x2bb>;
		compatible = "mediatek,charger,pe2";
		dcs_chg1_charger_current = <0x16e360>;
		dcs_chg2_charger_current = <0x16e360>;
		dcs_input_current = <0x30d400>;
		dual_polling_ieoc = <0x6ddd0>;
		gauge = <0x68>;
		min_charger_voltage = <0x4630c0>;
		pe20_ichg_level_threshold = <0xf4240>;
		phandle = <0xe3>;
		sc_charger_current = <0x2932e0>;
		sc_input_current = <0x30d400>;
		slave_mivr_diff = <0x186a0>;
		ta_start_battery_soc = <0x0>;
		ta_stop_battery_soc = <0x55>;
		vbat_cable_imp_threshold = <0x3b8260>;
	};

	pe4 {
		compatible = "mediatek,charger,pe4";
		dcs_chg1_charger_current = <0x16e360>;
		dcs_chg2_charger_current = <0x16e360>;
		dcs_input_current = <0x30d400>;
		dual_polling_ieoc = <0x6ddd0>;
		gauge = <0x68>;
		high_temp_to_enter_pe40 = <0x27>;
		high_temp_to_leave_pe40 = <0x2e>;
		ibus_err = <0x1e>;
		low_temp_to_enter_pe40 = <0x10>;
		low_temp_to_leave_pe40 = <0xa>;
		min_charger_voltage = <0x4630c0>;
		pe40_r_cable_1a_lower = <0x1f4>;
		pe40_r_cable_2a_lower = <0x15f>;
		pe40_r_cable_3a_lower = <0xf0>;
		pe40_stop_battery_soc = <0x50>;
		phandle = <0xe5>;
		sc_charger_current = <0x2932e0>;
		sc_input_current = <0x30d400>;
		slave_mivr_diff = <0x186a0>;
	};

	pericfg@10003000 {
		#clock-cells = <0x1>;
		compatible = "mediatek,pericfg", "syscon";
		phandle = <0x4e>;
		reg = <0x0 0x10003000 0x0 0x1000>;
	};

	pinctrl@1000b000 {
		#gpio-cells = <0x2>;
		#interrupt-cells = <0x2>;
		compatible = "mediatek,mt6765-pinctrl";
		gpio-controller;
		gpio-ranges = <0x1f 0x0 0x0 0xb3>;
		interrupt-controller;
		interrupt-parent = <0x16>;
		interrupts = <0x0 0xab 0x4>;
		phandle = <0x1f>;
		pins-are-numbered;
		reg_bases = <0x17 0x18 0x19 0x1a 0x1b 0x1c 0x1d 0x1e>;

		msdc0@default {
			phandle = <0x51>;

			pins_clk {
				drive-strength = [03];
			};

			pins_cmd {
				drive-strength = [03];
			};

			pins_dat {
				drive-strength = [03];
			};

			pins_ds {
				drive-strength = [03];
			};

			pins_rst {
				drive-strength = [03];
			};
		};

		msdc0@hs200 {
			phandle = <0x53>;

			pins_clk {
				drive-strength = [04];
			};

			pins_cmd {
				drive-strength = [03];
			};

			pins_dat {
				drive-strength = [04];
			};

			pins_ds {
				drive-strength = [04];
			};

			pins_rst {
				drive-strength = [03];
			};
		};

		msdc0@hs400 {
			phandle = <0x52>;

			pins_clk {
				drive-strength = [04];
			};

			pins_cmd {
				drive-strength = [03];
			};

			pins_dat {
				drive-strength = [04];
			};

			pins_ds {
				drive-strength = [04];
			};

			pins_rst {
				drive-strength = [03];
			};
		};

		msdc0@register_default {
			cmd_edge = [00];
			phandle = <0x54>;
			rdata_edge = [00];
			wdata_edge = [00];
		};

		msdc1@ddr50 {
			phandle = <0x59>;

			pins_clk {
				drive-strength = [03];
			};

			pins_cmd {
				drive-strength = [03];
			};

			pins_dat {
				drive-strength = [03];
			};
		};

		msdc1@default {
			phandle = <0x56>;

			pins_clk {
				drive-strength = [03];
			};

			pins_cmd {
				drive-strength = [03];
			};

			pins_dat {
				drive-strength = [03];
			};
		};

		msdc1@register_default {
			cmd_edge = [00];
			phandle = <0x5a>;
			rdata_edge = [00];
			wdata_edge = [00];
		};

		msdc1@sdr104 {
			phandle = <0x57>;

			pins_clk {
				drive-strength = [03];
			};

			pins_cmd {
				drive-strength = [03];
			};

			pins_dat {
				drive-strength = [03];
			};
		};

		msdc1@sdr50 {
			phandle = <0x58>;

			pins_clk {
				drive-strength = [03];
			};

			pins_cmd {
				drive-strength = [03];
			};

			pins_dat {
				drive-strength = [03];
			};
		};

		msdc3@default {
			phandle = <0x73>;

			pins_clk {
				drive-strength = [04];
			};

			pins_cmd {
				drive-strength = [04];
			};

			pins_dat {
				drive-strength = [04];
			};
		};

		msdc3@register_default {
			cmd_edge = [01];
			phandle = <0x74>;
			rdata_edge = [01];
			wdata_edge = [01];
		};
	};

	pmic_clock_buffer_ctrl {
		compatible = "mediatek,pmic_clock_buffer";
		mediatek,bblpm-support = "enable";
		mediatek,clkbuf-config = <0x2 0x1 0x1 0x2 0x0 0x0 0x0>;
		mediatek,clkbuf-driving-current = <0x1 0x1 0x1 0x1 0x1 0x1 0x1>;
		mediatek,clkbuf-quantity = <0x7>;
		phandle = <0xf1>;
		pwrap = <0x2f>;
		pwrap-dcxo-cfg = <0x18c 0x19c>;
		pwrap-dcxo-en = <0x188 0x0 0x188 0x1 0x188 0x0>;
		sleep = <0x62>;
		spm-pwr-status = <0x180 0x0 0x180 0x1>;
	};

	pmu {
		compatible = "arm,armv8-pmuv3";
		interrupt-parent = <0x16>;
		interrupts = <0x1 0x7 0x8>;
	};

	psci {
		compatible = "arm,psci-1.0";
		method = "smc";
	};

	pwm@11006000 {
		clock-names = "PWM1-main", "PWM2-main", "PWM3-main", "PWM4-main", "PWM5-main", "PWM6-main", "PWM-HCLK-main", "PWM-main";
		clocks = <0x25 0x10 0x25 0x11 0x25 0x12 0x25 0x13 0x25 0x14 0x25 0x30 0x25 0xf 0x25 0x15>;
		compatible = "mediatek,pwm";
		interrupts = <0x0 0x4d 0x8>;
		phandle = <0xb5>;
		reg = <0x0 0x11006000 0x0 0x10000>;
	};

	pwrap@1000d000 {
		clock-names = "spi", "wrap", "ulposc";
		clocks = <0x24 0x25 0x2 0x26 0x7c>;
		compatible = "mediatek,mt6765-pwrap", "syscon";
		interrupts = <0x0 0xb3 0x4>;
		phandle = <0x2f>;
		reg = <0x0 0x1000d000 0x0 0x1000>;
		reg-names = "pwrap";

		main_pmic {
			#interrupt-cells = <0x2>;
			compatible = "mediatek,mt6357";
			interrupt-controller;
			interrupt-parent = <0x1f>;
			interrupts = <0x90 0x4 0x90 0x0>;
			phandle = <0x30>;

			clock_buffer_ctrl {
				clkbuf-pmic-dependent = "pmic-drvcurr", "pmic-auxout-sel", "pmic-auxout-xo", "pmic-auxout-drvcurr", "pmic-auxout-bblpm-en", "pmic-cofst-fpm", "pmic-cdac-fpm", "pmic-core-idac-fpm", "pmic-aac-fpm-swen";
				compatible = "mediatek,clock_buffer";
				n-clkbuf-pmic-dependent = <0x9>;
				n-pmic-aac-fpm-swen = <0x1>;
				n-pmic-auxout-bblpm-en = <0x1>;
				n-pmic-auxout-drvcurr = <0x7>;
				n-pmic-auxout-sel = <0x6>;
				n-pmic-auxout-xo = <0x7>;
				n-pmic-cdac-fpm = <0x1>;
				n-pmic-cofst-fpm = <0x1>;
				n-pmic-core-idac-fpm = <0x1>;
				n-pmic-drvcurr = <0x7>;
				phandle = <0x99>;
				pmic-aac-fpm-swen = <0x79e 0xe>;
				pmic-auxout-bblpm-en = <0x7b6 0x0>;
				pmic-auxout-drvcurr = <0x7b6 0x1 0x7b6 0x7 0x7b6 0x1 0x7b6 0x7 0xffff 0xffff 0x7b6 0x1 0x7b6 0xc>;
				pmic-auxout-sel = <0x7b4 0x0 0x7b4 0x5 0x7b4 0x6 0x7b4 0x7 0x7b4 0x6 0x7b4 0x18>;
				pmic-auxout-xo = <0x7b6 0x0 0x7b6 0x6 0x7b6 0x0 0x7b6 0x6 0xffff 0xffff 0x7b6 0x6 0x7b6 0xc>;
				pmic-bblpm-sw = <0x788 0xc>;
				pmic-cdac-fpm = <0x794 0x0>;
				pmic-cofst-fpm = <0x796 0xe>;
				pmic-core-idac-fpm = <0x79a 0xe>;
				pmic-dcxo-cw = <0x788>;
				pmic-drvcurr = <0x7b0 0x0 0x7b0 0x2 0x7b0 0x4 0x7b0 0x6 0xffff 0xffff 0x7b0 0xa 0x7b0 0xc>;
				pmic-srclkeni3 = <0x44a 0x0>;
				pmic-xo-en = <0x788 0x2 0x788 0x5 0x788 0x8 0x788 0xb 0xffff 0xffff 0x7a2 0xa 0x7a2 0xd>;
				pmic-xo-mode = <0x788 0x0 0x788 0x3 0x788 0x6 0x788 0x9 0xffff 0xffff 0x7a2 0x8 0x7a2 0xb>;
			};

			leds-mt6357 {
				compatible = "mediatek,mt6357_leds";

				Isink1 {
					default-state = "off";
					label = "red";
					linux,default-trigger = "none";
					reg = <0x1>;
				};
			};

			mt6357_charger {
				alias_name = "mt6357";
				charger_name = "primary_chg";
				compatible = "mediatek,mt6357-pulse-charger";
				cv = <0x426030>;
				ichg = <0x7a120>;
				phandle = <0x78>;
				vbat_ov_thres = <0x43e6d0>;
				vcdt_hv_thres = <0x6acfc0>;
			};

			mt6357_debug {
				compatible = "mediatek,mt63xx-debug";
			};

			mt6357_ts_buck1 {
				compatible = "mediatek,mt6357_ts_buck1";
				interconnects = <0x2d 0x1>;
				io-channel-names = "pmic_buck1_temp";
				io-channels = <0x27 0x6>;
				phandle = <0x79>;
			};

			mt6357_ts_buck2 {
				compatible = "mediatek,mt6357_ts_buck2";
				interconnects = <0x2d 0x1>;
				io-channel-names = "pmic_buck2_temp";
				io-channels = <0x27 0x7>;
				phandle = <0x7a>;
			};

			mt6357keys {
				compatible = "mediatek,mt6357-keys";
				mediatek,long-press-mode = <0x2>;
				phandle = <0x76>;
				power-off-time-sec = <0x0>;

				home {
					linux,keycodes = <0x72>;
				};

				power {
					linux,keycodes = <0x74>;
					wakeup-source;
				};
			};

			mt6357regulator {
				compatible = "mediatek,mt6357-regulator";
				phandle = <0x7b>;

				buck_vcore {
					phandle = <0x37>;
					regulator-enable-ramp-delay = <0xdc>;
					regulator-max-microvolt = <0x1406f4>;
					regulator-min-microvolt = <0x7ea5e>;
					regulator-name = "vcore";
					regulator-ramp-delay = <0x186a>;
				};

				buck_vmodem {
					phandle = <0x36>;
					regulator-enable-ramp-delay = <0xdc>;
					regulator-max-microvolt = <0x123716>;
					regulator-min-microvolt = <0x7a120>;
					regulator-name = "vmodem";
					regulator-ramp-delay = <0x186a>;
				};

				buck_vpa {
					phandle = <0x7e>;
					regulator-enable-ramp-delay = <0xdc>;
					regulator-max-microvolt = <0x37b1d0>;
					regulator-min-microvolt = <0x7a120>;
					regulator-name = "vpa";
					regulator-ramp-delay = <0xc350>;
				};

				buck_vproc {
					phandle = <0x7d>;
					regulator-enable-ramp-delay = <0xdc>;
					regulator-max-microvolt = <0x1406f4>;
					regulator-min-microvolt = <0x7ea5e>;
					regulator-name = "vproc";
					regulator-ramp-delay = <0x186a>;
				};

				buck_vs1 {
					phandle = <0x7c>;
					regulator-enable-ramp-delay = <0xdc>;
					regulator-max-microvolt = <0x2191c0>;
					regulator-min-microvolt = <0x124f80>;
					regulator-name = "vs1";
					regulator-ramp-delay = <0x30d4>;
				};

				ldo_vaud28 {
					phandle = <0x8f>;
					regulator-enable-ramp-delay = <0x108>;
					regulator-max-microvolt = <0x2ab980>;
					regulator-min-microvolt = <0x2ab980>;
					regulator-name = "vaud28";
				};

				ldo_vaux18 {
					phandle = <0x8e>;
					regulator-enable-ramp-delay = <0x108>;
					regulator-max-microvolt = <0x1b7740>;
					regulator-min-microvolt = <0x1b7740>;
					regulator-name = "vaux18";
				};

				ldo_vcama {
					phandle = <0x88>;
					regulator-enable-ramp-delay = <0x108>;
					regulator-max-microvolt = <0x2ab980>;
					regulator-min-microvolt = <0x2625a0>;
					regulator-name = "vcama";
				};

				ldo_vcamd {
					phandle = <0x89>;
					regulator-enable-ramp-delay = <0x108>;
					regulator-max-microvolt = <0x1b7740>;
					regulator-min-microvolt = <0xf4240>;
					regulator-name = "vcamd";
				};

				ldo_vcamio {
					phandle = <0x8a>;
					regulator-enable-ramp-delay = <0x108>;
					regulator-max-microvolt = <0x1b7740>;
					regulator-min-microvolt = <0x1b7740>;
					regulator-name = "vcamio";
				};

				ldo_vcn18 {
					phandle = <0x87>;
					regulator-enable-ramp-delay = <0x108>;
					regulator-max-microvolt = <0x1b7740>;
					regulator-min-microvolt = <0x1b7740>;
					regulator-name = "vcn18";
				};

				ldo_vcn28 {
					phandle = <0x86>;
					regulator-enable-ramp-delay = <0x108>;
					regulator-max-microvolt = <0x2ab980>;
					regulator-min-microvolt = <0x2ab980>;
					regulator-name = "vcn28";
				};

				ldo_vcn33_bt {
					phandle = <0x84>;
					regulator-enable-ramp-delay = <0x108>;
					regulator-max-microvolt = <0x3567e0>;
					regulator-min-microvolt = <0x325aa0>;
					regulator-name = "vcn33_bt";
				};

				ldo_vcn33_wifi {
					phandle = <0x85>;
					regulator-enable-ramp-delay = <0x108>;
					regulator-max-microvolt = <0x3567e0>;
					regulator-min-microvolt = <0x325aa0>;
					regulator-name = "vcn33_wifi";
				};

				ldo_vdram {
					phandle = <0x92>;
					regulator-enable-ramp-delay = <0xce4>;
					regulator-max-microvolt = <0x124f80>;
					regulator-min-microvolt = <0x10c8e0>;
					regulator-name = "vdram";
				};

				ldo_vefuse {
					phandle = <0x83>;
					regulator-enable-ramp-delay = <0x108>;
					regulator-max-microvolt = <0x325aa0>;
					regulator-min-microvolt = <0x124f80>;
					regulator-name = "vefuse";
				};

				ldo_vemc {
					phandle = <0x55>;
					regulator-always-on;
					regulator-enable-ramp-delay = <0x2c>;
					regulator-max-microvolt = <0x325aa0>;
					regulator-min-microvolt = <0x2c4020>;
					regulator-name = "vemc";
				};

				ldo_vfe28 {
					phandle = <0x7f>;
					regulator-enable-ramp-delay = <0x108>;
					regulator-max-microvolt = <0x2ab980>;
					regulator-min-microvolt = <0x2ab980>;
					regulator-name = "vfe28";
				};

				ldo_vibr {
					phandle = <0x2>;
					regulator-enable-ramp-delay = <0x2c>;
					regulator-max-microvolt = <0x325aa0>;
					regulator-min-microvolt = <0x124f80>;
					regulator-name = "vibr";
				};

				ldo_vio18 {
					phandle = <0x91>;
					regulator-enable-ramp-delay = <0x108>;
					regulator-max-microvolt = <0x1b7740>;
					regulator-min-microvolt = <0x1b7740>;
					regulator-name = "vio18";
				};

				ldo_vio28 {
					phandle = <0x90>;
					regulator-enable-ramp-delay = <0x108>;
					regulator-max-microvolt = <0x2ab980>;
					regulator-min-microvolt = <0x2ab980>;
					regulator-name = "vio28";
				};

				ldo_vldo28 {
					phandle = <0x8b>;
					regulator-enable-ramp-delay = <0x108>;
					regulator-max-microvolt = <0x2dc6c0>;
					regulator-min-microvolt = <0x2ab980>;
					regulator-name = "vldo28";
				};

				ldo_vmc {
					phandle = <0x5c>;
					regulator-enable-ramp-delay = <0x2c>;
					regulator-max-microvolt = <0x325aa0>;
					regulator-min-microvolt = <0x1b7740>;
					regulator-name = "vmc";
				};

				ldo_vmch {
					phandle = <0x5b>;
					regulator-enable-ramp-delay = <0x2c>;
					regulator-max-microvolt = <0x325aa0>;
					regulator-min-microvolt = <0x2c4020>;
					regulator-name = "vmch";
				};

				ldo_vrf12 {
					phandle = <0x82>;
					regulator-enable-ramp-delay = <0x6e>;
					regulator-max-microvolt = <0x124f80>;
					regulator-min-microvolt = <0x124f80>;
					regulator-name = "vrf12";
				};

				ldo_vrf18 {
					phandle = <0x81>;
					regulator-enable-ramp-delay = <0x6e>;
					regulator-max-microvolt = <0x1b7740>;
					regulator-min-microvolt = <0x1b7740>;
					regulator-name = "vrf18";
				};

				ldo_vsim1 {
					phandle = <0x93>;
					regulator-enable-ramp-delay = <0x108>;
					regulator-max-microvolt = <0x2f4d60>;
					regulator-min-microvolt = <0x19f0a0>;
					regulator-name = "vsim1";
				};

				ldo_vsim2 {
					phandle = <0x94>;
					regulator-enable-ramp-delay = <0x108>;
					regulator-max-microvolt = <0x2f4d60>;
					regulator-min-microvolt = <0x19f0a0>;
					regulator-name = "vsim2";
				};

				ldo_vsram_others {
					phandle = <0x8c>;
					regulator-enable-ramp-delay = <0x6e>;
					regulator-max-microvolt = <0x1406f4>;
					regulator-min-microvolt = <0x7ea5e>;
					regulator-name = "vsram_others";
					regulator-ramp-delay = <0x186a>;
				};

				ldo_vsram_proc {
					phandle = <0x8d>;
					regulator-enable-ramp-delay = <0x6e>;
					regulator-max-microvolt = <0x1406f4>;
					regulator-min-microvolt = <0x7ea5e>;
					regulator-name = "vsram_proc";
					regulator-ramp-delay = <0x186a>;
				};

				ldo_vusb33 {
					phandle = <0x95>;
					regulator-enable-ramp-delay = <0x108>;
					regulator-max-microvolt = <0x2f4d60>;
					regulator-min-microvolt = <0x2dc6c0>;
					regulator-name = "vusb33";
				};

				ldo_vxo22 {
					phandle = <0x80>;
					regulator-enable-ramp-delay = <0x6e>;
					regulator-max-microvolt = <0x249f00>;
					regulator-min-microvolt = <0x2191c0>;
					regulator-name = "vxo22";
				};
			};

			mt63xx-oc-debug {
				compatible = "mediatek,mt63xx-oc-debug";
			};

			mtk_battery_oc_throttling {
				compatible = "mediatek,mt6357-battery_oc_throttling";
				oc-thd-h = <0x123e>;
				oc-thd-l = <0x157c>;
			};

			mtk_charger_type {
				bc12_active = <0x0>;
				compatible = "mediatek,mt6357-charger-type";
				io-channel-names = "pmic_vbus";
				io-channels = <0x27 0x2>;
				phandle = <0x77>;
			};

			mtk_dynamic_loading_throttling {
				compatible = "mediatek,mt6357-dynamic_loading_throttling";
				io-channel-names = "pmic_ptim", "pmic_imix_r", "pmic_isense", "pmic_batadc";
				io-channels = <0x27 0xf 0x27 0x10 0x27 0x1 0x27 0x0>;
				isense_support;
				mediatek,charger = <0x2e>;
				uvlo-level = <0xa28>;
			};

			mtk_gauge {
				ACTIVE_TABLE = <0x6>;
				CAR_TUNE_VALUE = <0x64>;
				COM_FG_METER_RESISTANCE = <0x64>;
				COM_R_FG_VALUE = <0x0>;
				DIFFERENCE_FULLOCV_ITH = <0xc8>;
				EMBEDDED_SEL = <0x1>;
				FG_METER_RESISTANCE = <0x4b>;
				KEEP_100_PERCENT = <0x1>;
				MULTI_TEMP_GAUGE0 = <0x1>;
				PMIC_MIN_VOL = <0x82dc>;
				PMIC_SHUTDOWN_CURRENT = <0x14>;
				POWERON_SYSTEM_IBOOT = <0x1f4>;
				Q_MAX_SYS_VOLTAGE_BAT0 = <0xd16>;
				Q_MAX_SYS_VOLTAGE_BAT1 = <0xd16>;
				Q_MAX_SYS_VOLTAGE_BAT2 = <0xd16>;
				Q_MAX_SYS_VOLTAGE_BAT3 = <0xd16>;
				RBAT_PULL_UP_R = <0x4204>;
				RBAT_PULL_UP_VOLT = <0x708>;
				R_FG_VALUE = <0xa>;
				SHUTDOWN_1_TIME = <0x1e>;
				SHUTDOWN_GAUGE0_VOLTAGE = <0x84d0>;
				TEMPERATURE_T0 = <0x32>;
				TEMPERATURE_T1 = <0x19>;
				TEMPERATURE_T2 = <0xa>;
				TEMPERATURE_T3 = <0x0>;
				TEMPERATURE_T4 = <0xfffffff6>;
				TEMPERATURE_T5 = <0xffffffec>;
				battery0_profile_t0 = <0x0 0xaa86 0x379 0x1f5 0xa9ca 0x379 0x3ea 0xa92d 0x37b 0x5df 0xa89b 0x37c 0x7d4 0xa80e 0x375 0x9c9 0xa78a 0x376 0xbbe 0xa70b 0x375 0xdb3 0xa691 0x378 0xfa8 0xa61c 0x37f 0x119d 0xa5a2 0x376 0x1392 0xa52c 0x37f 0x1587 0xa4b8 0x37e 0x177c 0xa444 0x37e 0x1971 0xa3d1 0x37c 0x1b66 0xa361 0x381 0x1d5b 0xa2ef 0x387 0x1f50 0xa282 0x388 0x2145 0xa212 0x387 0x233a 0xa1a1 0x385 0x252f 0xa135 0x38a 0x2724 0xa0ca 0x38e 0x2919 0xa060 0x390 0x2b0e 0x9ff5 0x394 0x2d03 0x9f8e 0x399 0x2ef8 0x9f26 0x397 0x30ed 0x9ec3 0x39c 0x32e2 0x9e6e 0x3b7 0x34d7 0x9e1c 0x3c0 0x36cc 0x9db8 0x3c5 0x38c1 0x9d2c 0x3b1 0x3ab6 0x9cb2 0x3b4 0x3cab 0x9c59 0x3b6 0x3ea0 0x9c21 0x3d2 0x4095 0x9bd9 0x3c5 0x428a 0x9b8a 0x3cb 0x447f 0x9b36 0x3cb 0x4674 0x9aeb 0x3dd 0x4869 0x9a9b 0x3dd 0x4a5e 0x9a4e 0x3e9 0x4c53 0x9a02 0x3f7 0x4e48 0x99b7 0x3fd 0x503d 0x9967 0x409 0x51df 0x9921 0x40b 0x5380 0x98c8 0x3fb 0x5575 0x9845 0x3c8 0x576a 0x97c5 0x39f 0x595f 0x975a 0x384 0x5b54 0x9709 0x379 0x5d49 0x96c7 0x37c 0x5f3e 0x9689 0x37f 0x608c 0x9663 0x37c 0x61da 0x963f 0x379 0x63cf 0x9607 0x37b 0x65c4 0x95d3 0x379 0x67b9 0x95a8 0x37e 0x69ae 0x9574 0x37b 0x6ba3 0x954b 0x37e 0x6d98 0x9522 0x382 0x6f8d 0x94fe 0x390 0x7182 0x94d3 0x38a 0x7377 0x94b0 0x38d 0x756c 0x948d 0x391 0x7761 0x946e 0x39c 0x7956 0x944b 0x39d 0x7b4b 0x942c 0x3a0 0x7d40 0x9411 0x3a2 0x7f35 0x93f4 0x3a8 0x812a 0x93db 0x3b4 0x831f 0x93c2 0x3ba 0x8514 0x93a7 0x3ba 0x8709 0x938c 0x3bd 0x88fe 0x9365 0x3b4 0x8af3 0x9321 0x394 0x8ce8 0x92d0 0x376 0x8edd 0x9296 0x37f 0x90d2 0x926b 0x382 0x92c7 0x9244 0x382 0x94bc 0x921c 0x387 0x96b1 0x91ef 0x382 0x98a6 0x91ca 0x382 0x9a9b 0x91ab 0x388 0x9c90 0x918e 0x397 0x9e85 0x9166 0x39c 0xa07a 0x9133 0x396 0xa26f 0x90f7 0x396 0xa464 0x90b5 0x38e 0xa659 0x9081 0x39f 0xa84e 0x903f 0x39c 0xaa43 0x8fec 0x384 0xac38 0x8fbd 0x379 0xae2d 0x8fb4 0x38a 0xb022 0x8fac 0x39f 0xb217 0x8fa2 0x3c0 0xb40c 0x8f8d 0x3ee 0xb601 0x8f5b 0x412 0xb7f6 0x8ea2 0x3ec 0xb9eb 0x8d13 0x3c8 0xbbe0 0x8af9 0x3e6 0xbdd5 0x8824 0x40a 0xbfca 0x83c3 0x456 0xc19d 0x7b5e 0xc77>;
				battery0_profile_t0_col = <0x3>;
				battery0_profile_t0_num = <0x64>;
				battery0_profile_t1 = <0x0 0xab26 0x43b 0x1f5 0xaa4c 0x459 0x3ea 0xa99b 0x45c 0x5df 0xa8f7 0x456 0x7d4 0xa863 0x456 0x9c9 0xa7d8 0x453 0xbbe 0xa75c 0x459 0xdb3 0xa6e2 0x456 0xfa8 0xa66a 0x456 0x119d 0xa5f0 0x44d 0x1392 0xa581 0x456 0x1587 0xa50d 0x454 0x177c 0xa499 0x453 0x1971 0xa42a 0x456 0x1b66 0xa3be 0x45f 0x1d5b 0xa34d 0x459 0x1f50 0xa2df 0x462 0x2145 0xa26f 0x462 0x233a 0xa206 0x46e 0x252f 0xa194 0x468 0x2724 0xa125 0x46e 0x2919 0xa0bb 0x477 0x2b0e 0xa04e 0x47f 0x2d03 0x9fe5 0x483 0x2ef8 0x9f8a 0x492 0x30ed 0x9f45 0x4a9 0x32e2 0x9f12 0x4cd 0x34d7 0x9ecf 0x4e7 0x36cc 0x9e51 0x4d2 0x38c1 0x9d95 0x4a9 0x3ab6 0x9cb8 0x537 0x3cab 0x9c25 0x61a 0x3ea0 0x9bbc 0x57d 0x4095 0x9b70 0x534 0x428a 0x9b34 0x50e 0x447f 0x9b0a 0x508 0x4674 0x9af4 0x513 0x4869 0x9ad3 0x50d 0x4a5e 0x9a90 0x4ec 0x4c53 0x9a46 0x4de 0x4e48 0x99f9 0x4de 0x503d 0x99af 0x4db 0x51df 0x9967 0x4d7 0x5380 0x9916 0x4c0 0x5575 0x98ab 0x4a0 0x576a 0x9831 0x469 0x595f 0x97b9 0x436 0x5b54 0x9754 0x410 0x5d49 0x9703 0x3fd 0x5f3e 0x96bb 0x3f2 0x6133 0x9681 0x3ef 0x6328 0x964b 0x409 0x651d 0x9613 0x410 0x6712 0x95e2 0x412 0x6907 0x95b4 0x415 0x6afc 0x9585 0x40f 0x6cf1 0x955b 0x418 0x6ee6 0x9536 0x424 0x70db 0x9511 0x42a 0x72d0 0x94e8 0x42d 0x74c5 0x94c7 0x433 0x76ba 0x94a8 0x43c 0x78af 0x9489 0x442 0x7aa4 0x9467 0x447 0x7c99 0x944b 0x44d 0x7e8e 0x9430 0x453 0x8083 0x9413 0x453 0x8278 0x9400 0x459 0x846d 0x93e7 0x45d 0x8662 0x93ce 0x462 0x8857 0x93b4 0x465 0x8a4c 0x939f 0x46b 0x8c41 0x9382 0x460 0x8e36 0x9367 0x45a 0x902b 0x9342 0x44b 0x9220 0x9321 0x445 0x9415 0x92fe 0x43f 0x960a 0x92d6 0x43b 0x97ff 0x92af 0x439 0x99f4 0x9288 0x43c 0x9be9 0x926b 0x444 0x9dde 0x924a 0x444 0x9fd3 0x9226 0x44c 0xa1c8 0x91f5 0x44e 0xa3bd 0x91bb 0x450 0xa5b2 0x917d 0x456 0xa7a7 0x9145 0x45c 0xa99c 0x910c 0x468 0xab91 0x90b9 0x461 0xad86 0x906c 0x459 0xaf7b 0x9051 0x46b 0xb170 0x9043 0x47d 0xb365 0x9035 0x48b 0xb55a 0x9026 0x4a9 0xb74f 0x900d 0x4d2 0xb944 0x8fcd 0x501 0xbb39 0x8ee0 0x4f3 0xbd2e 0x8d13 0x4f8 0xbf23 0x8aa9 0x539 0xc118 0x874b 0x596 0xc30d 0x818f 0x667>;
				battery0_profile_t1_col = <0x3>;
				battery0_profile_t1_num = <0x64>;
				battery0_profile_t2 = <0x0 0xab00 0x95b 0x1f5 0xaa32 0x95b 0x3ea 0xa988 0x955 0x5df 0xa8eb 0x940 0x7d4 0xa856 0x931 0x9c9 0xa7d0 0x931 0xbbf 0xa752 0x923 0xdb5 0xa6da 0x917 0xfaa 0xa66a 0x90b 0x11a0 0xa5f9 0x8e5 0x1395 0xa58b 0x8d6 0x158a 0xa517 0x8c3 0x177f 0xa4a8 0x8b5 0x1974 0xa43a 0x8b3 0x1b69 0xa3d1 0x8b2 0x1d5e 0xa361 0x8a9 0x1f53 0xa2f4 0x8a3 0x2148 0xa28c 0x8a9 0x233d 0xa21f 0x8aa 0x2532 0xa1b1 0x8a3 0x2727 0xa142 0x8a6 0x291c 0xa0d6 0x8aa 0x2b11 0xa06d 0x8aa 0x2d06 0xa00c 0x8af 0x2efb 0x9fc1 0x8df 0x30f0 0x9f83 0x924 0x32e5 0x9f48 0x95b 0x34da 0x9ef5 0x969 0x36cf 0x9e68 0x93d 0x38c4 0x9d9c 0x8dc 0x3ab9 0x9cc7 0x883 0x3cae 0x9c23 0x85f 0x3ea3 0x9bae 0x857 0x4098 0x9b51 0x84b 0x428d 0x9b0c 0x856 0x4482 0x9aca 0x857 0x4677 0x9a9b 0x86b 0x486c 0x9a6d 0x87a 0x4a61 0x9a3a 0x877 0x4c56 0x99fe 0x868 0x4e4b 0x99b7 0x84b 0x5040 0x995c 0x824 0x5235 0x98f9 0x7f8 0x542a 0x9896 0x7d2 0x561f 0x982d 0x7a3 0x5814 0x97c7 0x77c 0x5a09 0x9775 0x76b 0x5bfe 0x9722 0x753 0x5df3 0x96e0 0x74b 0x5f95 0x96a7 0x73e 0x60e3 0x9680 0x743 0x6284 0x964f 0x73b 0x6479 0x961b 0x73b 0x666e 0x95e8 0x73c 0x6863 0x95bd 0x73e 0x6a58 0x958f 0x742 0x6c4d 0x9560 0x73b 0x6e42 0x9538 0x744 0x7037 0x9513 0x74a 0x722c 0x94ee 0x74e 0x7421 0x94c6 0x74a 0x7616 0x94a7 0x756 0x780b 0x9486 0x756 0x7a00 0x9469 0x758 0x7bf5 0x944b 0x75c 0x7dea 0x942e 0x75f 0x7fdf 0x9413 0x765 0x81d4 0x93fc 0x76d 0x83c9 0x93e5 0x76d 0x85be 0x93cf 0x774 0x87b3 0x93be 0x77d 0x89a8 0x93b0 0x786 0x8b9d 0x93a1 0x79a 0x8d92 0x9393 0x7af 0x8f87 0x937e 0x7c3 0x917c 0x9367 0x7d5 0x9371 0x934c 0x7ec 0x9566 0x9327 0x7fb 0x975b 0x9300 0x810 0x9950 0x92db 0x82e 0x9b45 0x92b8 0x857 0x9d3a 0x9291 0x878 0x9f2f 0x9267 0x8b3 0xa124 0x9233 0x8e1 0xa319 0x91f7 0x916 0xa50e 0x91bb 0x954 0xa703 0x9183 0x995 0xa8f8 0x913b 0x9d7 0xaaed 0x90f1 0xa20 0xace2 0x90a6 0xa67 0xaed7 0x907f 0xace 0xb0cc 0x906a 0xb4a 0xb2c1 0x9058 0xbde 0xb4b6 0x903f 0xc80 0xb6ab 0x9018 0xd53 0xb8a0 0x8fc5 0xe30 0xba95 0x8ef0 0xec9 0xbc8a 0x8d3c 0xf34 0xbe7f 0x8ace 0x108a 0xc074 0x8759 0x129a 0xc269 0x8172 0x16de>;
				battery0_profile_t2_col = <0x3>;
				battery0_profile_t2_num = <0x64>;
				battery0_profile_t3 = <0x0 0xab02 0xf9b 0x1f5 0xaa19 0xf9b 0x3ea 0xa95b 0xf92 0x5df 0xa8b8 0xf6f 0x7d4 0xa823 0xf43 0x9c9 0xa794 0xf18 0xbbe 0xa714 0xef8 0xdb3 0xa69c 0xed8 0xfa8 0xa62a 0xec1 0x119d 0xa5b9 0xea0 0x1392 0xa549 0xe7d 0x1587 0xa4d8 0xe66 0x177c 0xa46c 0xe4d 0x1971 0xa401 0xe3c 0x1b66 0xa391 0xe2a 0x1d5b 0xa32c 0xe19 0x1f50 0xa2be 0xe09 0x2145 0xa253 0xe06 0x233a 0xa1e7 0xdf1 0x252f 0xa17e 0xdf2 0x2724 0xa10e 0xde0 0x2919 0xa0a5 0xdd1 0x2b0e 0xa04a 0xddd 0x2d03 0x9ffb 0xe04 0x2ef8 0x9fb9 0xe32 0x30ed 0x9f75 0xe5f 0x32e2 0x9f24 0xe6d 0x34d7 0x9ea8 0xe38 0x3720 0x9dcd 0xdc1 0x3968 0x9ce1 0xd46 0x3b5d 0x9c34 0xd05 0x3d52 0x9bad 0xcdf 0x3f47 0x9b42 0xcc2 0x413c 0x9aeb 0xcb9 0x4331 0x9aa3 0xcb5 0x4526 0x9a61 0xcb3 0x471b 0x9a25 0xcb6 0x4910 0x99e5 0xcad 0x4b05 0x99a3 0xc99 0x4cfa 0x995a 0xc7a 0x4eef 0x990e 0xc60 0x50e4 0x98bb 0xc3d 0x52d9 0x9862 0xc0e 0x54ce 0x9809 0xbe7 0x56c3 0x97b5 0xbc3 0x58b8 0x976a 0xbb8 0x5aad 0x971e 0xba6 0x5ca2 0x96d7 0xb9d 0x5e97 0x9699 0xb9d 0x608c 0x9660 0xba0 0x622e 0x962f 0xb9a 0x63cf 0x9603 0xb9a 0x65c4 0x95cf 0xb9e 0x67b9 0x959d 0xb9a 0x69ae 0x9572 0xba4 0x6ba3 0x9546 0xbae 0x6d98 0x951f 0xbba 0x6f8d 0x94f8 0xbc4 0x7182 0x94d3 0xbcf 0x7377 0x94ae 0xbd8 0x756c 0x948d 0xbdf 0x7761 0x946b 0xbec 0x7956 0x944a 0xbf9 0x7b4b 0x942e 0xc02 0x7d40 0x9415 0xc19 0x7f35 0x9402 0xc37 0x812a 0x93f4 0xc60 0x831f 0x93e5 0xc8a 0x8514 0x93d9 0xcca 0x8709 0x93ca 0xd09 0x88fe 0x93be 0xd55 0x8af3 0x93b2 0xdab 0x8ce8 0x93a1 0xdf7 0x8edd 0x938f 0xe51 0x90d2 0x937a 0xeb1 0x92c7 0x9363 0xf13 0x94bc 0x934a 0xf7a 0x96b1 0x9327 0xfe5 0x98a6 0x9308 0x1052 0x9a9b 0x92df 0x10c5 0x9c90 0x92b7 0x1147 0x9e85 0x9288 0x11cb 0xa07a 0x925b 0x125f 0xa2c3 0x9214 0x130b 0xa50b 0x91ce 0x13cb 0xa700 0x918c 0x146d 0xa8f5 0x914e 0x152b 0xaaea 0x9112 0x15f6 0xacdf 0x90d3 0x16d0 0xaed4 0x90ab 0x17da 0xb0c9 0x9087 0x18fe 0xb2be 0x9068 0x1a40 0xb4b3 0x9041 0x1ba1 0xb6a8 0x8ff7 0x1d16 0xb89d 0x8f74 0x1e87 0xba92 0x8e87 0x1fe1 0xbc87 0x8cf8 0x2158 0xbe7c 0x8a7f 0x2313 0xc03f 0x87dd 0x2439 0xc202 0x8454 0x25a4 0xc439 0x7b69 0x220c>;
				battery0_profile_t3_col = <0x3>;
				battery0_profile_t3_num = <0x64>;
				battery0_profile_t4 = <0x0 0xab55 0x1634 0x1f6 0xaa23 0x1634 0x3ec 0xa93c 0x1636 0x5e2 0xa882 0x161c 0x7d8 0xa7da 0x15fe 0x9ce 0xa745 0x15e0 0xbc4 0xa6bd 0x15c3 0xdba 0xa63b 0x15a3 0xfb0 0xa5bf 0x157c 0x11a6 0xa547 0x155f 0x139c 0xa4d7 0x1541 0x1592 0xa466 0x151e 0x1788 0xa3fa 0x1503 0x197e 0xa38f 0x14ec 0x1b74 0xa323 0x14d7 0x1d6a 0xa2b8 0x14c3 0x1f60 0xa24c 0x1490 0x2156 0xa1e1 0x1467 0x234c 0xa177 0x143d 0x2542 0xa10c 0x140e 0x2738 0xa0a5 0x13ee 0x292e 0xa05c 0x13fd 0x2b24 0xa014 0x1421 0x2d1a 0x9fce 0x143e 0x2f10 0x9f7f 0x144a 0x3106 0x9f1a 0x142f 0x32fc 0x9e83 0x13e3 0x34f2 0x9db6 0x1360 0x36e8 0x9ce5 0x12ea 0x38de 0x9c36 0x129d 0x3ad4 0x9ba7 0x1271 0x3cca 0x9b37 0x1256 0x3ec0 0x9ad4 0x123f 0x40b6 0x9a80 0x1230 0x42ac 0x9a33 0x1224 0x44a2 0x99ef 0x1227 0x4698 0x99ab 0x121f 0x488e 0x9965 0x1213 0x4a84 0x991e 0x11fe 0x4c7a 0x98da 0x11de 0x4e70 0x9892 0x11cc 0x5066 0x9849 0x11b1 0x525c 0x9801 0x119d 0x5452 0x97bb 0x118b 0x5648 0x9772 0x1173 0x583e 0x972c 0x1162 0x5a34 0x96ea 0x1156 0x5c2a 0x96aa 0x1150 0x5e20 0x9670 0x1150 0x6016 0x9636 0x1135 0x6260 0x95f6 0x1149 0x64a9 0x95bb 0x1142 0x669f 0x958d 0x1138 0x6895 0x9562 0x113e 0x6a8b 0x9536 0x1139 0x6c81 0x950b 0x1138 0x6e77 0x94e6 0x113e 0x706e 0x94be 0x1144 0x7264 0x9499 0x1147 0x745b 0x9476 0x114f 0x7652 0x945d 0x1164 0x7848 0x9444 0x1182 0x7a3e 0x9436 0x11af 0x7c34 0x9427 0x11ed 0x7e2a 0x941b 0x123c 0x8020 0x940c 0x129a 0x8216 0x93fe 0x1302 0x840c 0x93f2 0x1373 0x8602 0x93e1 0x13dc 0x87f8 0x93d5 0x1459 0x89ee 0x93c6 0x14d7 0x8be4 0x93ba 0x155f 0x8dda 0x93a7 0x15ea 0x8fd0 0x9397 0x1683 0x91c6 0x9384 0x1720 0x93bc 0x9369 0x17bd 0x95b2 0x934f 0x1856 0x97a8 0x9336 0x18ff 0x999e 0x9317 0x19a7 0x9b94 0x92fa 0x1a61 0x9d8a 0x92ce 0x1b06 0x9f80 0x92a7 0x1bab 0xa176 0x927c 0x1c4b 0xa36c 0x9248 0x1ced 0xa562 0x9214 0x1d95 0xa758 0x91de 0x1e3d 0xa94e 0x91a2 0x1ee9 0xab44 0x916b 0x1fae 0xad3a 0x9131 0x2077 0xaf30 0x90fd 0x2146 0xb126 0x90d4 0x222a 0xb31c 0x90ac 0x2313 0xb512 0x9083 0x2402 0xb708 0x905a 0x24fd 0xb8fe 0x901e 0x25e9 0xbaf4 0x8faa 0x26a6 0xbcea 0x8ec4 0x2745 0xbee0 0x8d2e 0x27f4 0xc0d6 0x8ab5 0x2977 0xc2cc 0x86f4 0x2bda 0xc4c2 0x7eee 0x26e4>;
				battery0_profile_t4_col = <0x3>;
				battery0_profile_t4_num = <0x64>;
				battery0_profile_t5 = <0x0 0xab59 0x25e9 0x1f6 0xa9e9 0x25e9 0x3ec 0xa8d8 0x25b3 0x5e2 0xa7f7 0x251b 0x7d8 0xa73f 0x2487 0x9ce 0xa696 0x23de 0xbc4 0xa5ff 0x233f 0xdba 0xa577 0x22af 0xfb0 0xa4f8 0x2226 0x11a6 0xa483 0x21a8 0x139c 0xa411 0x2137 0x1592 0xa3aa 0x20d6 0x1788 0xa340 0x2074 0x197e 0xa2d5 0x2011 0x1b74 0xa26b 0x1fb8 0x1d6a 0xa206 0x1f5e 0x1f60 0xa19b 0x1f01 0x2156 0xa133 0x1eae 0x234c 0xa0da 0x1e78 0x2542 0xa090 0x1e5e 0x2738 0xa048 0x1e52 0x292e 0x9ff5 0x1e4c 0x2b24 0x9f96 0x1e38 0x2d1a 0x9f24 0x1dfc 0x2f10 0x9e97 0x1d9b 0x3106 0x9de2 0x1d13 0x32fc 0x9d1b 0x1c7d 0x34f2 0x9c66 0x1c01 0x36e8 0x9bcd 0x1bb4 0x38de 0x9b44 0x1b76 0x3ad4 0x9ad4 0x1b5b 0x3cca 0x9a6f 0x1b58 0x3ec0 0x9a12 0x1b4a 0x40b6 0x99c2 0x1b4d 0x42ac 0x997b 0x1b58 0x44a2 0x9933 0x1b56 0x4698 0x98f1 0x1b62 0x488e 0x98a8 0x1b58 0x4a84 0x9864 0x1b50 0x4c7a 0x9824 0x1b50 0x4e70 0x97e2 0x1b44 0x5066 0x97a2 0x1b3e 0x525c 0x9766 0x1b39 0x5452 0x9728 0x1b30 0x5648 0x96ea 0x1b2d 0x583e 0x96b0 0x1b24 0x5a34 0x9678 0x1b1d 0x5c2a 0x9643 0x1b23 0x5e20 0x9609 0x1b1e 0x6016 0x95d7 0x1b26 0x620c 0x95a6 0x1b26 0x6402 0x9576 0x1b2d 0x65f8 0x9547 0x1b35 0x67ee 0x9517 0x1b39 0x69e4 0x94f0 0x1b42 0x6bda 0x94cd 0x1b5c 0x6dd0 0x94ae 0x1b7a 0x6fc6 0x9491 0x1b9f 0x71bc 0x947c 0x1be0 0x73b2 0x9467 0x1c24 0x75a8 0x9453 0x1c78 0x779e 0x9442 0x1cd5 0x7994 0x9434 0x1d3a 0x7b8a 0x9423 0x1db0 0x7d80 0x9415 0x1dfd 0x7f76 0x93fe 0x1e5b 0x816c 0x93f0 0x1ecf 0x8362 0x93db 0x1f50 0x85ac 0x93c7 0x1ffb 0x87f5 0x93b2 0x20aa 0x89eb 0x939f 0x2143 0x8be1 0x9389 0x21d4 0x8dd7 0x9372 0x2268 0x8fcd 0x935b 0x22fb 0x91c3 0x9342 0x238e 0x93b9 0x932b 0x2422 0x95af 0x9311 0x24b0 0x97a5 0x92f6 0x2535 0x999b 0x92d7 0x25b2 0x9b91 0x92b8 0x262d 0x9d87 0x9297 0x269e 0x9f7d 0x9273 0x2713 0xa173 0x9248 0x2775 0xa369 0x921e 0x27de 0xa55f 0x91f1 0x2849 0xa755 0x91c1 0x28b3 0xa94b 0x9194 0x292a 0xab41 0x9166 0x29a2 0xad37 0x913d 0x2a27 0xaf2d 0x9114 0x2ab9 0xb123 0x90ec 0x2b58 0xb319 0x90c5 0x2c11 0xb50f 0x9098 0x2ce9 0xb705 0x905e 0x2dd5 0xb8fb 0x9001 0x2edf 0xbaf1 0x8f6c 0x300f 0xbce7 0x8e72 0x3175 0xbedd 0x8ce9 0x332f 0xc0d3 0x8abe 0x3520 0xc2c9 0x86a3 0x3210 0xc494 0x7ff2 0x2884>;
				battery0_profile_t5_col = <0x3>;
				battery0_profile_t5_num = <0x64>;
				battery1_profile_t0 = <0x0 0xab43 0x399 0x1f6 0xaa25 0x399 0x3eb 0xa9b6 0x3a3 0x5e1 0xa943 0x39e 0x7d6 0xa8d7 0x3a2 0x9cc 0xa85e 0x399 0xbc1 0xa7f1 0x3a6 0xdb7 0xa775 0x399 0xfac 0xa702 0x3a2 0x11a2 0xa68d 0x3a2 0x1397 0xa617 0x3a3 0x158d 0xa59e 0x3a2 0x1782 0xa528 0x3a2 0x1978 0xa4b5 0x3ab 0x1b6d 0xa440 0x3a6 0x1d63 0xa3cd 0x3ab 0x1f58 0xa357 0x3a6 0x214e 0xa2e4 0x3ab 0x2343 0xa272 0x3b0 0x2539 0xa202 0x3b0 0x272e 0xa192 0x3ab 0x2924 0xa123 0x3b0 0x2b19 0xa0b9 0x3bc 0x2d0f 0xa04a 0x3b5 0x2f04 0x9fda 0x3ab 0x2fff 0x9fa9 0x3b4 0x30fa 0x9f77 0x3bd 0x32ef 0x9f14 0x3c1 0x34e5 0x9eaa 0x3bc 0x36da 0x9e47 0x3c6 0x38d0 0x9de4 0x3c6 0x3ac5 0x9d87 0x3ce 0x3cbb 0x9d27 0x3d3 0x3eb0 0x9ccd 0x3dc 0x40a6 0x9c73 0x3e4 0x429b 0x9c1c 0x3ed 0x4491 0x9bc5 0x3f6 0x4686 0x9b75 0x404 0x487c 0x9b1e 0x40c 0x4a71 0x9aca 0x419 0x4c67 0x9a70 0x422 0x4e5c 0x9a01 0x414 0x5052 0x996c 0x3e0 0x5247 0x98db 0x3ab 0x543d 0x986e 0x3a2 0x5632 0x981a 0x399 0x5828 0x97d0 0x399 0x5a1d 0x978b 0x399 0x5c13 0x974d 0x394 0x5e08 0x970c 0x394 0x5ffe 0x96d5 0x399 0x61f3 0x969d 0x399 0x63e9 0x9662 0x391 0x65de 0x9636 0x39d 0x67d4 0x9602 0x39e 0x69c9 0x95d0 0x394 0x6bbf 0x95a5 0x3a3 0x6db4 0x9579 0x3a6 0x6faa 0x954b 0x39e 0x719f 0x9526 0x3a3 0x7395 0x9500 0x3af 0x758a 0x94db 0x3b4 0x7780 0x94b6 0x3b4 0x7975 0x9494 0x3bd 0x7b6a 0x9478 0x3ca 0x7d5f 0x9453 0x3c6 0x7f54 0x9437 0x3ca 0x8149 0x9418 0x3ce 0x833e 0x93f9 0x3d8 0x8533 0x93d1 0x3d3 0x8728 0x9390 0x3b9 0x891d 0x933c 0x39e 0x8b13 0x92fb 0x3a2 0x8d08 0x92c6 0x3a3 0x8efe 0x929b 0x3a6 0x8ff8 0x9283 0x3a9 0x90f3 0x926c 0x3ab 0x92e9 0x923e 0x3a6 0x94de 0x9212 0x3a7 0x96d4 0x91e7 0x3a6 0x98c9 0x91c2 0x3a6 0x9abf 0x919c 0x3b0 0x9cb4 0x9177 0x3c1 0x9ea9 0x9140 0x3bd 0xa09f 0x90fe 0x3b4 0xa295 0x90c4 0x3b0 0xa48a 0x908f 0x3c1 0xa67f 0x904b 0x3c1 0xa875 0x8ff7 0x399 0xaa6b 0x8fd8 0x3a3 0xac60 0x8fce 0x3b3 0xae56 0x8fc5 0x3ca 0xb04b 0x8fbc 0x3f2 0xb241 0x8fa9 0x42b 0xb436 0x8f7e 0x453 0xb62c 0x8ed7 0x423 0xb821 0x8d5c 0x3f6 0xba17 0x8b6c 0x410 0xbc0c 0x88d5 0x42f 0xbe02 0x852d 0x477 0xbff7 0x7eea 0x5ba>;
				battery1_profile_t0_col = <0x3>;
				battery1_profile_t0_num = <0x64>;
				battery1_profile_t1 = <0x0 0xab3d 0x4ed 0x1f6 0xaab4 0x4ed 0x3eb 0xaa41 0x4fb 0x5e1 0xa9cf 0x4f7 0x7d6 0xa95f 0x4fb 0x9cc 0xa8e9 0x4fb 0xbc1 0xa873 0x4f7 0xdb7 0xa7fe 0x4f7 0xfac 0xa78b 0x4f7 0x11a2 0xa70f 0x4ed 0x1397 0xa699 0x4ea 0x158d 0xa623 0x4f2 0x1782 0xa5aa 0x4ea 0x1978 0xa538 0x4ee 0x1b6d 0xa4bf 0x4e9 0x1d63 0xa44c 0x4ea 0x1f58 0xa3d6 0x4e6 0x214e 0xa364 0x4e5 0x2343 0xa2f1 0x4e5 0x2539 0xa27b 0x4dd 0x272e 0xa20f 0x4e6 0x2924 0xa19f 0x4e6 0x2b19 0xa12c 0x4e1 0x2d0f 0xa0c6 0x4ea 0x2f04 0xa056 0x4ee 0x30fa 0x9fed 0x4ed 0x32ef 0x9f84 0x4ef 0x34e5 0x9f20 0x4f7 0x36da 0x9ec0 0x500 0x38d0 0x9e5a 0x504 0x3ac5 0x9df7 0x511 0x3cbb 0x9d90 0x512 0x3eb0 0x9d2d 0x516 0x40a6 0x9ccd 0x51a 0x429b 0x9c73 0x51f 0x4491 0x9c1f 0x530 0x4686 0x9bcc 0x539 0x487c 0x9b7b 0x542 0x4a71 0x9b24 0x542 0x4c67 0x9ace 0x54c 0x4e5c 0x9a6b 0x54c 0x5052 0x99ee 0x527 0x5247 0x9963 0x4f3 0x543d 0x98da 0x4c2 0x5632 0x986b 0x4a3 0x5828 0x9811 0x491 0x5a1d 0x97c4 0x489 0x5c13 0x9782 0x48d 0x5e08 0x9741 0x489 0x5ffe 0x9703 0x47f 0x61f3 0x96cb 0x483 0x63e9 0x9697 0x488 0x65de 0x965f 0x484 0x67d4 0x9630 0x488 0x69c9 0x95ff 0x488 0x6bbf 0x95d3 0x48c 0x6db4 0x95a8 0x491 0x6faa 0x957a 0x492 0x719f 0x9557 0x49a 0x7395 0x952c 0x4a0 0x758a 0x950a 0x4a4 0x7780 0x94e5 0x4a7 0x7975 0x94c3 0x4ac 0x7b6b 0x94a4 0x4b0 0x7d60 0x9485 0x4b0 0x7f56 0x9469 0x4b9 0x814b 0x944a 0x4c3 0x8341 0x9431 0x4c6 0x8536 0x940f 0x4c3 0x872c 0x93f0 0x4c3 0x8921 0x93ce 0x4be 0x8b17 0x93a6 0x4b1 0x8d0c 0x9377 0x4ac 0x8f02 0x934f 0x4a3 0x90f7 0x9323 0x4a3 0x92ec 0x92f8 0x4a3 0x94e2 0x92cd 0x4a4 0x96d7 0x92a7 0x4ac 0x98cd 0x9282 0x4b0 0x9ac2 0x9263 0x4bd 0x9cb8 0x923e 0x4c2 0x9ead 0x9219 0x4d4 0xa0a3 0x91e1 0x4dd 0xa299 0x91a3 0x4e1 0xa48e 0x9168 0x4ea 0xa683 0x9136 0x4ff 0xa879 0x90f5 0x50c 0xaa6f 0x909e 0x509 0xac64 0x9066 0x512 0xae59 0x9054 0x528 0xb04f 0x9047 0x542 0xb245 0x9038 0x559 0xb43a 0x9025 0x577 0xb630 0x900d 0x5a9 0xb825 0x8fb0 0x5cc 0xba1b 0x8e95 0x5c7 0xbc10 0x8cbb 0x5e7 0xbe06 0x8a4c 0x631 0xbffb 0x86e5 0x6b2 0xc1f1 0x813d 0x7f5 0xc393 0x790d 0x1eb1>;
				battery1_profile_t1_col = <0x3>;
				battery1_profile_t1_num = <0x64>;
				battery1_profile_t2 = <0x0 0xab40 0xc44 0x1f6 0xaa92 0xc44 0x3eb 0xaa19 0xc4d 0x5e1 0xa9a3 0xc43 0x7d6 0xa930 0xc36 0x9cc 0xa8bb 0xc2d 0xbc1 0xa845 0xc13 0xdb7 0xa7cf 0xc02 0xfac 0xa75c 0xbf3 0x11a2 0xa6e3 0xbd5 0x1397 0xa66e 0xbc3 0x158d 0xa5f8 0xbb7 0x1782 0xa585 0xba0 0x1978 0xa509 0xb85 0x1b6d 0xa497 0xb75 0x1d63 0xa421 0xb55 0x1f58 0xa3b4 0xb4c 0x214e 0xa33e 0xb35 0x2343 0xa2cf 0xb24 0x2539 0xa25c 0xb0f 0x272e 0xa1f0 0xb05 0x2924 0xa180 0xaf4 0x2b19 0xa114 0xae6 0x2d0f 0xa0a7 0xada 0x2f04 0xa03e 0xacc 0x307c 0x9fee 0xac1 0x31f4 0x9fa3 0xabf 0x33ea 0x9f43 0xab6 0x35df 0x9ee3 0xab6 0x37d5 0x9e86 0xaba 0x39ca 0x9e1c 0xaa8 0x3bc0 0x9da0 0xa80 0x3db5 0x9d24 0xa65 0x3fab 0x9cae 0xa4f 0x41a0 0x9c45 0xa47 0x4396 0x9beb 0xa42 0x458b 0x9ba0 0xa46 0x4781 0x9b50 0xa42 0x4976 0x9af3 0xa1f 0x4b6c 0x9a8c 0xa04 0x4d61 0x9a1d 0x9d7 0x4f57 0x99a7 0x9ac 0x514c 0x9931 0x984 0x5342 0x98be 0x957 0x5537 0x985e 0x941 0x572d 0x9807 0x938 0x5922 0x97b7 0x92c 0x5b18 0x9773 0x92c 0x5d0d 0x972e 0x92b 0x5f03 0x96f1 0x92c 0x607b 0x96c4 0x92c 0x61f3 0x969a 0x930 0x63e9 0x9662 0x930 0x65de 0x9630 0x934 0x67d4 0x95fc 0x934 0x69c9 0x95ca 0x930 0x6bbf 0x959f 0x946 0x6db4 0x9570 0x94b 0x6faa 0x9548 0x953 0x719f 0x951f 0x960 0x7395 0x94fd 0x969 0x758a 0x94d5 0x977 0x7780 0x94b0 0x97b 0x7975 0x948e 0x989 0x7b6b 0x946f 0x99b 0x7d60 0x944d 0x9a2 0x7f56 0x9434 0x9b1 0x814b 0x9412 0x9ba 0x8341 0x93f9 0x9c3 0x8536 0x93e6 0x9dc 0x872c 0x93d4 0x9eb 0x8921 0x93be 0xa00 0x8b17 0x93ac 0xa16 0x8d0c 0x9396 0xa39 0x8f02 0x937a 0xa59 0x907a 0x9361 0xa6c 0x91f2 0x9345 0xa84 0x93e7 0x931d 0xa9f 0x95dd 0x92f2 0xacc 0x97d2 0x92c9 0xafc 0x99c7 0x92a7 0xb43 0x9bbd 0x927f 0xb85 0x9db2 0x924d 0xbd5 0x9fa8 0x9212 0xc2e 0xa19d 0x91ce 0xc86 0xa393 0x9193 0xcf9 0xa588 0x915f 0xd7a 0xa77e 0x9111 0xdf1 0xa974 0x90ba 0xe77 0xab69 0x9076 0xf15 0xad5f 0x9057 0xfd8 0xaf54 0x9041 0x10bf 0xb14a 0x9028 0x11c4 0xb33f 0x900d 0x12ee 0xb535 0x8fee 0x1459 0xb72a 0x8f9d 0x15fd 0xb920 0x8ea8 0x17bc 0xbb15 0x8ce3 0x1a00 0xbd0b 0x8a77 0x1d69 0xbf00 0x871d 0x21df 0xc0f6 0x81e7 0x26ed>;
				battery1_profile_t2_col = <0x3>;
				battery1_profile_t2_num = <0x64>;
				battery1_profile_t3 = <0x0 0xab40 0x148d 0x1f6 0xaaae 0x148d 0x3eb 0xaa22 0x14d4 0x5e1 0xa9a3 0x14dd 0x7d6 0xa921 0x14d9 0x9cc 0xa8a2 0x14cc 0xbc1 0xa829 0x14bd 0xdb7 0xa7aa 0x149a 0xfac 0xa72e 0x1484 0x11a2 0xa6b5 0x146f 0x1397 0xa63c 0x1459 0x158d 0xa5c3 0x1439 0x1782 0xa547 0x1428 0x1978 0xa4d2 0x1416 0x1b6d 0xa45f 0x13f7 0x1d63 0xa3e9 0x13d3 0x1f58 0xa376 0x13bd 0x214e 0xa307 0x139e 0x2343 0xa294 0x1383 0x2539 0xa224 0x135c 0x272e 0xa1b8 0x134e 0x2924 0xa148 0x1334 0x2b19 0xa0dc 0x1311 0x2d0f 0xa06c 0x12fb 0x2f04 0xa00c 0x12e9 0x30fa 0x9fac 0x12e0 0x32ef 0x9f52 0x12db 0x34e5 0x9eec 0x12c1 0x36da 0x9e82 0x12b0 0x38d0 0x9e0c 0x128c 0x3ac5 0x9d91 0x1265 0x3cbb 0x9d0e 0x1240 0x3eb0 0x9c8c 0x1214 0x40a6 0x9c20 0x1203 0x429b 0x9bb9 0x11fa 0x4491 0x9b63 0x11f1 0x4686 0x9b09 0x11e4 0x487c 0x9aac 0x11c5 0x4a71 0x9a48 0x11a1 0x4c67 0x99e5 0x1179 0x4e5c 0x9979 0x1148 0x5052 0x990c 0x1113 0x5247 0x98ac 0x10f8 0x543d 0x984f 0x10d9 0x5632 0x97f5 0x10c3 0x5828 0x97a4 0x10b6 0x5a1d 0x975d 0x10b2 0x5c13 0x9719 0x10a8 0x5e08 0x96d8 0x10a9 0x5ffe 0x9697 0x10a9 0x60f8 0x9679 0x10a4 0x61f3 0x965c 0x10a0 0x63e9 0x962a 0x10a9 0x65de 0x95f6 0x10aa 0x67d4 0x95c4 0x10b2 0x69c9 0x9598 0x10be 0x6bbf 0x956a 0x10c4 0x6db4 0x953b 0x10c3 0x6faa 0x9513 0x10d5 0x719f 0x94eb 0x10da 0x7395 0x94c9 0x10f4 0x758a 0x94a0 0x110a 0x7780 0x9481 0x1120 0x7975 0x9462 0x1136 0x7b6b 0x9447 0x1152 0x7d60 0x942e 0x116c 0x7f56 0x941b 0x119d 0x814b 0x940c 0x11d6 0x8341 0x93ff 0x120b 0x8536 0x93ed 0x1245 0x872c 0x93da 0x128c 0x8921 0x93cb 0x12db 0x8b17 0x93b8 0x1334 0x8d0c 0x93a2 0x1396 0x8f02 0x938a 0x1400 0x90f7 0x936b 0x1474 0x92ec 0x934c 0x14ef 0x94e2 0x9323 0x1574 0x96d7 0x92fe 0x160f 0x98cd 0x92d6 0x16bc 0x9ac2 0x92aa 0x1771 0x9cb8 0x9279 0x1846 0x9ead 0x923e 0x192c 0xa0a3 0x9200 0x1a20 0xa299 0x91bf 0x1b32 0xa48e 0x9184 0x1c44 0xa683 0x9146 0x1d5c 0xa879 0x90f8 0x1e76 0xaa6f 0x90a5 0x1f8a 0xac64 0x906a 0x2094 0xae59 0x904a 0x21a1 0xb04f 0x9035 0x22ac 0xb245 0x901c 0x2389 0xb43a 0x9006 0x2492 0xb630 0x8fe4 0x25b7 0xb825 0x8f8d 0x26e4 0xba1b 0x8e73 0x2810 0xbc10 0x8c86 0x29ef 0xbe06 0x89f2 0x2d16 0xbffb 0x8685 0x3122 0xc1f1 0x805b 0x2920>;
				battery1_profile_t3_col = <0x3>;
				battery1_profile_t3_num = <0x64>;
				battery1_profile_t4 = <0x0 0xab4c 0x2835 0x1f6 0xaa98 0x2835 0x3eb 0xa9d2 0x282c 0x5e1 0xa915 0x276e 0x7d6 0xa864 0x269d 0x9cc 0xa7c0 0x25d1 0xbc1 0xa72b 0x250e 0xdb7 0xa69c 0x2459 0xfac 0xa617 0x23b0 0x11a2 0xa595 0x2304 0x1397 0xa519 0x2269 0x158d 0xa4a0 0x21db 0x1782 0xa42d 0x2156 0x1978 0xa3c1 0x20db 0x1b6d 0xa354 0x2067 0x1d63 0xa2e8 0x1ff4 0x1f58 0xa278 0x1f97 0x214e 0xa20c 0x1f36 0x2343 0xa1a8 0x1eef 0x2539 0xa139 0x1e9b 0x272e 0xa0d9 0x1e4f 0x2924 0xa07c 0x1e1f 0x2b19 0xa01f 0x1dfb 0x2d0f 0x9fbf 0x1dca 0x2f04 0x9f52 0x1dab 0x30fa 0x9edc 0x1d69 0x32ef 0x9e60 0x1d22 0x34e5 0x9de4 0x1ce3 0x36da 0x9d65 0x1c9d 0x38d0 0x9cec 0x1c4d 0x3ac5 0x9c70 0x1c0b 0x3cbb 0x9bfd 0x1bda 0x3eb0 0x9b8e 0x1bb7 0x40a6 0x9b2b 0x1ba1 0x429b 0x9acb 0x1b8b 0x4491 0x9a6b 0x1b63 0x4686 0x9a0e 0x1b56 0x487c 0x99b4 0x1b3b 0x4a71 0x9957 0x1b2e 0x4c67 0x9900 0x1b25 0x4e5c 0x98ac 0x1b18 0x5052 0x9858 0x1b0a 0x5247 0x9808 0x1b07 0x543d 0x97bd 0x1af9 0x5632 0x9776 0x1af9 0x5828 0x9732 0x1af4 0x5a1d 0x96f1 0x1afd 0x5c13 0x96ac 0x1af4 0x5e08 0x9671 0x1afd 0x5ffe 0x963a 0x1b0f 0x61f3 0x9605 0x1b21 0x63e9 0x95d0 0x1b32 0x65de 0x95a5 0x1b52 0x67d4 0x9573 0x1b63 0x69c9 0x9548 0x1b6d 0x6bbf 0x951f 0x1b81 0x6db4 0x94fd 0x1bae 0x6faa 0x94d8 0x1bc4 0x719f 0x94b9 0x1bf9 0x7395 0x94a0 0x1c2a 0x758a 0x948b 0x1c5f 0x7780 0x9475 0x1c9e 0x7975 0x9462 0x1cdf 0x7b6b 0x944d 0x1d2b 0x7d60 0x9437 0x1d84 0x7f56 0x9421 0x1ddc 0x814b 0x940f 0x1e3d 0x8341 0x93fc 0x1eba 0x8536 0x93ea 0x1f2d 0x872c 0x93d1 0x1fa0 0x8921 0x93bb 0x201c 0x8b17 0x93a2 0x209d 0x8d0c 0x9386 0x2121 0x8f02 0x9371 0x21b3 0x90f7 0x9352 0x2238 0x92ec 0x9336 0x22ca 0x94e2 0x9314 0x2347 0x96d7 0x92ef 0x23ba 0x98cd 0x92c9 0x242d 0x9ac2 0x92a1 0x24a4 0x9cb8 0x9270 0x250b 0x9ead 0x923e 0x2567 0xa0a3 0x920c 0x25d5 0xa299 0x91d8 0x2645 0xa48e 0x919d 0x26b4 0xa683 0x9158 0x271e 0xa879 0x9111 0x2795 0xaa6f 0x90d0 0x282c 0xac64 0x90a1 0x28d8 0xae59 0x907c 0x29be 0xb04f 0x9060 0x2ada 0xb245 0x9047 0x2c52 0xb43a 0x9029 0x2e2d 0xb630 0x8ffa 0x30c9 0xb825 0x8f91 0x3470 0xba1b 0x8e77 0x39d6 0xbbc0 0x8d37 0x3b7f 0xbdb6 0x8c0b 0x39d2 0xbfab 0x89ca 0x369a 0xc1a1 0x860c 0x3146 0xc396 0x7f85 0x27f2>;
				battery1_profile_t4_col = <0x3>;
				battery1_profile_t4_num = <0x64>;
				battery1_profile_t5 = <0x0 0xab52 0x3038 0x1f6 0xaa95 0x3038 0x3eb 0xa9af 0x3001 0x5e1 0xa8da 0x2f17 0x7d6 0xa816 0x2e16 0x9cc 0xa762 0x2d1e 0xbc1 0xa6c1 0x2c4d 0xdb7 0xa626 0x2b83 0xfac 0xa598 0x2ac9 0x11a2 0xa50f 0x2a32 0x131a 0xa4b1 0x29d1 0x1492 0xa452 0x296f 0x1687 0xa3d6 0x28f3 0x187d 0xa35d 0x2884 0x1a72 0xa2e4 0x2819 0x1c68 0xa26c 0x27b9 0x1e5d 0xa1f9 0x2764 0x2053 0xa18a 0x2711 0x2248 0xa11d 0x26c0 0x243e 0xa0b7 0x2688 0x2633 0xa04a 0x263c 0x2829 0x9fd1 0x25f9 0x2a1e 0x9f55 0x25b3 0x2c14 0x9ed0 0x256b 0x2e09 0x9e4a 0x2525 0x2f81 0x9dea 0x24f7 0x30fa 0x9d87 0x24b2 0x32ef 0x9d05 0x2466 0x34e5 0x9c8f 0x2435 0x36da 0x9c23 0x240a 0x3852 0x9bd0 0x23e8 0x39ca 0x9b87 0x23d3 0x3bc0 0x9b27 0x23be 0x3db5 0x9aca 0x23b5 0x3fab 0x9a6d 0x23a3 0x41a0 0x9a10 0x2396 0x4396 0x99b6 0x2384 0x458b 0x995c 0x237f 0x4781 0x9906 0x2378 0x4976 0x98af 0x237c 0x4b6c 0x9861 0x2380 0x4d61 0x9814 0x2389 0x4f57 0x97c9 0x238d 0x514c 0x9782 0x2392 0x5342 0x9747 0x239f 0x5537 0x9700 0x2396 0x572d 0x96c8 0x23a3 0x5922 0x968a 0x23b1 0x5b18 0x9656 0x23bf 0x5d0d 0x9624 0x23dd 0x5e85 0x95fa 0x23e1 0x5ffd 0x95d7 0x23ef 0x61f3 0x95ab 0x240e 0x63e8 0x9586 0x2432 0x65de 0x955e 0x244c 0x67d3 0x9538 0x2473 0x69c9 0x951a 0x24a9 0x6bbe 0x94fb 0x24de 0x6db4 0x94e2 0x2525 0x6fa9 0x94c0 0x2563 0x719f 0x94a1 0x25a1 0x7394 0x9488 0x25f5 0x758a 0x946c 0x2641 0x777f 0x9453 0x269d 0x7975 0x9431 0x26ed 0x7b6a 0x9418 0x274f 0x7d60 0x93ff 0x27b4 0x7f55 0x93e0 0x281a 0x814b 0x93c8 0x2892 0x8340 0x93a8 0x2900 0x84b8 0x938e 0x294c 0x8630 0x937a 0x29a0 0x8826 0x935b 0x2a17 0x8a1b 0x933c 0x2a86 0x8c11 0x931d 0x2af9 0x8d89 0x9301 0x2b47 0x8f01 0x92e5 0x2b94 0x90f7 0x92c3 0x2c15 0x92ec 0x92a1 0x2c88 0x94e1 0x9279 0x2cf2 0x96d7 0x924d 0x2d6e 0x98cd 0x9225 0x2de1 0x9ac1 0x91f7 0x2e59 0x9cb6 0x91bf 0x2ecc 0x9eac 0x9190 0x2f54 0xa0a1 0x915c 0x2fdf 0xa296 0x912a 0x307e 0xa48c 0x9101 0x3141 0xa682 0x90d9 0x3227 0xa877 0x90b4 0x332c 0xa9ef 0x9093 0x3429 0xab67 0x9079 0x3563 0xad5d 0x9054 0x375c 0xaf52 0x9019 0x39f9 0xb148 0x8fc2 0x3bd3 0xb33d 0x8f3a 0x3cc2 0xb533 0x8e07 0x3ca8 0xb728 0x8cab 0x3ab7 0xb91e 0x8a52 0x375d 0xbb13 0x872f 0x32e6 0xbd09 0x81e8 0x2b5b>;
				battery1_profile_t5_col = <0x3>;
				battery1_profile_t5_num = <0x64>;
				bootmode = <0x2a>;
				charger = <0x29>;
				compatible = "mediatek,mt6357-gauge";
				enable_tmp_intr_suspend = <0x0>;
				g_FG_PSEUDO100_T0 = <0x64>;
				g_FG_PSEUDO100_T1 = <0x64>;
				g_FG_PSEUDO100_T2 = <0x63>;
				g_FG_PSEUDO100_T3 = <0x63>;
				g_FG_PSEUDO100_T4 = <0x64>;
				io-channel-names = "pmic_battery_temp", "pmic_battery_voltage", "pmic_bif_voltage", "pmic_ptim_voltage", "pmic_ptim_r";
				io-channels = <0x27 0x3 0x27 0x1 0x27 0xe 0x27 0xf 0x27 0x10>;
				nvmem-cell-names = "initialization", "state-of-charge";
				nvmem-cells = <0x2b 0x2c>;
				phandle = <0x68>;
			};

			mtk_rtc {
				#address-cells = <0x1>;
				#size-cells = <0x1>;
				bootmode = <0x2a>;
				compatible = "mediatek,mt6357-rtc";
				phandle = <0x96>;

				ext_32k {
					bits = <0x6 0x1>;
					phandle = <0x97>;
					reg = <0x2 0x1>;
				};

				fg_init {
					bits = <0x0 0x8>;
					phandle = <0x2b>;
					reg = <0x0 0x1>;
				};

				fg_soc {
					bits = <0x0 0x8>;
					phandle = <0x2c>;
					reg = <0x1 0x1>;
				};
			};

			mtk_ts_pmic {
				#interconnect-cells = <0x1>;
				compatible = "mediatek,mtk_ts_pmic";
				interconnects = <0x27 0x1>;
				io-channel-names = "pmic_chip_temp", "pmic_buck1_temp", "pmic_buck2_temp";
				io-channels = <0x27 0x5 0x27 0x6 0x27 0x7>;
				phandle = <0x2d>;
			};

			pmic_accdet {
				accdet-mic-mode = <0x1>;
				accdet-mic-vol = <0x6>;
				accdet-name = "mt63xx-accdet";
				accdet-plugout-debounce = <0x1>;
				compatible = "mediatek,mt6357-accdet";
				headset-eint-level-pol = <0x8>;
				headset-eint-num = <0x0>;
				headset-eint-trig-mode = <0x0>;
				headset-four-key-threshold = <0x0 0x3a 0x79 0xc0 0x190>;
				headset-key-mode = <0x0>;
				headset-mode-setting = <0x500 0x500 0x1 0x1f0 0x800 0x800 0x20 0x44>;
				headset-three-key-threshold = <0x0 0x50 0xdc 0x190>;
				headset-three-key-threshold-CDD = <0x0 0x79 0xc0 0x258>;
				headset-use-ap-eint = <0x0>;
				headset-vol-threshold = <0x0 0x24e 0x24f 0x690 0xa28>;
				io-channel-names = "pmic_accdet";
				io-channels = <0x27 0x9>;
				moisture-external-r = <0x72bf0>;
				moisture-ver = <0x1>;
				moisture-water-r = <0xc350>;
				moisture_use_ext_res = <0x1>;
				nvmem = <0x28>;
				nvmem-names = "mt63xx-accdet-efuse";
				phandle = <0x5e>;
				status = "okay";
			};

			pmic_auxadc {
				#interconnect-cells = <0x1>;
				#io-channel-cells = <0x1>;
				compatible = "mediatek,pmic-auxadc", "mediatek,mt6357-auxadc";
				phandle = <0x27>;

				accdet {
					channel = <0x9>;
				};

				bat_temp {
					channel = <0x3>;
					resistance-ratio = <0x1 0x1>;
				};

				batadc {
					avg-num = <0x80>;
					channel = <0x0>;
					resistance-ratio = <0x3 0x1>;
				};

				chip_temp {
					channel = <0x5>;
				};

				dcxo_temp {
					avg-num = <0x10>;
					channel = <0xd>;
				};

				hpofs_cal {
					avg-num = <0x100>;
					channel = <0xc>;
				};

				imix_r {
					channel = <0x10>;
				};

				imp {
					avg-num = <0x80>;
					channel = <0xf>;
					resistance-ratio = <0x3 0x1>;
				};

				isense {
					avg-num = <0x80>;
					channel = <0x1>;
					resistance-ratio = <0x3 0x1>;
				};

				tsx_temp {
					avg-num = <0x80>;
					channel = <0xb>;
				};

				vbif {
					channel = <0xe>;
					resistance-ratio = <0x1 0x1>;
				};

				vcdt {
					channel = <0x2>;
				};

				vcore_temp {
					channel = <0x6>;
				};

				vproc_temp {
					channel = <0x7>;
				};
			};

			pmic_codec {
				compatible = "mediatek,mt6357-sound";
				ctrl-mod = <0x1f 0x33 0x0>;
				io-channel-names = "pmic_codec", "pmic_accdet";
				io-channels = <0x27 0xc 0x27 0x9>;
				mediatek,pwrap-regmap = <0x2f>;
				nvmem = <0x28>;
				nvmem-names = "pmic-hp-efuse";
				phandle = <0x98>;
				use_hp_depop_flow = <0x0>;
				use_ul_260k = <0x0>;
			};

			pmic_efuse {
				#address-cells = <0x1>;
				#size-cells = <0x1>;
				compatible = "mediatek,mt6357-efuse";
				phandle = <0x28>;
			};

			pmic_lbat_service {
				compatible = "mediatek,mt6357-lbat_service";
			};
		};
	};

	radio_md_cfg {
		compatible = "mediatek,radio_md_cfg";
		phandle = <0xee>;
	};

	regulator_vibrator {
		compatible = "regulator-vibrator";
		max-limit = <0x3a98>;
		max-volt = <0x2dc6c0>;
		min-limit = <0xf>;
		min-volt = <0x2dc6c0>;
		vib-supply = <0x2>;
	};

	reserved-memory {
		#address-cells = <0x2>;
		#size-cells = <0x2>;
		phandle = <0x6d>;
		ranges;

		consys-reserve-memory {
			alignment = <0x0 0x1000000>;
			alloc-ranges = <0x0 0x40000000 0x0 0x80000000>;
			compatible = "mediatek,consys-reserve-memory";
			no-map;
			phandle = <0x4c>;
			size = <0x0 0x440000>;
		};

		ion-carveout-heap {
			alignment = <0x0 0x1000>;
			alloc-ranges = <0x0 0xc0000000 0x0 0x10000000>;
			compatible = "mediatek,ion-carveout-heap";
			no-map;
			size = <0x0 0x5000>;
		};

		reserve-memory-scp_share {
			alignment = <0x0 0x1000000>;
			alloc-ranges = <0x0 0x40000000 0x0 0x50000000>;
			compatible = "mediatek,reserve-memory-scp_share";
			no-map;
			size = <0x0 0x300000>;
		};

		reserve-memory-sspm_share {
			alignment = <0x0 0x10000>;
			alloc-ranges = <0x0 0x40000000 0x0 0x60000000>;
			compatible = "mediatek,reserve-memory-sspm_share";
			no-map;
			size = <0x0 0x510000>;
			status = "okay";
		};

		sec-autocomment-reserve-memory@0x47400000 {
			reg = <0x0 0x47400000 0x0 0x10000>;
		};

		sec-extrainfo-reserve-memory@0x47410000 {
			reg = <0x0 0x47410000 0x0 0x1f0000>;
		};

		sec-lastklog@0x46E00000 {
			reg = <0x0 0x46e00000 0x0 0x200000>;
		};

		sec-log-reserve-memory@0x46C00000 {
			reg = <0x0 0x46c00000 0x0 0x200000>;
		};

		sec-logger-reserve-memory@0x47000000 {
			reg = <0x0 0x47000000 0x0 0x400000>;
		};

		ssmr-reserved-cma_memory {
			alignment = <0x0 0x1000000>;
			alloc-range = <0x0 0xc0000000 0x0 0x10000000>;
			compatible = "shared-dma-pool";
			phandle = <0x6b>;
			reusable;
			size = <0x0 0x10000000>;
		};

		wifi-reserve-memory {
			alignment = <0x0 0x1000000>;
			alloc-ranges = <0x0 0x40000000 0x0 0x80000000>;
			compatible = "shared-dma-pool";
			no-map;
			phandle = <0x4d>;
			size = <0x0 0x300000>;
		};
	};

	rt-pd-manager {
		compatible = "mediatek,rt-pd-manager";
	};

	rt9465_slave_chr {
		compatible = "richtek,rt9465";
		phandle = <0xe8>;
		status = "disabled";
	};

	scp@10500000 {
		compatible = "mediatek,scp";
		core_1 = "enable";
		interrupts = <0x0 0xc0 0x4>;
		reg = <0x0 0x10500000 0x0 0x40000 0x0 0x105c0000 0x0 0x3000 0x0 0x105c4000 0x0 0x1000 0x0 0x105d4000 0x0 0x6000>;
		scp_feature_tbl = <0x0 0x2f 0x1 0x164 0x2 0x3e 0x3 0x2f 0x4 0x1a 0x5 0x0 0x6 0xc8 0x7 0x0 0x8 0x64 0x9 0xa>;
		scp_mem_key = "mediatek,reserve-memory-scp_share";
		scp_mem_tbl = <0x1 0x100000 0x4 0x200000>;
		scp_mpuRegionId = <0x1b>;
		scp_sramSize = <0x40000>;
		status = "okay";
	};

	scp_dvfs {
		clock-names = "clk_mux", "clk_pll_0", "clk_pll_1", "clk_pll_2", "clk_pll_3", "clk_pll_4", "clk_pll_5", "clk_pll_6";
		clocks = <0x26 0x63 0x24 0x26 0xe 0x26 0x1a 0x26 0x2 0x26 0x17 0x26 0x6 0x26 0x19>;
		compatible = "mediatek,scp_dvfs";
		dvfs-opp = <0xff 0xff 0xff 0x0 0x0 0xfa 0x0 0xff 0xff 0xff 0x0 0x0 0x111 0x3 0xff 0xff 0xff 0x2 0x8 0x14a 0x5 0xff 0xff 0xff 0x3 0xc 0x1a0 0x6>;
		dvfsrc-opp-num = <0x3>;
		gpio = <0x17 0x1>;
		gpio-feature = "gpio-mode";
		gpio-feature-cfg = <0x0>;
		pmic = <0x30>;
		pmic-feature = "pmic-vow-lp", "pmic-pmrc";
		pmic-feature-cfg = <0x0 0x0>;
	};

	scp_infra@10001000 {
		compatible = "mediatek,scpinfra";
		phandle = <0x70>;
		reg = <0x0 0x10001000 0x0 0x1000>;
	};

	scpsys@10001000 {
		#clock-cells = <0x1>;
		compatible = "mediatek,mt6765-scpsys", "syscon";
		phandle = <0x35>;
		reg = <0x0 0x10001000 0x0 0x1000 0x0 0x10006000 0x0 0x1000 0x0 0x14002000 0x0 0x1000 0x0 0x1020e000 0x0 0x1000 0x0 0x18004000 0x0 0x1000 0x0 0x18002000 0x0 0x1000>;
	};

	security_ao@1001a000 {
		compatible = "mediatek,security_ao";
		reg = <0x0 0x1001a000 0x0 0x1000>;
	};

	seninf1@1a040000 {
		compatible = "mediatek,seninf1";
		reg = <0x0 0x1a040000 0x0 0x1000>;
	};

	seninf2@1a041000 {
		compatible = "mediatek,seninf2";
		reg = <0x0 0x1a041000 0x0 0x1000>;
	};

	seninf3@1a042000 {
		compatible = "mediatek,seninf3";
		reg = <0x0 0x1a042000 0x0 0x1000>;
	};

	seninf4@1a043000 {
		compatible = "mediatek,seninf4";
		reg = <0x0 0x1a043000 0x0 0x1000>;
	};

	serial@11020000 {
		clock-names = "baud", "bus";
		clocks = <0x24 0x25 0x16>;
		compatible = "mediatek,mt6758-uart", "mediatek,mt6577-uart";
		dma-names = "tx", "rx";
		dmas = <0x49 0x0 0x49 0x1>;
		interrupts = <0x0 0x5b 0x8>;
		phandle = <0xa8>;
		reg = <0x0 0x11002000 0x0 0x1000>;
	};

	serial@11030000 {
		clock-names = "baud", "bus";
		clocks = <0x24 0x25 0x17>;
		compatible = "mediatek,mt6758-uart", "mediatek,mt6577-uart";
		interrupts = <0x0 0x5c 0x8>;
		phandle = <0xa9>;
		reg = <0x0 0x11003000 0x0 0x1000>;
	};

	silead_fp {
		compatible = "sil,silead_fp-pins";
		phandle = <0x9e>;
	};

	sleep@10006000 {
		compatible = "mediatek,sleep", "syscon";
		interrupts = <0x0 0xb5 0x8>;
		phandle = <0x62>;
		reg = <0x0 0x10006000 0x0 0x1000>;
		wakeup-source = <0x20 0x0 0x4 0x21 0x1 0x20 0x22 0x3 0x2000000>;
	};

	sleep_reg_md@1000f000 {
		compatible = "mediatek,sleep_reg_md";
		reg = <0x0 0x1000f000 0x0 0x1000>;
	};

	smart_pa {
		phandle = <0xf6>;
	};

	smi_common@14002000 {
		clock-names = "mtcmos-mm", "smi-common-gals-comm0", "smi-common-gals-comm1", "smi-common", "mmdvfs_clk_mm_sel_ck", "mmdvfs_clk_mmpll_ck", "mmdvfs_clk_univpll1_d2_ck", "mmdvfs_clk_mmpll_d2_ck";
		clocks = <0x35 0x3 0x63 0x15 0x63 0x16 0x63 0x13 0x26 0x62 0x26 0x21 0x26 0x17 0x26 0x22>;
		compatible = "mediatek,smi_common";
		mediatek,smi-cnt = <0x5>;
		mediatek,smi-id = <0x4>;
		mmsys_config = <0x3c>;
		phandle = <0xd2>;
		reg = <0x0 0x14002000 0x0 0x1000>;
	};

	smi_larb0@14003000 {
		cell-index = <0x0>;
		clock-names = "mtcmos-mm", "mm-larb0";
		clocks = <0x35 0x3 0x63 0x14>;
		compatible = "mediatek,smi_larb0", "mediatek,smi_larb";
		mediatek,larb-id = <0x0>;
		mediatek,smi-id = <0x0>;
		phandle = <0xd3>;
		reg = <0x0 0x14003000 0x0 0x1000>;
	};

	smi_larb1@17010000 {
		cell-index = <0x1>;
		clock-names = "mtcmos-vcodec", "venc-larb1";
		clocks = <0x35 0xa 0x66 0x1>;
		compatible = "mediatek,smi_larb1", "mediatek,smi_larb";
		mediatek,larb-id = <0x1>;
		mediatek,smi-id = <0x1>;
		phandle = <0xd8>;
		reg = <0x0 0x17010000 0x0 0x1000>;
	};

	smi_larb2@15021000 {
		cell-index = <0x2>;
		clock-names = "mtcmos-isp", "gals-img2mm", "img-larb2";
		clocks = <0x35 0x5 0x63 0x18 0x64 0x0>;
		compatible = "mediatek,smi_larb2", "mediatek,smi_larb";
		mediatek,larb-id = <0x2>;
		mediatek,smi-id = <0x2>;
		phandle = <0xd6>;
		reg = <0x0 0x15021000 0x0 0x1000>;
	};

	smi_larb3@1a002000 {
		cell-index = <0x3>;
		clock-names = "mtcmos-cam", "gals-cam2mm", "cam-larb3";
		clocks = <0x35 0x9 0x63 0x19 0x65 0x0>;
		compatible = "mediatek,smi_larb3", "mediatek,smi_larb";
		mediatek,larb-id = <0x3>;
		mediatek,smi-id = <0x3>;
		phandle = <0xda>;
		reg = <0x0 0x1a002000 0x0 0x1000>;
	};

	spi@1100a000 {
		clock-names = "parent-clk", "sel-clk", "spi-clk";
		clocks = <0x26 0xb 0x26 0x6b 0x25 0x1b>;
		compatible = "mediatek,mt6765-spi";
		interrupts = <0x0 0x76 0x8>;
		mediatek,pad-select = <0x0>;
		phandle = <0xb6>;
		reg = <0x0 0x1100a000 0x0 0x1000>;
	};

	spi@11010000 {
		clock-names = "parent-clk", "sel-clk", "spi-clk";
		clocks = <0x26 0xb 0x26 0x6b 0x25 0x34>;
		compatible = "mediatek,mt6765-spi";
		interrupts = <0x0 0x7a 0x8>;
		mediatek,pad-select = <0x0>;
		phandle = <0xbc>;
		reg = <0x0 0x11010000 0x0 0x1000>;
	};

	spi@11012000 {
		clock-names = "parent-clk", "sel-clk", "spi-clk";
		clocks = <0x26 0xb 0x26 0x6b 0x25 0x37>;
		compatible = "mediatek,mt6765-spi";
		interrupts = <0x0 0x80 0x8>;
		mediatek,pad-select = <0x0>;
		phandle = <0xbd>;
		reg = <0x0 0x11012000 0x0 0x1000>;
	};

	spi@11013000 {
		clock-names = "parent-clk", "sel-clk", "spi-clk";
		clocks = <0x26 0xb 0x26 0x6b 0x25 0x38>;
		compatible = "mediatek,mt6765-spi";
		interrupts = <0x0 0x81 0x8>;
		mediatek,pad-select = <0x0>;
		phandle = <0xbe>;
		reg = <0x0 0x11013000 0x0 0x1000>;
	};

	spi@11014000 {
		clock-names = "parent-clk", "sel-clk", "spi-clk";
		clocks = <0x26 0xb 0x26 0x6b 0x25 0x41>;
		compatible = "mediatek,mt6765-spi";
		interrupts = <0x0 0x5f 0x8>;
		mediatek,pad-select = <0x0>;
		phandle = <0xbf>;
		reg = <0x0 0x11014000 0x0 0x1000>;
	};

	spi@11015000 {
		clock-names = "parent-clk", "sel-clk", "spi-clk";
		clocks = <0x26 0xb 0x26 0x6b 0x25 0x42>;
		compatible = "mediatek,mt6765-spi";
		interrupts = <0x0 0x60 0x8>;
		mediatek,pad-select = <0x0>;
		phandle = <0xc0>;
		reg = <0x0 0x11015000 0x0 0x1000>;
	};

	sramrom@10214000 {
		compatible = "mediatek,sramrom";
		reg = <0x0 0x10214000 0x0 0x1000>;
	};

	ssmr {
		compatible = "mediatek,trusted_mem";
		memory-region = <0x6b>;
	};

	sspm@10440000 {
		compatible = "mediatek,mt6765-sspm";
		interrupt-names = "ipc", "mbox0", "mbox1", "mbox2", "mbox3", "mbox4";
		interrupts = <0x0 0xca 0x4 0x0 0xcd 0x4 0x0 0xce 0x4 0x0 0xcf 0x4 0x0 0xd0 0x4 0x0 0xd1 0x4>;
		reg = <0x0 0x10440000 0x0 0x10000 0x0 0x10450000 0x0 0x100 0x0 0x10451000 0x0 0x8 0x0 0x10460000 0x0 0x100 0x0 0x10461000 0x0 0x8 0x0 0x10470000 0x0 0x100 0x0 0x10471000 0x0 0x8 0x0 0x10480000 0x0 0x100 0x0 0x10481000 0x0 0x8 0x0 0x10490000 0x0 0x100 0x0 0x10491000 0x0 0x8>;
		reg-names = "cfgreg", "mbox0_base", "mbox0_ctrl", "mbox1_base", "mbox1_ctrl", "mbox2_base", "mbox2_ctrl", "mbox3_base", "mbox3_ctrl", "mbox4_base", "mbox4_ctrl";
	};

	sys_cirq@10204000 {
		compatible = "mediatek,sys_cirq";
		interrupts = <0x0 0x118 0x8>;
		mediatek,cirq_num = <0xd1>;
		mediatek,spi_start_offset = <0x48>;
		reg = <0x0 0x10204000 0x0 0x1000>;
	};

	tee_sanity {
		compatible = "trustonic,tee_sanity";
		interrupts = <0x0 0x110 0x1>;
	};

	teegris {
		compatible = "samsung,teegris";
		interrupts = <0x0 0x7b 0x8 0x0 0x7c 0x8>;
	};

	therm_ctrl@1100b000 {
		clock-names = "therm-main";
		clocks = <0x25 0xa>;
		compatible = "mediatek,therm_ctrl";
		interrupts = <0x0 0x4e 0x8>;
		nvmem = <0x3b>;
		nvmem-cell-names = "cpu_freq_segment_cell", "thermal_efuse_cell";
		nvmem-cells = <0x4a 0x4b>;
		nvmem-names = "mtk_efuse";
		reg = <0x0 0x1100b000 0x0 0x1000>;
	};

	thermal-sensor1 {
		compatible = "mediatek,mtboard-thermistor1";
		interconnects = <0x38 0x0>;
		io-channel-names = "thermistor-ch0";
		io-channels = <0x38 0x0>;
		phandle = <0xb7>;
	};

	thermal-sensor2 {
		compatible = "mediatek,mtboard-thermistor2";
		interconnects = <0x38 0x1>;
		io-channel-names = "thermistor-ch1";
		io-channels = <0x38 0x1>;
		phandle = <0xb8>;
	};

	thermal-sensor3 {
		compatible = "mediatek,mtboard-thermistor3";
		interconnects = <0x38 0x2>;
		io-channel-names = "thermistor-ch2";
		io-channels = <0x38 0x2>;
		phandle = <0xb9>;
	};

	thermal-sensor4 {
		compatible = "mediatek,mtboard-thermistor4";
		interconnects = <0x38 0x3>;
		io-channel-names = "thermistor-ch3";
		io-channels = <0x38 0x3>;
		phandle = <0xba>;
	};

	timer {
		clock-frequency = <0xc65d40>;
		compatible = "arm,armv8-timer";
		interrupt-parent = <0x16>;
		interrupts = <0x1 0xd 0x8 0x1 0xe 0x8 0x1 0xb 0x8 0x1 0xa 0x8>;
	};

	timer@10017000 {
		clocks = <0x34>;
		compatible = "mediatek,sys_timer", "mediatek,mt6761-timer", "mediatek,mt6765-timer";
		interrupts = <0x0 0xc2 0x4>;
		phandle = <0xa3>;
		reg = <0x0 0x10017000 0x0 0x1000>;
		reg-names = "sys_timer_base";
	};

	tkcore {
		compatible = "trustkernel,tkcore";
		interrupts = <0x0 0xf8 0x1>;
	};

	topckgen@10000000 {
		#clock-cells = <0x1>;
		compatible = "mediatek,mt6765-topckgen", "syscon";
		phandle = <0x26>;
		reg = <0x0 0x10000000 0x0 0x1000>;
	};

	topckgen_ao@1001b000 {
		compatible = "mediatek,topckgen_ao";
		reg = <0x0 0x1001b000 0x0 0x1000>;
	};

	topmisc@10011000 {
		compatible = "mediatek,topmisc";
		reg = <0x0 0x10011000 0x0 0x1000>;
	};

	toprgu@10007000 {
		#reset-cells = <0x1>;
		compatible = "mediatek,mt6765-wdt", "mediatek,mt6589-wdt", "mediatek,toprgu", "syscon", "simple-mfd";
		interrupts = <0x0 0x8b 0x0>;
		mediatek,rg_dfd_timeout = <0xa0>;
		phandle = <0x48>;
		reg = <0x0 0x10007000 0x0 0x1000>;

		reboot-mode {
			compatible = "syscon-reboot-mode";
			mask = <0xf>;
			mode-bootloader = <0x3>;
			mode-charger = <0x1>;
			mode-ddr-reserve = <0x6>;
			mode-dm-verity-dev-corrupt = <0x4>;
			mode-kpoc = <0x5>;
			mode-meta = <0x7>;
			mode-recovery = <0x2>;
			mode-rpmbpk = <0x8>;
			offset = <0x24>;
		};
	};

	touch {
		compatible = "goodix,touch";
		phandle = <0x9c>;
	};

	trng@1020f000 {
		compatible = "mediatek,trng";
		interrupts = <0x0 0xa1 0x8>;
		reg = <0x0 0x1020f000 0x0 0x1000>;
	};

	trusty {
		#address-cells = <0x2>;
		#size-cells = <0x2>;
		compatible = "android,trusty-smc-v1";
		ranges;
		tee-id = <0x0>;
		tee-name = "trusty";

		gz-main {
			compatible = "mediatek,trusty-gz";
		};

		mtee {
			compatible = "mediatek,trusty-mtee-v1";
		};

		trusty-gz-log {
			compatible = "android,trusty-gz-log-v1";
		};

		trusty-irq {
			compatible = "android,trusty-irq-v1";
			ppi-interrupt-parent = <0x16>;
		};

		trusty-virtio {
			compatible = "android,trusty-virtio-v1";
		};
	};

	type_c_port0 {
		mt-tcpc,name = "type_c_port0";
		mt-tcpc,notifier_supply_num = <0x2>;
		mt-tcpc,role_def = <0x2>;
		mt-tcpc,rp_level = <0x1>;
		mt-tcpc,vconn_supply = <0x1>;
		mt6370pd,intr_gpio = <0x1f 0x6b 0x0>;
		mt6370pd,intr_gpio_num = <0x6b>;
		phandle = <0xfc>;
		tcpc-dual,supported_modes = <0x0>;
	};

	usb-phy@11210000 {
		#address-cells = <0x2>;
		#size-cells = <0x2>;
		compatible = "mediatek,generic-tphy-v1";
		phandle = <0xc1>;
		ranges;
		reg = <0x0 0x11cc0000 0x0 0x800>;
		status = "okay";

		usb-phy@11210000 {
			#phy-cells = <0x1>;
			clock-names = "ref";
			clocks = <0x24>;
			nvmem-cell-masks = <0x1f>;
			nvmem-cell-names = "intr_cal";
			nvmem-cells = <0x50>;
			phandle = <0x4f>;
			reg = <0x0 0x11cc0800 0x0 0x100>;
			status = "okay";
		};
	};

	usb0@11200000 {
		clock-names = "usb0", "usb0_clk_top_sel", "usb0_clk_univpll3_d4";
		clocks = <0x25 0x8 0x26 0x76 0x26 0x20>;
		compatible = "mediatek,mt6765-usb20";
		dr_mode = "otg";
		interrupt-names = "mc";
		interrupts = <0x0 0x49 0x8>;
		mode = <0x2>;
		multipoint = <0x1>;
		num_eps = <0x10>;
		pericfg = <0x4e>;
		phandle = <0x6a>;
		phys = <0x4f 0x3>;
		reg = <0x0 0x11200000 0x0 0x10000 0x0 0x11cc0000 0x0 0x10000>;
		usb-role-switch;
	};

	usb1p_sif@11210000 {
		compatible = "mediatek,usb1p_sif";
		reg = <0x0 0x11210000 0x0 0x10000>;
	};

	utos {
		compatible = "microtrust,utos";
		interrupts = <0x0 0xf9 0x1 0x0 0xfa 0x1>;
	};

	utos_tester {
		compatible = "microtrust,tester-v1";
	};

	vcodecsys@17000000 {
		#clock-cells = <0x1>;
		compatible = "mediatek,mt6765-vcodecsys", "syscon";
		phandle = <0x66>;
		pwr-regmap = <0x62>;
		reg = <0x0 0x17000000 0x0 0x10000>;
	};

	vdec@17040000 {
		compatible = "mediatek,vdec";
		interrupts = <0x0 0xe9 0x8>;
		reg = <0x0 0x17040000 0x0 0x10000>;
	};

	venc@17020000 {
		compatible = "mediatek,venc";
		interrupts = <0x0 0xe6 0x8>;
		reg = <0x0 0x17020000 0x0 0x10000>;
	};

	venc_gcon@17000000 {
		clock-names = "MT_SCP_SYS_DIS", "MT_SCP_SYS_VCODEC", "MT_CG_MM_SMI_COMM0", "MT_CG_MM_SMI_COMM1", "MT_CG_MM_SMI_COMMON", "MT_CG_VDEC", "MT_CG_VENC";
		clocks = <0x35 0x3 0x35 0xa 0x63 0x15 0x63 0x16 0x63 0x13 0x66 0x3 0x66 0x1>;
		compatible = "mediatek,venc_gcon", "syscon";
		phandle = <0xd7>;
		reg = <0x0 0x17000000 0x0 0x10000>;
	};

	venc_jpg@17030000 {
		clock-names = "MT_CG_VENC_JPGENC";
		clocks = <0x66 0x2>;
		compatible = "mediatek,venc_jpg";
		interrupts = <0x0 0xe8 0x8>;
		reg = <0x0 0x17030000 0x0 0x10000>;
	};

	wifi@18000000 {
		compatible = "mediatek,wifi";
		interrupts = <0x0 0x10c 0x8>;
		memory-region = <0x4d>;
		phandle = <0xbb>;
		reg = <0x0 0x18000000 0x0 0x100000>;
	};
};
